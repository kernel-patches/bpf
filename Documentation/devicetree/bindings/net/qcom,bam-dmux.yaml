## Documentation/devicetree/bindings/phy/qcom,sa8255p-dwmac-sgmii-phy.yaml
```yaml
# SPDX-License-Identifier: (GPL-2.0 OR BSD-2-Clause)
%YAML 1.2
---
$id: http://devicetree.org/schemas/phy/qcom,sa8255p-dwmac-sgmii-phy.yaml#
$schema: http://devicetree.org/meta-schemas/core.yaml#

title: Qualcomm SerDes/SGMII ethernet PHY controller (firmware managed)

maintainers:
  - Bartosz Golaszewski <brgl@kernel.org>

description:
  The SerDes PHY sits between the MAC and the external PHY and provides
  separate Rx Tx lines.

properties:
  compatible:
    const: qcom,sa8255p-dwmac-sgmii-phy

  reg:
    items:
      - description: serdes

  power-domains:
    maxItems: 1

  power-domain-names:
    maxItems: 1

  "#phy-cells":
    const: 0

required:
  - compatible
  - reg
  - "#phy-cells"
  - power-domains
  - power-domain-names

additionalProperties: false

examples:
  - |
    phy@8901000 {
        compatible = "qcom,sa8255p-dwmac-sgmii-phy";
        reg = <0x08901000 0xe10>;
        #phy-cells = <0>;
        power-domains = <&scmi7_dvfs 0>;
        power-domain-names = "serdes";
    };
```

## Documentation/devicetree/bindings/ptp/renesas,rcar-gen4-gptp.yaml
```yaml
# SPDX-License-Identifier: GPL-2.0-only OR BSD-2-Clause
# Copyright (C) 2026 Renesas Electronics Corp.
# Copyright (C) 2026 Niklas Söderlund <niklas.soderlund@ragnatech.se>
%YAML 1.2
---
$id: http://devicetree.org/schemas/ptp/renesas,rcar-gen4-gptp.yaml#
$schema: http://devicetree.org/meta-schemas/core.yaml#

title: Renesas R-Car Gen4 gPTP timer

maintainers:
  - Niklas Söderlund <niklas.soderlund@ragnatech.se>

description:
  The R-Car Gen4 gPTP timer enables accurate synchronization of the clock in
  the control system. The timer is system-wide and used by different Ethernet
  devices on each Gen4 platform.

    - On R-Car S4 it is shared between RSWITCH and RAVB.
    - On R-Car V4H it is shared between RTSN and RAVB.
    - On R-Car V4M it is only used by RAVB.

properties:
  compatible:
    items:
      - enum:
          - renesas,r8a779f0-gptp # S4-8
          - renesas,r8a779g0-gptp # V4H
          - renesas,r8a779h0-gptp # V4M
      - const: renesas,rcar-gen4-gptp

  reg:
    maxItems: 1

  clocks:
    maxItems: 1

  power-domains:
    maxItems: 1

  resets:
    maxItems: 1

required:
  - compatible
  - reg
  - clocks
  - power-domains
  - resets

additionalProperties: false

examples:
  - |
    #include <dt-bindings/clock/r8a779g0-cpg-mssr.h>
    #include <dt-bindings/power/r8a779g0-sysc.h>

    ptp@e6449000 {
            compatible = "renesas,r8a779g0-gptp", "renesas,rcar-gen4-gptp";
            reg = <0xe6449000 0x500>;
            clocks = <&cpg CPG_MOD 2723>;
            power-domains = <&sysc R8A779G0_PD_ALWAYS_ON>;
            resets = <&cpg 2723>;
    };
```

## arch/arm/mach-orion5x/Kconfig
```kconfig
# SPDX-License-Identifier: GPL-2.0-only
menuconfig ARCH_ORION5X
	bool "Marvell Orion"
	depends on ARCH_MULTI_V5
	depends on CPU_LITTLE_ENDIAN
	select CPU_FEROCEON
	select GPIOLIB
	select GPIOLIB_LEGACY
	select MVEBU_MBUS
	select FORCE_PCI
	select PCI_QUIRKS
	select PHYLIB if NETDEVICES
	select PLAT_ORION_LEGACY
	help
	  Support for the following Marvell Orion 5x series SoCs:
	  Orion-1 (5181), Orion-VoIP (5181L), Orion-NAS (5182),
	  Orion-2 (5281), Orion-1-90 (6183).

if ARCH_ORION5X

config ARCH_ORION5X_DT
	def_bool y
	select ORION_CLK
	select ORION_IRQCHIP
	select ORION_TIMER
	select PINCTRL
	select PINCTRL_ORION
	help
	  Say 'Y' here if you want your kernel to support the
	  Marvell Orion5x using flattened device tree.

config MACH_RD88F5182_DT
	bool "Marvell Orion-NAS Reference Design (Flattened Device Tree)"
	select ARCH_ORION5X_DT
	select I2C_BOARDINFO if I2C
	help
	  Say 'Y' here if you want your kernel to support the Marvell
	  Orion-NAS (88F5182) RD2, Flattened Device Tree.

config MACH_LINKSTATION_MINI
	bool "Buffalo Linkstation Mini (Flattened Device Tree)"
	select ARCH_ORION5X_DT
	help
	  Say 'Y' here if you want your kernel to support the
	  Buffalo Linkstation Mini (LS-WSGL) platform.

config MACH_D2NET_DT
	bool "LaCie d2 Network / Big Disk Network (Flattened Device Tree)"
	select ARCH_ORION5X_DT
	help
	  Say 'Y' here if you want your kernel to support the
	  LaCie d2 Network NAS.

config MACH_MSS2_DT
	bool "Maxtor Shared Storage II (Flattened Device Tree)"
	select ARCH_ORION5X_DT
	help
	  Say 'Y' here if you want your kernel to support the
	  Maxtor Shared Storage II platform.

endif
```

## arch/arm/mach-pxa/Kconfig
```kconfig
# SPDX-License-Identifier: GPL-2.0-only
menuconfig ARCH_PXA
	bool "PXA2xx/PXA3xx-based"
	depends on ARCH_MULTI_V5
	depends on CPU_LITTLE_ENDIAN
	select ARM_CPU_SUSPEND if PM
	select CLKSRC_PXA
	select CLKSRC_MMIO
	select TIMER_OF
	select CPU_XSCALE if !CPU_XSC3
	select GPIO_PXA
	select GPIOLIB
	select GPIOLIB_LEGACY
	select PLAT_PXA
	help
	  Support for Intel/Marvell's PXA2xx/PXA3xx processor line.

if ARCH_PXA

config MACH_PXA25X_DT
	bool "Support PXA25x platforms from device tree"
	select PINCTRL
	select POWER_SUPPLY
	select PXA25x
	help
	  Include support for Marvell PXA25x based platforms using
	  the device tree. Needn't select any other machine while
	  MACH_PXA25x_DT is enabled.

config MACH_PXA27X_DT
	bool "Support PXA27x platforms from device tree"
	select PINCTRL
	select POWER_SUPPLY
	select PXA27x
	help
	  Include support for Marvell PXA27x based platforms using
	  the device tree. Needn't select any other machine while
	  MACH_PXA27X_DT is enabled.

config MACH_PXA3XX_DT
	bool "Support PXA3xx platforms from device tree"
	select CPU_PXA300
	select CPU_PXA310
	select CPU_PXA320
	select PINCTRL
	select POWER_SUPPLY
	select PXA3xx
	help
	  Include support for Marvell PXA3xx based platforms using
	  the device tree. Needn't select any other machine while
	  MACH_PXA3XX_DT is enabled.

config PXA25x
	bool
	select CPU_XSCALE
	help
	  Select code specific to PXA21x/25x/26x variants

config PXA27x
	bool
	select CPU_XSCALE
	help
	  Select code specific to PXA27x variants

config PXA3xx
	bool
	select CPU_XSC3
	help
	  Select code specific to PXA3xx variants

config CPU_PXA300
	bool
	select PXA3xx
	help
	  PXA300 (codename Monahans-L)

config CPU_PXA310
	bool
	select CPU_PXA300
	help
	  PXA310 (codename Monahans-LV)

config CPU_PXA320
	bool
	select PXA3xx
	help
	  PXA320 (codename Monahans-P)

endif
```

## drivers/dpll/dpllsim/Kconfig
```kconfig
# SPDX-License-Identifier: GPL-2.0-only

config DPLLSIM
	tristate "DPLL simulator driver"
	depends on NET
	select DPLL
	select CONFIGFS_FS
	help
	  This driver provides simulated DPLL devices for testing and
	  development of the DPLL subsystem and its userspace tooling
	  without real hardware. Devices with arbitrary pin topologies
	  are created and configured at runtime through configfs,
	  similar to what gpio-sim provides for GPIO.

	  To compile this driver as a module, choose M here: the module
	  will be called dpllsim.
```

## drivers/dpll/sit9531x/Kconfig
```kconfig
# SPDX-License-Identifier: GPL-2.0-only

config SIT9531X_DPLL
	tristate "SiTime SiT9531x DPLL driver"
	depends on I2C && NET
	select DPLL
	select REGMAP_I2C
	help
	  Driver for SiTime SiT9531x family clock generators
	  (SiT95317, SiT95316).

	  This driver registers each on-chip PLL as a DPLL device
	  and exposes input/output clocks as DPLL pins, providing
	  runtime configuration via Generic Netlink.

	  To compile this driver as a module, choose M here: the
	  module will be called sit9531x.
```

## drivers/firmware/arm_rmm/Kconfig
```kconfig
config ARCH_SUPPORTS_RMM
	bool

config ARM_RMM_RMI
	bool "Realm Management Interface (RMI) Support"
	depends on ARCH_SUPPORTS_RMM
	help
	  Support the Realm Management Monitor (RMM) on Arm systems that
	  implement the Realm Management Extension (RME), as defined by the
	  Arm Confidential Compute Architecture.

	  The RMM runs at EL2 in the Realm world and provides the Realm
	  Management Interface (RMI) used by a Normal World host to create,
	  manage and run protected virtual machines called Realms. The RMM can
	  also act as a TSM, as defined by the PCIe TDISP and can manage the
	  PCI IDE setup for securing the PCIe links.

	  This option builds the host-side RMI support used by KVM to detect a
	  compatible RMM, configure it, manage delegated memory and enable
	  Realm guests.

	  Selecting this option does not by itself make Realm guests available:
	  the system must also provide RME-capable hardware and firmware with a
	  compatible RMM implementation.
```

## drivers/gpu/drm/panel/bpf/Kconfig
```kconfig
# SPDX-License-Identifier: GPL-2.0

config DRM_PANEL_BPF
	tristate "eBPF-backed panels"
	depends on DRM && DRM_PANEL
	depends on BPF_SYSCALL
	help
	  TODO

menu "eBPF Display Panels"
	depends on DRM_PANEL_BPF

config DRM_PANEL_BPF_MIPI_DSI
	tristate "Generic BPF-based MIPI-DSI panel"
	depends on BACKLIGHT_CLASS_DEVICE
	depends on BPF_SYSCALL
	depends on DRM_MIPI_DSI
	depends on OF
	select VIDEOMODE_HELPERS
	help
	  Generic MIPI-DSI panel driver that delegates panel-specific
	  power sequencing and DSI init commands to BPF programs loaded
	  from userspace.

	  Enable this if you want to support MIPI-DSI panels without
	  panel-specific kernel drivers.

endmenu
```

## drivers/net/dsa/mediatek/Kconfig
```kconfig
# SPDX-License-Identifier: GPL-2.0-only
config NET_DSA_AN8855
	tristate "Airoha AN8855 Ethernet switch support"
	depends on MFD_AIROHA_AN8855 || COMPILE_TEST
	depends on NET_DSA
	select NET_DSA_MT7530_LIB
	select NET_DSA_TAG_AIROHA
	help
	  This enables support for the Ethernet switch inside the
	  Airoha AN8855 chip.

config NET_DSA_MT7530_LIB
	tristate

config NET_DSA_MT7530
	tristate "MediaTek MT7530 and MT7531 Ethernet switch support"
	select NET_DSA_MT7530_LIB
	select NET_DSA_TAG_MTK
	select REGMAP_IRQ
	imply NET_DSA_MT7530_MDIO
	imply NET_DSA_MT7530_MMIO
	help
	  This enables support for the MediaTek MT7530 and MT7531 Ethernet
	  switch chips. Multi-chip module MT7530 in MT7621AT, MT7621DAT,
	  MT7621ST and MT7623AI SoCs, and built-in switch in MT7988 SoC are
	  supported as well.

config NET_DSA_MT7530_MDIO
	tristate "MediaTek MT7530 MDIO interface driver"
	depends on NET_DSA_MT7530
	select MEDIATEK_GE_PHY
	select PCS_MTK_LYNXI
	help
	  This enables support for the MediaTek MT7530 and MT7531 switch
	  chips which are connected via MDIO, as well as multi-chip
	  module MT7530 which can be found in the MT7621AT, MT7621DAT,
	  MT7621ST and MT7623AI SoCs.

config NET_DSA_MT7530_MMIO
	tristate "MediaTek MT7530 MMIO interface driver"
	depends on NET_DSA_MT7530
	depends on HAS_IOMEM
	imply MEDIATEK_GE_SOC_PHY
	help
	  This enables support for the built-in Ethernet switch found
	  in the MediaTek MT7988 SoC.
	  The switch is a similar design as MT7531, but the switch registers
	  are directly mapped into the SoCs register space rather than being
	  accessible via MDIO.

config NET_DSA_MT7628
	tristate "MediaTek MT7628 Embedded Ethernet switch support"
	depends on HAS_IOMEM && (SOC_MT7620 || COMPILE_TEST)
	select NET_DSA_TAG_MT7628
	select MEDIATEK_FE_SOC_PHY
	select REGMAP_MMIO
	help
	  This enables support for the built-in Ethernet switch found
	  in the MT7628 SoC.
```

## drivers/net/dsa/microchip/lan9645x/Kconfig
```kconfig
# SPDX-License-Identifier: GPL-2.0-only
config NET_DSA_MICROCHIP_LAN9645X
	tristate "Microchip Lan9645x switch support"
	depends on NET_DSA
	select NET_DSA_TAG_LAN9645X
	help
	  This driver adds DSA support for Microchip Lan9645x switch chips.
	  The lan9645x switch is a multi-port Gigabit AVB/TSN Ethernet Switch
	  with five integrated 10/100/1000Base-T PHYs. In addition to the
	  integrated PHYs, it supports up to 2 RGMII/RMII, up to 2
	  BASE-X/SERDES/2.5GBASE-X and one Quad-SGMII/Quad-USGMII interfaces.
```

## drivers/net/dsa/soce/Kconfig
```kconfig
# SPDX-License-Identifier: GPL-2.0
config NET_DSA_SOCE
	tristate "SoC-e switches"
	depends on NET_DSA
	depends on OF
	depends on HAS_IOMEM
	select NET_DSA_TAG_SDSA
	help
	  This enables support for switches based on SoC-e IP cores.
	  Frames are exchanged with the CPU port using the SDSA DSA tag protocol.
	  The driver supports switch variants whose features and number of ports
	  are selected at synthesis time and detected at runtime.
```

## drivers/net/ethernet/mellanox/mlx5/nodnic/Kconfig
```kconfig
# SPDX-License-Identifier: GPL-2.0-only

config MLX5_NODNIC
	tristate "Mellanox NODNIC core driver"
	depends on PCI
	depends on NETDEVICES && ETHERNET
	help
	  This driver provides core support for Mellanox NODNIC (NO DRAM NIC)
	  devices. NODNIC is a lightweight network
	  interface driver that uses Vendor Specific Capability (VSC) for
	  PCI communication with Mellanox network adapters.

	  This driver enables basic Ethernet networking functionality for
	  supported Mellanox NODNIC hardware.

	  To compile this driver as a module, choose M here: the module
	  will be called mlx5_nodnic.
```

## drivers/net/ethernet/oa_tc6/Kconfig
```kconfig
# SPDX-License-Identifier: GPL-2.0-only
#
# OA TC6 10BASE-T1x MAC-PHY configuration
#

config OA_TC6
	tristate "OPEN Alliance TC6 10BASE-T1x MAC-PHY support" if COMPILE_TEST
	depends on SPI
	depends on PTP_1588_CLOCK_OPTIONAL
	select PHYLIB
	help
	  This library implements OPEN Alliance TC6 10BASE-T1x MAC-PHY
	  Serial Interface protocol for supporting 10BASE-T1x MAC-PHYs.

	  To know the implementation details, refer documentation in
	  <file:Documentation/networking/oa-tc6-framework.rst>.
```

## drivers/net/ethernet/onsemi/Kconfig
```kconfig
# SPDX-License-Identifier: GPL-2.0-only
#
# onsemi network device configuration
#

config NET_VENDOR_ONSEMI
	bool "onsemi network devices"
	default y
	help
	  If you have a network card belonging to this class, say Y.

	  Note that the answer to this question doesn't directly affect the
	  kernel: saying N will just cause the configurator to skip all
	  the questions about onsemi ethernet devices. If you say Y, you
	  will be asked for your specific card in the following questions.

if NET_VENDOR_ONSEMI

source "drivers/net/ethernet/onsemi/s2500/Kconfig"

endif # NET_VENDOR_ONSEMI
```

## drivers/net/ethernet/onsemi/s2500/Kconfig
```kconfig
# SPDX-License-Identifier: GPL-2.0-only
#
# onsemi S2500 Driver Support
#

config S2500_MACPHY
	tristate "S2500 support"
	depends on SPI
	depends on PTP_1588_CLOCK_OPTIONAL
	imply NET_SELFTESTS
	select BITREVERSE
	select NCN26000_PHY
	select OA_TC6
	help
	  Support for the onsemi S2500 MACPHY Ethernet chip.
	  It works under the framework that conform to OPEN Alliance
	  10BASE-T1x Serial Interface specification.

	  To compile this driver as a module, choose M here. The module will be
	  called s2500.
```

## drivers/net/ethernet/xilinx/tsn/Kconfig
```kconfig
# SPDX-License-Identifier: GPL-2.0-only
#
# Xilinx TSN device configuration
#

config XILINX_TSN
	tristate "Xilinx TSN Ethernet driver"
	depends on OF_ADDRESS
	help
	  This driver supports the AMD/Xilinx Time-Sensitive Networking
	  (TSN) Endpoint Ethernet MAC IP. It provides the wrapper device
	  and the endpoint MAC that connects the IP to the host CPU.

	  If unsure, say N.
```

## drivers/net/phy/realtek/Kconfig
```kconfig
# SPDX-License-Identifier: GPL-2.0-only
config REALTEK_PHY
	tristate "Realtek PHYs"
	select PHY_PACKAGE
	help
	  Currently supports RTL821x/RTL822x and fast ethernet PHYs

if REALTEK_PHY

config REALTEK_PHY_HWMON
	bool "HWMON support for Realtek PHYs"
	depends on HWMON && !(REALTEK_PHY=y && HWMON=m)
	help
	  Optional hwmon support for the temperature sensor

config REALTEK_PHY_PTP
	bool "PTP support for Realtek PHYs"
	default y
	depends on PTP_1588_CLOCK && NETWORK_PHY_TIMESTAMPING
	depends on !(REALTEK_PHY=y && PTP_1588_CLOCK=m)
	help
	  Optional PTP hardware clock and hardware timestamping support
	  for the internal PHY of RTL8127A. The PHY registers a PTP clock
	  and timestamps PTPv2 event messages on behalf of the MAC, so no
	  support from the MAC driver is needed.

endif # REALTEK_PHY
```
