## Documentation/devicetree/bindings/net/qcom,bam-dmux.yaml
```yaml
# SPDX-License-Identifier: (GPL-2.0-only OR BSD-2-Clause)
%YAML 1.2
---
$id: http://devicetree.org/schemas/net/qcom,bam-dmux.yaml#
$schema: http://devicetree.org/meta-schemas/core.yaml#

title: Qualcomm BAM Data Multiplexer

maintainers:
  - Stephan Gerhold <stephan@gerhold.net>

description: |
  The BAM Data Multiplexer provides access to the network data channels
  of modems integrated into many older Qualcomm SoCs, e.g. Qualcomm MSM8916
  or MSM8974. It is built using a simple protocol layer on top of a DMA engine
  (Qualcomm BAM DMA) and bidirectional interrupts to coordinate power control.

  Note that this schema does not directly describe a hardware block but rather
  a firmware convention that combines several other hardware blocks (such as the
  DMA engine). As such it is specific to a firmware version, not a particular
  SoC or hardware version.

properties:
  compatible:
    oneOf:
      - const: qcom,bam-dmux
      - items:
          - const: qcom,shikra-bam-dmux
          - const: qcom,bam-dmux

  interrupts:
    description:
      Interrupts used by the modem to signal the AP.
      Both interrupts must be declared as IRQ_TYPE_EDGE_BOTH.
    items:
      - description: Power control
      - description: Power control acknowledgment

  interrupt-names:
    items:
      - const: pc
      - const: pc-ack

  qcom,smem-states:
    $ref: /schemas/types.yaml#/definitions/phandle-array
    description: State bits used by the AP to signal the modem.
    items:
      - description: Power control
        items:
          - description: Phandle to the Shared Memory Point 2 Point device
              handling the communication with a remote processor
          - description: Single bit index to toggle in the value sent to
              the remote processor
            maximum: 32
      - description: Power control acknowledgment
        items:
          - description: Phandle to the Shared Memory Point 2 Point device
              handling the communication with a remote processor
          - description: Single bit index to toggle in the value sent to
              the remote processor
            maximum: 32

  qcom,smem-state-names:
    description: Names for the state bits used by the AP to signal the modem.
    items:
      - const: pc
      - const: pc-ack

  dmas:
    items:
      - description: TX DMA channel phandle
      - description: RX DMA channel phandle

  dma-names:
    items:
      - const: tx
      - const: rx

  memory-region:
    maxItems: 1
    description:
      Phandle to a reserved-memory node compatible with restricted-dma-pool.
      The BAM-DMUX device uses the pool for DMA mappings.

  qcom,vmid:
    $ref: /schemas/types.yaml#/definitions/uint32-array
    maxItems: 1
    items:
      minimum: 1
      maximum: 63
    description:
      VMID of the remote execution environment that is granted access to the
      restricted DMA pool through SCM.

required:
  - compatible
  - interrupts
  - interrupt-names
  - qcom,smem-states
  - qcom,smem-state-names
  - dmas
  - dma-names

dependencies:
  qcom,vmid: [ memory-region ]

allOf:
  - if:
      properties:
        compatible:
          contains:
            const: qcom,shikra-bam-dmux
    then:
      required:
        - memory-region
        - qcom,vmid

additionalProperties: false

examples:
  - |
    #include <dt-bindings/interrupt-controller/irq.h>

    mpss: remoteproc {
        bam-dmux {
            compatible = "qcom,bam-dmux";

            interrupt-parent = <&modem_smsm>;
            interrupts = <1 IRQ_TYPE_EDGE_BOTH>, <11 IRQ_TYPE_EDGE_BOTH>;
            interrupt-names = "pc", "pc-ack";

            qcom,smem-states = <&apps_smsm 1>, <&apps_smsm 11>;
            qcom,smem-state-names = "pc", "pc-ack";

            dmas = <&bam_dmux_dma 4>, <&bam_dmux_dma 5>;
            dma-names = "tx", "rx";
        };
    };
```

## Documentation/devicetree/bindings/net/realtek,rtl82xx.yaml
```yaml
# SPDX-License-Identifier: GPL-2.0+
%YAML 1.2
---
$id: http://devicetree.org/schemas/net/realtek,rtl82xx.yaml#
$schema: http://devicetree.org/meta-schemas/core.yaml#

title: Realtek RTL82xx PHY

maintainers:
  - Andrew Lunn <andrew@lunn.ch>
  - Florian Fainelli <f.fainelli@gmail.com>
  - Heiner Kallweit <hkallweit1@gmail.com>

description:
  Bindings for Realtek RTL82xx PHYs.

  The RTL8224 contains four PHYs at consecutive MDIO addresses. Its PHY
  nodes may be grouped under an ethernet-phy-package node as described
  in ethernet-phy-package.yaml. The package reg must identify the first
  PHY's MDIO address, even if that PHY has no child node. This address
  need not be a multiple of four. Each child PHY reg is its absolute
  MDIO address, not an offset from the package base.

  The enet-phy-pair-order and enet-phy-pair-polarity properties belong
  to the individual PHY nodes and describe each port's MDI wiring.

properties:
  compatible:
    enum:
      - ethernet-phy-id001c.c800
      - ethernet-phy-id001c.c816
      - ethernet-phy-id001c.c838
      - ethernet-phy-id001c.c840
      - ethernet-phy-id001c.c848
      - ethernet-phy-id001c.c849
      - ethernet-phy-id001c.c84a
      - ethernet-phy-id001c.c862
      - ethernet-phy-id001c.c878
      - ethernet-phy-id001c.c880
      - ethernet-phy-id001c.c910
      - ethernet-phy-id001c.c912
      - ethernet-phy-id001c.c913
      - ethernet-phy-id001c.c914
      - ethernet-phy-id001c.c915
      - ethernet-phy-id001c.c916
      - ethernet-phy-id001c.c942
      - ethernet-phy-id001c.c961
      - ethernet-phy-id001c.cad0
      - ethernet-phy-id001c.cb00

  leds: true

  realtek,aldps-enable:
    type: boolean
    description:
      Enable ALDPS mode, ALDPS mode default is disabled after hardware reset.

  realtek,clkout-disable:
    type: boolean
    description:
      Disable CLKOUT clock, CLKOUT clock default is enabled after hardware reset.

  realtek,clkout-ssc-enable:
    type: boolean
    description:
      Enable CLKOUT SSC mode, CLKOUT SSC mode default is disabled after hardware reset.

  realtek,rxc-ssc-enable:
    type: boolean
    description:
      Enable RXC SSC mode, RXC SSC mode default is disabled after hardware reset.

  realtek,sysclk-ssc-enable:
    type: boolean
    description:
      Enable SYSCLK SSC mode, SYSCLK SSC mode default is disabled after hardware reset.

  wakeup-source:
    type: boolean
    description:
      Enable Wake-on-LAN support for the RTL8211F PHY.

unevaluatedProperties: false

allOf:
  - $ref: ethernet-phy.yaml#
  - if:
      not:
        properties:
          compatible:
            contains:
              const: ethernet-phy-id001c.c916
    then:
      properties:
        leds: false

examples:
  - |
    mdio {
        #address-cells = <1>;
        #size-cells = <0>;

        ethernet-phy@1 {
            reg = <1>;
            realtek,aldps-enable;
            realtek,clkout-disable;
        };
    };
  - |
    mdio {
        #address-cells = <1>;
        #size-cells = <0>;

        ethernet-phy-package@1 {
            reg = <1>;
            #address-cells = <1>;
            #size-cells = <0>;

            ethernet-phy@1 {
                compatible = "ethernet-phy-ieee802.3-c45";
                reg = <1>;
                enet-phy-pair-order = <0>;
            };

            ethernet-phy@2 {
                compatible = "ethernet-phy-ieee802.3-c45";
                reg = <2>;
                enet-phy-pair-order = <0>;
            };

            ethernet-phy@3 {
                compatible = "ethernet-phy-ieee802.3-c45";
                reg = <3>;
                enet-phy-pair-order = <1>;
            };

            ethernet-phy@4 {
                compatible = "ethernet-phy-ieee802.3-c45";
                reg = <4>;
                enet-phy-pair-order = <1>;
                enet-phy-pair-polarity = <0x1>;
            };
        };
    };
```

## Documentation/devicetree/bindings/net/siflower,sf19a2890-gmac.yaml
```yaml
# SPDX-License-Identifier: (GPL-2.0-only OR BSD-2-Clause)
%YAML 1.2
---
$id: http://devicetree.org/schemas/net/siflower,sf19a2890-gmac.yaml#
$schema: http://devicetree.org/meta-schemas/core.yaml#

title: Siflower SF19A2890 GMAC

maintainers:
  - Joseph Telaak <joseph@telaak.dev>

description:
  The Siflower SF19A2890 has a Synopsys DesignWare GMAC 3.73a. Its
  interface type and RGMII clock delays are set in a configuration block
  of their own. The MAC adds an RGMII delay only where the
  rx-internal-delay-ps or tx-internal-delay-ps property says so.

select:
  properties:
    compatible:
      contains:
        const: siflower,sf19a2890-gmac
  required:
    - compatible

properties:
  compatible:
    items:
      - const: siflower,sf19a2890-gmac
      - const: snps,dwmac

  reg:
    items:
      - description: MAC registers
      - description: Interface configuration registers

  interrupts:
    maxItems: 3

  interrupt-names:
    items:
      - const: macirq
      - const: eth_wake_irq
      - const: eth_lpi

  clocks:
    items:
      - description: GMAC main clock
      - description: Peripheral registers interface clock
      - description: PTP reference clock
      - description: RGMII transmit reference clock

  clock-names:
    items:
      - const: stmmaceth
      - const: pclk
      - const: ptp_ref
      - const: byp_ref

  rx-internal-delay-ps:
    description:
      Applied in steps of about 55 ps, rounded to the nearest step.
    maximum: 14025

  tx-internal-delay-ps:
    description:
      Applied in steps of about 55 ps, rounded to the nearest step.
    maximum: 14025

required:
  - compatible
  - reg
  - interrupts
  - interrupt-names
  - clocks
  - clock-names
  - resets
  - reset-names

allOf:
  - $ref: snps,dwmac.yaml#

unevaluatedProperties: false

examples:
  - |
    #include <dt-bindings/interrupt-controller/irq.h>
    #include <dt-bindings/interrupt-controller/mips-gic.h>

    ethernet@10800000 {
        compatible = "siflower,sf19a2890-gmac", "snps,dwmac";
        reg = <0x10800000 0x200000>, <0x19e04440 0x10>;
        interrupt-parent = <&gic>;
        interrupts = <GIC_SHARED 32 IRQ_TYPE_LEVEL_HIGH>,
                     <GIC_SHARED 34 IRQ_TYPE_LEVEL_HIGH>,
                     <GIC_SHARED 33 IRQ_TYPE_LEVEL_HIGH>;
        interrupt-names = "macirq", "eth_wake_irq", "eth_lpi";
        clocks = <&gmac_crm 0>, <&gmac_crm 1>, <&gmac_crm 3>, <&gmac_crm 2>;
        clock-names = "stmmaceth", "pclk", "ptp_ref", "byp_ref";
        resets = <&gmac_crm 0>;
        reset-names = "stmmaceth";
        phy-mode = "rgmii-id";
        rx-internal-delay-ps = <550>;
        tx-internal-delay-ps = <935>;

        fixed-link {
            speed = <1000>;
            full-duplex;
        };
    };
```

## Documentation/devicetree/bindings/net/soce,swip-mdio.yaml
```yaml
# SPDX-License-Identifier: (GPL-2.0-only OR BSD-2-Clause)
%YAML 1.2
---
$id: http://devicetree.org/schemas/net/soce,swip-mdio.yaml#
$schema: http://devicetree.org/meta-schemas/core.yaml#

title: SoC-e switch IP MDIO controller

maintainers:
  - Vasilij Strassheim <v.strassheim@linutronix.de>

description:
  MDIO controller integrated into SoC-e Ethernet switch FPGA IP cores.
  The controller accesses multiple external MDIO buses through a mux.

$ref: mdio.yaml#

properties:
  compatible:
    const: soce,swip-mdio-23-02

  reg:
    items:
      - description: MDIO parameter, write data, and read data registers
      - description: Shared MDIO transaction control and bus selection register

  reg-names:
    items:
      - const: data
      - const: control

required:
  - compatible
  - reg
  - reg-names

unevaluatedProperties: false

examples:
  - |
    mdio@204 {
        compatible = "soce,swip-mdio-23-02";
        reg = <0x204 0xc>, <0x200 0x4>;
        reg-names = "data", "control";
        #address-cells = <1>;
        #size-cells = <0>;
    };
```

## Documentation/devicetree/bindings/net/wiznet,w5100.yaml
```yaml
# SPDX-License-Identifier: (GPL-2.0-only OR BSD-2-Clause)
%YAML 1.2
---
$id: http://devicetree.org/schemas/net/wiznet,w5100.yaml#
$schema: http://devicetree.org/meta-schemas/core.yaml#

title: Wiznet w5100/w5200/w5500 SPI Ethernet Controller

maintainers:
  - Arthur Crepin Leblond <arthur@marmottus.net>

description: |
  This is a standalone 10/100 MBit Ethernet controller with SPI interface.

properties:
  compatible:
    enum:
      - wiznet,w5100
      - wiznet,w5200
      - wiznet,w5500

  interrupts:
    description:
      The main interrupt (INT pin) is mandatory on all devices. The w5500
      additionally supports an optional second interrupt for link status changes
      (LINKLED pin). If it is not specified, link state changes will not be
      reported.

  reg:
    maxItems: 1

  spi-max-frequency:
    description:
      According to the datasheets, w5500 and w5200 allow a maximum of 80 MHz
      while w5100 is reported by users to allow a maximum of 14 MHz. However,
      board designs may need to limit this value.
    maximum: 80000000

required:
  - compatible
  - reg
  - interrupts

allOf:
  - $ref: /schemas/net/ethernet-controller.yaml#
  - $ref: /schemas/spi/spi-peripheral-props.yaml#
  - if:
      properties:
        compatible:
          contains:
            enum:
              - wiznet,w5500
    then:
      properties:
        interrupts:
          minItems: 1
          items:
            - description: Main interrupt (INT pin on the device).
            - description:
                Optional interrupt for link status changes (LINKLED pin on
                w5500).
    else:
      properties:
        interrupts:
          maxItems: 1
          description: Main interrupt (INT pin on the device).

unevaluatedProperties: false

examples:
  - |
    /* Example (for Raspberry Pi with pin control stuff for GPIO irq) */

    #include <dt-bindings/interrupt-controller/irq.h>

    spi {
        #address-cells = <1>;
        #size-cells = <0>;

        ethernet@0 {
            compatible = "wiznet,w5500";
            reg = <0>;
            pinctrl-names = "default";
            pinctrl-0 = <&eth1_pins>;
            interrupt-parent = <&gpio>;
            interrupts = <25 IRQ_TYPE_LEVEL_LOW>,
                         <24 IRQ_TYPE_EDGE_BOTH>;
            spi-max-frequency = <30000000>;
            local-mac-address = [ a0 b0 c0 d0 e0 f0 ];
        };
    };
...
```
