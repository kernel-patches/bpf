## Documentation/devicetree/bindings/display/panel/panel-mipi-dsi-bpf.yaml
```yaml
# SPDX-License-Identifier: (GPL-2.0-only OR BSD-2-Clause)
%YAML 1.2
---
$id: http://devicetree.org/schemas/display/panel/panel-mipi-dsi-bpf.yaml#
$schema: http://devicetree.org/meta-schemas/core.yaml#

title: Generic MIPI-DSI panel with BPF init sequences

maintainers:
  - Maxime Ripard <mripard@kernel.org>

description: |
  A generic MIPI-DSI panel driver where the panel-specific power sequencing
  and DSI init commands are provided by BPF programs.

  Panel DT nodes use a fallback compatible so the generic driver matches on
  "panel-mipi-dsi-bpf" while the first compatible identifies the specific
  panel for BPF program matching.

allOf:
  - $ref: panel-common.yaml#

properties:
  compatible:
    items:
      - description: Panel-specific compatible string
      - const: panel-mipi-dsi-bpf

  reg:
    maxItems: 1
    description: DSI virtual channel

  backlight: true
  enable-gpios: true
  height-mm: true
  port: true
  reset-gpios: true
  rotation: true
  width-mm: true

  vcc-supply:
    description: IC core supply, typically 2.8-3.3V (charge pump input)

  iovcc-supply:
    description: I/O interface supply, typically 1.8V (MIPI logic level)

  avdd-supply:
    description: Positive analog supply for source/gate driver, typically +5V

  avee-supply:
    description: Negative analog supply for source/gate driver, typically -5V

  elvdd-supply:
    description: OLED EL positive supply

  elvss-supply:
    description: OLED EL negative supply

  dsi-lanes:
    description: Number of DSI data lanes
    $ref: /schemas/types.yaml#/definitions/uint32
    enum: [1, 2, 3, 4]
    default: 4

  mode-video:
    type: boolean
    description: Use DSI video mode (as opposed to command mode)

  mode-video-burst:
    type: boolean
    description: Use DSI video burst mode

  mode-lpm:
    type: boolean
    description: Use low-power mode for DSI commands

  mode-no-eot:
    type: boolean
    description: Disable end-of-transmission packet

  clock-non-continuous:
    type: boolean
    description: DSI clock is non-continuous

  hs-rate:
    description: Maximum lane frequency for high speed mode in hertz
    $ref: /schemas/types.yaml#/definitions/uint32

  lp-rate:
    description: Maximum lane frequency for low power mode in hertz
    $ref: /schemas/types.yaml#/definitions/uint32

  panel-timing: true

required:
  - compatible
  - reg
  - panel-timing
  - port

additionalProperties: false

examples:
  - |
    #include <dt-bindings/gpio/gpio.h>

    dsi {
        #address-cells = <1>;
        #size-cells = <0>;

        panel@0 {
            compatible = "elida,kd35t133", "panel-mipi-dsi-bpf";
            reg = <0>;
            backlight = <&backlight>;
            vcc-supply = <&vcc3v3_lcd>;
            iovcc-supply = <&vcc_1v8>;
            reset-gpios = <&gpio3 13 GPIO_ACTIVE_LOW>;
            dsi-lanes = <1>;
            mode-video;
            mode-video-burst;
            mode-lpm;

            width-mm = <42>;
            height-mm = <82>;

            panel-timing {
                clock-frequency = <17000000>;
                hactive = <320>;
                vactive = <480>;
                hfront-porch = <20>;
                hsync-len = <4>;
                hback-porch = <20>;
                vfront-porch = <2>;
                vsync-len = <1>;
                vback-porch = <2>;
            };

            port {
                panel_in: endpoint {
                    remote-endpoint = <&dsi_out>;
                };
            };
        };
    };

  - |
    /* OLED panel using avdd/avee and elvdd/elvss supplies */

    dsi {
        #address-cells = <1>;
        #size-cells = <0>;

        panel@0 {
            compatible = "boe,bf060y8m-aj0", "panel-mipi-dsi-bpf";
            reg = <0>;
            vcc-supply = <&vreg_l14a>;
            iovcc-supply = <&vreg_l12a>;
            elvdd-supply = <&vreg_oled_pos>;
            elvss-supply = <&vreg_oled_neg>;
            reset-gpios = <&tlmm 6 GPIO_ACTIVE_LOW>;
            dsi-lanes = <4>;
            mode-video;

            panel-timing {
                clock-frequency = <157000000>;
                hactive = <1080>;
                vactive = <2160>;
                hfront-porch = <36>;
                hsync-len = <4>;
                hback-porch = <36>;
                vfront-porch = <4>;
                vsync-len = <4>;
                vback-porch = <4>;
            };

            port {
                oled_in: endpoint {
                    remote-endpoint = <&dsi0_out>;
                };
            };
        };
    };

...
```

## Documentation/devicetree/bindings/dpll/sitime,sit95316.yaml
```yaml
# SPDX-License-Identifier: (GPL-2.0-only OR BSD-2-Clause)
%YAML 1.2
---
$id: http://devicetree.org/schemas/dpll/sitime,sit95316.yaml#
$schema: http://devicetree.org/meta-schemas/core.yaml#

title: SiTime SiT95316/SiT95317 DPLL Clock Generator

maintainers:
  - Ali Rouhi <arouhi@sitime.com>

description: |
  SiTime SiT95316 and SiT95317 are I2C-controlled programmable clock
  generators with integrated DPLL for synchronization applications.  Both
  variants contain four PLLs with automatic/manual reference selection,
  DCO frequency adjustment, and phase offset measurement via an on-chip
  TDC (Time-to-Digital Converter).

  Both parts have 4 differential input pairs whose lanes can also be
  driven independently as single-ended references, so 8 inputs are
  individually selectable.  SiT95317 drives 8 outputs, SiT95316
  drives 12.

  Pin numbering.  An input pin's reg is its lane: 2k is INkP and 2k + 1
  is INkN, 0 to 7.  A pair the loaded configuration runs differential is
  one input, described at 2k.  An output pin's reg is its physical output
  OUTn, 0 to 11; the SiT95317 bonds out OUT0, OUT3, OUT4, OUT5, OUT7, OUT8,
  OUT9 and OUT11.

properties:
  compatible:
    enum:
      - sitime,sit95316
      - sitime,sit95317

  reg:
    maxItems: 1

  clocks:
    maxItems: 1

  clock-names:
    items:
      - const: xtal

  clock-frequency:
    description:
      XO rate in Hz feeding XIN/XO_CLK, for firmware that describes the
      oscillator as a property rather than as a clock provider, such as
      ACPI.  Use either this or "clocks", not both.

  reset-gpios:
    maxItems: 1
    description:
      GPIO connected to the chip's active-low reset pin (RESETB).

  interrupts:
    maxItems: 1
    description:
      Interrupt from the chip's active-low INTRB output.  Asserted when
      the device detects a status change such as lock acquisition or loss.

  dpll-types:
    maxItems: 4

  vdd-supply:
    description: Core supply of the PLLs, 1.8 V (the VDD pins).

  vddin-supply:
    description:
      Supply of the input receivers and dividers, 3.3 V (VDDIN).

  vdds-supply:
    description:
      Supply of the two GPIO pins that have their own rail (VDDS).  The
      SiT95316 has no such pin.

  input-pins:
    type: object
    patternProperties:
      "^pin@[0-9a-f]+$":
        type: object
        properties:
          reg:
            maximum: 7

          supported-frequencies-hz:
            maxItems: 1
            description:
              The rate wired to the input, in Hz, as a single entry.  An
              input runs at the rate the board feeds it and has no
              frequency to select, so that entry is what the pin reports
              as its frequency.

patternProperties:
  "^vddo([0-9]|1[01]|0_1|10_11)-supply$":
    description: |
      Supply of an output driver, named after its VDDO pin.  The SiT95317
      has one per output, VDDO0 to VDDO7, numbered as that part's
      datasheet numbers its outputs; in the pin numbering of this binding
      those are outputs 0, 3, 4, 5, 7, 8, 9 and 11, in that order.  The
      SiT95316 has VDDO0_1, VDDO2 to VDDO9 and VDDO10_11, the two shared
      pins each powering the pair of outputs they are named after.

required:
  - compatible
  - reg

dependencies:
  clocks: [ clock-names ]

oneOf:
  - required:
      - clocks
  - required:
      - clock-frequency

allOf:
  - $ref: /schemas/dpll/dpll-device.yaml#
  - if:
      properties:
        compatible:
          const: sitime,sit95317
    then:
      properties:
        output-pins:
          patternProperties:
            "^pin@[0-9a-f]+$":
              properties:
                reg:
                  enum: [0, 3, 4, 5, 7, 8, 9, 11]
      patternProperties:
        "^vddo(8|9|1[01]|0_1|10_11)-supply$": false
    else:
      properties:
        vdds-supply: false
        output-pins:
          patternProperties:
            "^pin@[0-9a-f]+$":
              properties:
                reg:
                  maximum: 11
      patternProperties:
        "^vddo(1[01]|[01])-supply$": false

unevaluatedProperties: false

examples:
  - |
    #include <dt-bindings/gpio/gpio.h>
    #include <dt-bindings/interrupt-controller/irq.h>

    i2c {
        #address-cells = <1>;
        #size-cells = <0>;

        dpll@68 {
            compatible = "sitime,sit95316";
            reg = <0x68>;
            clocks = <&xo2>;
            clock-names = "xtal";
            reset-gpios = <&gpio 78 GPIO_ACTIVE_LOW>;
            interrupts = <12 IRQ_TYPE_LEVEL_LOW>;
            vdd-supply = <&reg_1v8>;
            vddin-supply = <&reg_3v3>;
            vddo0_1-supply = <&reg_3v3>;
            vddo10_11-supply = <&reg_1v8>;
            dpll-types = "eec", "eec", "eec", "eec";

            input-pins {
                #address-cells = <1>;
                #size-cells = <0>;

                /* IN0P and IN0N: pair 0 runs single-ended */
                pin@0 {
                    reg = <0>;
                    label = "clkin0";
                    connection-type = "ext";
                    supported-frequencies-hz = <10000000>;
                };

                pin@1 {
                    reg = <1>;
                    label = "clkin1";
                    connection-type = "synce";
                    supported-frequencies-hz = <156250000>;
                };
            };

            output-pins {
                #address-cells = <1>;
                #size-cells = <0>;

                pin@0 {
                    reg = <0>;
                    label = "clkout0";
                    supported-frequencies-hz = <156250000>;
                };

                pin@1 {
                    reg = <1>;
                    label = "clkout1";
                    supported-frequencies-hz = <25000000>;
                };

                pin@a {
                    reg = <10>;
                    label = "clkout10";
                    supported-frequencies-hz = <10000000>;
                };
            };
        };
    };
...
```

## Documentation/devicetree/bindings/mfd/airoha,an8855.yaml
```yaml
# SPDX-License-Identifier: (GPL-2.0-only OR BSD-2-Clause)
%YAML 1.2
---
$id: http://devicetree.org/schemas/mfd/airoha,an8855.yaml#
$schema: http://devicetree.org/meta-schemas/core.yaml#

title: Airoha AN8855 Switch SoC

maintainers:
  - Christian Marangi <ansuelsmth@gmail.com>

description: >
  Airoha AN8855 Switch is a SoC that expose various peripherals like an
  Ethernet Switch, a NVMEM provider and Ethernet PHYs.

  It does also support i2c and timers but those are not currently
  supported/used.

properties:
  compatible:
    const: airoha,an8855

  reg:
    maxItems: 1

  reset-gpios:
    maxItems: 1

  efuse:
    type: object
    $ref: /schemas/nvmem/airoha,an8855-efuse.yaml
    description: EFUSE exposed by the Airoha AN8855 SoC

  ethernet-switch:
    type: object
    $ref: /schemas/net/dsa/airoha,an8855-switch.yaml
    description: Switch exposed by the Airoha AN8855 SoC

  mdio:
    type: object
    $ref: /schemas/net/mdio.yaml#
    description: MDIO exposed by the Airoha AN8855 SoC
    unevaluatedProperties: false

required:
  - compatible
  - reg
  - mdio
  - ethernet-switch

additionalProperties: false

examples:
  - |
    #include <dt-bindings/gpio/gpio.h>

    mdio {
        #address-cells = <1>;
        #size-cells = <0>;

        soc@1 {
            compatible = "airoha,an8855";
            reg = <1>;

            reset-gpios = <&pio 39 GPIO_ACTIVE_HIGH>;

            efuse {
                compatible = "airoha,an8855-efuse";

                #nvmem-cell-cells = <0>;

                nvmem-layout {
                    compatible = "fixed-layout";
                    #address-cells = <1>;
                    #size-cells = <1>;

                    shift_sel_port0_tx_a: shift-sel-port0-tx-a@c {
                       reg = <0xc 0x4>;
                    };

                    shift_sel_port0_tx_b: shift-sel-port0-tx-b@10 {
                        reg = <0x10 0x4>;
                    };

                    shift_sel_port0_tx_c: shift-sel-port0-tx-c@14 {
                        reg = <0x14 0x4>;
                    };

                    shift_sel_port0_tx_d: shift-sel-port0-tx-d@18 {
                       reg = <0x18 0x4>;
                    };

                    shift_sel_port1_tx_a: shift-sel-port1-tx-a@1c {
                        reg = <0x1c 0x4>;
                    };

                    shift_sel_port1_tx_b: shift-sel-port1-tx-b@20 {
                        reg = <0x20 0x4>;
                    };

                    shift_sel_port1_tx_c: shift-sel-port1-tx-c@24 {
                       reg = <0x24 0x4>;
                    };

                    shift_sel_port1_tx_d: shift-sel-port1-tx-d@28 {
                        reg = <0x28 0x4>;
                    };
                };
            };

            ethernet-switch {
                compatible = "airoha,an8855-switch";

                ports {
                    #address-cells = <1>;
                    #size-cells = <0>;

                    port@0 {
                        reg = <0>;
                        label = "lan1";
                        phy-mode = "internal";
                        phy-handle = <&internal_phy1>;
                    };

                    port@1 {
                        reg = <1>;
                        label = "lan2";
                        phy-mode = "internal";
                        phy-handle = <&internal_phy2>;
                    };

                    port@5 {
                        reg = <5>;
                        label = "cpu";
                        ethernet = <&gmac0>;
                        phy-mode = "2500base-x";

                        fixed-link {
                            speed = <2500>;
                            full-duplex;
                            pause;
                        };
                    };
                };
            };

            mdio {
                #address-cells = <1>;
                #size-cells = <0>;

                internal_phy1: ethernet-phy@1 {
                  compatible = "ethernet-phy-idc0ff.0410",
                               "ethernet-phy-ieee802.3-c22";
                  reg = <1>;

                  nvmem-cells = <&shift_sel_port0_tx_a>,
                      <&shift_sel_port0_tx_b>,
                      <&shift_sel_port0_tx_c>,
                      <&shift_sel_port0_tx_d>;
                  nvmem-cell-names = "tx_a", "tx_b", "tx_c", "tx_d";
                };

                internal_phy2: ethernet-phy@2 {
                  compatible = "ethernet-phy-idc0ff.0410",
                               "ethernet-phy-ieee802.3-c22";
                  reg = <2>;

                  nvmem-cells = <&shift_sel_port1_tx_a>,
                      <&shift_sel_port1_tx_b>,
                      <&shift_sel_port1_tx_c>,
                      <&shift_sel_port1_tx_d>;
                  nvmem-cell-names = "tx_a", "tx_b", "tx_c", "tx_d";
                };
            };
        };
    };
```
