## Documentation/devicetree/bindings/net/can/fsl,mpc5xxx-mscan.yaml
```yaml
# SPDX-License-Identifier: (GPL-2.0-only OR BSD-2-Clause)
%YAML 1.2
---
$id: http://devicetree.org/schemas/net/can/fsl,mpc5xxx-mscan.yaml#
$schema: http://devicetree.org/meta-schemas/core.yaml#

title: Freescale MPC5xxx MSCAN controller

maintainers:
  - Marc Kleine-Budde <mkl@pengutronix.de>

description:
  The MSCAN controller found on the Freescale MPC5200 and MPC5121 SoCs. The
  MPC5121 Rev. 1 processor is not supported.

properties:
  compatible:
    oneOf:
      - items:
          - enum:
              - fsl,mpc5200b-mscan
          - const: fsl,mpc5200-mscan
      - enum:
          - fsl,mpc5200-mscan
          - fsl,mpc5121-mscan

  reg:
    maxItems: 1

  interrupts:
    maxItems: 1

  clocks:
    description:
      Clocks feeding the controller. fsl,mpc5200-mscan takes its frequency
      from the CDM block and does not use DT clocks.
    minItems: 5
    maxItems: 5

  clock-names:
    items:
      - const: ipg
      - const: ips
      - const: sys
      - const: ref
      - const: mclk

  fsl,mscan-clock-source:
    description:
      Clock source used for the controller. When the property is not present,
      fsl,mpc5200-mscan uses the reference clock, while fsl,mpc5121-mscan
      selects an optimal clock source and frequency based on the system clock
      and uses the reference clock when that is not possible.
    enum: [ip, ref, sys]

  fsl,mscan-clock-divider:
    description: Additional clock divider for the reference and system clocks.
    $ref: /schemas/types.yaml#/definitions/uint32
    minimum: 1
    default: 1

required:
  - compatible
  - reg
  - interrupts

allOf:
  - $ref: can-controller.yaml#

  - if:
      properties:
        compatible:
          contains:
            const: fsl,mpc5200-mscan
    then:
      properties:
        fsl,mscan-clock-source:
          enum: [ip, ref]

  - if:
      properties:
        compatible:
          contains:
            const: fsl,mpc5121-mscan
    then:
      required:
        - clocks
        - clock-names

unevaluatedProperties: false

examples:
  - |
    #include <dt-bindings/clock/mpc512x-clock.h>
    #include <dt-bindings/interrupt-controller/irq.h>

    can@1300 {
        compatible = "fsl,mpc5121-mscan";
        reg = <0x1300 0x80>;
        interrupts = <12 IRQ_TYPE_LEVEL_LOW>;
        interrupt-parent = <&ipic>;
        clocks = <&clks MPC512x_CLK_BDLC>, <&clks MPC512x_CLK_IPS>,
                 <&clks MPC512x_CLK_SYS>, <&clks MPC512x_CLK_REF>,
                 <&clks MPC512x_CLK_MSCAN0_MCLK>;
        clock-names = "ipg", "ips", "sys", "ref", "mclk";
        fsl,mscan-clock-source = "ref";
        fsl,mscan-clock-divider = <3>;
    };
...
```

## Documentation/devicetree/bindings/net/can/holt,hi311x.yaml
```yaml
# SPDX-License-Identifier: (GPL-2.0-only OR BSD-2-Clause)
%YAML 1.2
---
$id: http://devicetree.org/schemas/net/can/holt,hi311x.yaml#
$schema: http://devicetree.org/meta-schemas/core.yaml#

title: Holt HI-311X stand-alone CAN controller

maintainers:
  - Marc Kleine-Budde <mkl@pengutronix.de>

description:
  The Holt HI-3110 is a stand-alone CAN controller with an SPI interface.

allOf:
  - $ref: can-controller.yaml#
  - $ref: /schemas/spi/spi-peripheral-props.yaml#

properties:
  compatible:
    const: holt,hi3110

  reg:
    description: SPI chip select.
    maxItems: 1

  clocks:
    description: The clock feeding the CAN controller.
    maxItems: 1

  interrupts:
    description: IRQ line for the CAN controller.
    maxItems: 1

  vdd-supply:
    description: Regulator that powers the CAN controller.

  xceiver-supply:
    description: Regulator that powers the CAN transceiver.

required:
  - compatible
  - reg
  - clocks
  - interrupts

unevaluatedProperties: false

examples:
  - |
    #include <dt-bindings/interrupt-controller/irq.h>

    spi {
        #address-cells = <1>;
        #size-cells = <0>;

        can@1 {
            compatible = "holt,hi3110";
            reg = <1>;
            clocks = <&clk32m>;
            interrupt-parent = <&gpio4>;
            interrupts = <13 IRQ_TYPE_LEVEL_HIGH>;
            vdd-supply = <&reg5v0>;
            xceiver-supply = <&reg5v0>;
        };
    };
...
```

## Documentation/devicetree/bindings/net/can/ifi,canfd.yaml
```yaml
# SPDX-License-Identifier: (GPL-2.0-only OR BSD-2-Clause)
%YAML 1.2
---
$id: http://devicetree.org/schemas/net/can/ifi,canfd.yaml#
$schema: http://devicetree.org/meta-schemas/core.yaml#

title: IFI CAN-FD Controller

maintainers:
  - Marc Kleine-Budde <mkl@pengutronix.de>

description:
  The I/F/I CAN-FD soft IP block connected to the platform bus. It is most
  often synthesised into an FPGA or CPLD.

allOf:
  - $ref: can-controller.yaml#

properties:
  compatible:
    const: ifi,canfd-1.0

  reg:
    maxItems: 1

  interrupts:
    maxItems: 1

required:
  - compatible
  - reg
  - interrupts

unevaluatedProperties: false

examples:
  - |
    #include <dt-bindings/interrupt-controller/arm-gic.h>
    #include <dt-bindings/interrupt-controller/irq.h>

    can@ff220000 {
        compatible = "ifi,canfd-1.0";
        reg = <0xff220000 0x1000>;
        interrupts = <GIC_SPI 43 IRQ_TYPE_NONE>;
    };
...
```

## Documentation/devicetree/bindings/net/dsa/airoha,an8855-switch.yaml
```yaml
# SPDX-License-Identifier: (GPL-2.0-only OR BSD-2-Clause)
%YAML 1.2
---
$id: http://devicetree.org/schemas/net/dsa/airoha,an8855-switch.yaml#
$schema: http://devicetree.org/meta-schemas/core.yaml#

title: Airoha AN8855 Gigabit Switch

maintainers:
  - Christian Marangi <ansuelsmth@gmail.com>

description: >
  Airoha AN8855 is a 5-port Gigabit Switch.

  It does expose the 5 Internal PHYs on the MDIO bus and each port
  can access the Switch register space by configuring the PHY page.

$ref: dsa.yaml#/$defs/ethernet-ports

properties:
  compatible:
    const: airoha,an8855-switch

required:
  - compatible

unevaluatedProperties: false

examples:
  - |
    ethernet-switch {
        compatible = "airoha,an8855-switch";

        ports {
            #address-cells = <1>;
            #size-cells = <0>;

            port@0 {
                reg = <0>;
                label = "lan1";
                phy-mode = "internal";
                phy-handle = <&internal_phy1>;
            };

            port@1 {
                reg = <1>;
                label = "lan2";
                phy-mode = "internal";
                phy-handle = <&internal_phy2>;
            };

            port@2 {
                reg = <2>;
                label = "lan3";
                phy-mode = "internal";
                phy-handle = <&internal_phy3>;
            };

            port@3 {
                reg = <3>;
                label = "lan4";
                phy-mode = "internal";
                phy-handle = <&internal_phy4>;
            };

            port@4 {
                reg = <4>;
                label = "wan";
                phy-mode = "internal";
                phy-handle = <&internal_phy5>;
            };

            port@5 {
                reg = <5>;
                label = "cpu";
                ethernet = <&gmac0>;
                phy-mode = "2500base-x";

                fixed-link {
                    speed = <2500>;
                    full-duplex;
                    pause;
                };
            };
        };
    };
```

## Documentation/devicetree/bindings/net/dsa/microchip,lan96455s-switch.yaml
```yaml
# SPDX-License-Identifier: GPL-2.0-only OR BSD-2-Clause
%YAML 1.2
---
$id: http://devicetree.org/schemas/net/dsa/microchip,lan96455s-switch.yaml#
$schema: http://devicetree.org/meta-schemas/core.yaml#

title: Microchip LAN9645x Ethernet switch

maintainers:
  - Jens Emil Schulz Østergaard <jensemil.schulzostergaard@microchip.com>

description: |
  The LAN9645x switch is a multi-port Gigabit AVB/TSN Ethernet switch with
  five integrated 10/100/1000Base-T PHYs. In addition to the integrated PHYs,
  it supports up to 2 RGMII/RMII, up to 2 BASE-X/SERDES/2.5GBASE-X and one
  Quad-SGMII interfaces.

  The part number encodes the SKU. The last digit is the number of usable
  front ports, 5, 7 or 9. The letter is the feature set, f for full and s for
  standard, where full adds HSR, PRP, TAS, frame preemption and PSFP.

properties:
  compatible:
    oneOf:
      - enum:
          - microchip,lan96455s-switch
      - items:
          - enum:
              - microchip,lan96455f-switch
              - microchip,lan96457f-switch
              - microchip,lan96459f-switch
              - microchip,lan96457s-switch
              - microchip,lan96459s-switch
          - const: microchip,lan96455s-switch

  reg:
    items:
      - description: General configuration block target
      - description:
          CPU device queue system target, the register based frame injection
          and extraction interface
      - description: Chip top level target
      - description: Rewriter target
      - description: Switching engine target
      - description: HSIO target
      - description: Port 0 device target
      - description: Port 1 device target
      - description: Port 2 device target
      - description: Port 3 device target
      - description: Port 4 device target
      - description: Port 5 device target
      - description: Port 6 device target
      - description: Port 7 device target
      - description: Port 8 device target
      - description: Queue system target
      - description: Analyzer target

  reg-names:
    items:
      - const: gcb
      - const: qs
      - const: chip_top
      - const: rew
      - const: sys
      - const: hsio
      - const: dev0
      - const: dev1
      - const: dev2
      - const: dev3
      - const: dev4
      - const: dev5
      - const: dev6
      - const: dev7
      - const: dev8
      - const: qsys
      - const: ana

  ethernet-ports:
    type: object
    additionalProperties: true
    patternProperties:
      "^(ethernet-)?port@[0-8]$":
        type: object
        description: Ethernet switch ports
        additionalProperties: true

        allOf:
          - if:
              properties:
                phy-mode:
                  contains:
                    enum:
                      - rgmii
                      - rgmii-rxid
                      - rgmii-txid
                      - rgmii-id
            then:
              properties:
                rx-internal-delay-ps:
                  $ref: "#/$defs/internal-delay-ps"
                tx-internal-delay-ps:
                  $ref: "#/$defs/internal-delay-ps"

$ref: dsa.yaml#/$defs/ethernet-ports

required:
  - compatible
  - reg
  - reg-names
  - ethernet-ports

unevaluatedProperties: false

$defs:
  internal-delay-ps:
    description:
      Disable the delay line using 0 ps, or enable the 2000 ps delay. The
      delay line is not tunable, so no other phase can be selected.
    enum: [0, 2000]
    default: 0

examples:
  - |
    ethernet-switch@4000 {
        compatible = "microchip,lan96459f-switch", "microchip,lan96455s-switch";
        reg = <0x4000 0x244>, <0x8000 0x4c>, <0x10000 0x134>,
              <0x18000 0x1910>, <0x2c000 0x12d4>, <0x30000 0xe4>,
              <0x38000 0xb8>, <0x3c000 0xb8>, <0x40000 0xb8>,
              <0x44000 0xb8>, <0x48000 0xb8>, <0x4c000 0xb8>,
              <0x50000 0xb8>, <0x54000 0xb8>, <0x58000 0xb8>,
              <0x100000 0xa000>, <0x140000 0x7468>;
        reg-names = "gcb", "qs", "chip_top", "rew", "sys", "hsio", "dev0",
                    "dev1", "dev2", "dev3", "dev4", "dev5", "dev6", "dev7",
                    "dev8", "qsys", "ana";

        ethernet-ports {
            #address-cells = <1>;
            #size-cells = <0>;

            ethernet-port@0 {
                reg = <0>;
                phy-handle = <&cuphy0>;
                phy-mode = "gmii";
            };

            ethernet-port@1 {
                reg = <1>;
                phy-handle = <&cuphy1>;
                phy-mode = "gmii";
            };

            ethernet-port@2 {
                reg = <2>;
                phy-handle = <&cuphy2>;
                phy-mode = "gmii";
            };

            ethernet-port@3 {
                reg = <3>;
                phy-handle = <&cuphy3>;
                phy-mode = "gmii";
            };

            ethernet-port@7 {
                reg = <7>;
                ethernet = <&cpu_host_port>;
                phy-mode = "rgmii";

                fixed-link {
                    full-duplex;
                    pause;
                    speed = <1000>;
                };
            };
        };
    };
...
```
