## Documentation/devicetree/bindings/net/allwinner,sun8i-a83t-emac.yaml
```yaml
# SPDX-License-Identifier: GPL-2.0
%YAML 1.2
---
$id: http://devicetree.org/schemas/net/allwinner,sun8i-a83t-emac.yaml#
$schema: http://devicetree.org/meta-schemas/core.yaml#

title: Allwinner A83t EMAC

maintainers:
  - Chen-Yu Tsai <wens@csie.org>
  - Maxime Ripard <mripard@kernel.org>

# We need a select here so we don't match all nodes with 'snps,dwmac'
select:
  properties:
    compatible:
      contains:
        enum:
          - allwinner,sun8i-a83t-emac
          - allwinner,sun8i-h3-emac
          - allwinner,sun8i-r40-gmac
          - allwinner,sun8i-v3s-emac
          - allwinner,sun50i-a64-emac
          - allwinner,sun55i-a523-gmac200
          - allwinner,sun60i-a733-gmac210
  required:
    - compatible

properties:
  compatible:
    oneOf:
      - const: allwinner,sun8i-a83t-emac
      - const: allwinner,sun8i-h3-emac
      - const: allwinner,sun8i-r40-gmac
      - const: allwinner,sun8i-v3s-emac
      - const: allwinner,sun50i-a64-emac
      - items:
          - enum:
              - allwinner,sun20i-d1-emac
              - allwinner,sun50i-a100-emac
              - allwinner,sun50i-h6-emac
              - allwinner,sun50i-h616-emac0
              - allwinner,sun55i-a523-gmac0
          - const: allwinner,sun50i-a64-emac
      - items:
          - const: allwinner,sun55i-a523-gmac200
          - const: snps,dwmac-4.20a
      - items:
          - const: allwinner,sun60i-a733-gmac210
          - const: snps,dwmac-5.20

  reg:
    minItems: 1
    items:
      - description: MAC controller registers
      - description: Glue configuration registers

  interrupts:
    minItems: 1
    maxItems: 4

  interrupt-names:
    minItems: 1
    items:
      - const: macirq
      - const: eth_lpi
      - const: tx-queue-0
      - const: rx-queue-0

  clocks:
    minItems: 1
    maxItems: 3

  clock-names:
    minItems: 1
    items:
      - const: stmmaceth
      - const: mbus
      - const: ptp_ref

  phy-supply:
    description: PHY regulator

  power-domains:
    maxItems: 1

  syscon:
    $ref: /schemas/types.yaml#/definitions/phandle
    description:
      Phandle to the device containing the EMAC or GMAC clock
      register

required:
  - compatible
  - reg
  - interrupts
  - interrupt-names
  - clocks
  - clock-names
  - resets
  - reset-names
  - phy-handle
  - phy-mode

allOf:
  - $ref: snps,dwmac.yaml#
  - if:
      properties:
        compatible:
          contains:
            enum:
              - allwinner,sun8i-a83t-emac
              - allwinner,sun8i-h3-emac
              - allwinner,sun8i-v3s-emac
              - allwinner,sun50i-a64-emac

    then:
      properties:
        allwinner,tx-delay-ps:
          default: 0
          minimum: 0
          maximum: 700
          multipleOf: 100
          description:
            External RGMII PHY TX clock delay chain value in ps.

        allwinner,rx-delay-ps:
          default: 0
          minimum: 0
          maximum: 3100
          multipleOf: 100
          description:
            External RGMII PHY TX clock delay chain value in ps.

  - if:
      properties:
        compatible:
          contains:
            enum:
              - allwinner,sun8i-r40-gmac

    then:
      properties:
        allwinner,rx-delay-ps:
          default: 0
          minimum: 0
          maximum: 700
          multipleOf: 100
          description:
            External RGMII PHY TX clock delay chain value in ps.

  - if:
      properties:
        compatible:
          contains:
            enum:
              - allwinner,sun8i-h3-emac
              - allwinner,sun8i-v3s-emac

    then:
      properties:
        allwinner,leds-active-low:
          $ref: /schemas/types.yaml#/definitions/flag
          description:
            EPHY LEDs are active low.

        mdio-mux:
          type: object
          unevaluatedProperties: false

          properties:
            compatible:
              const: allwinner,sun8i-h3-mdio-mux

            mdio-parent-bus:
              $ref: /schemas/types.yaml#/definitions/phandle
              description:
                Phandle to EMAC MDIO.

            "#address-cells":
              const: 1

            "#size-cells":
              const: 0

            mdio@1:
              $ref: mdio.yaml#
              unevaluatedProperties: false
              description: Internal MDIO Bus

              properties:
                compatible:
                  const: allwinner,sun8i-h3-mdio-internal

                reg:
                  const: 1

              patternProperties:
                "^ethernet-phy@[0-9a-f]$":
                  type: object
                  $ref: ethernet-phy.yaml#
                  unevaluatedProperties: false
                  description:
                    Integrated PHY node

                  properties:
                    clocks:
                      maxItems: 1

                    resets:
                      maxItems: 1

                  required:
                    - clocks
                    - resets

            mdio@2:
              $ref: mdio.yaml#
              unevaluatedProperties: false
              description: External MDIO Bus (H3 only)

              properties:
                reg:
                  const: 2

          required:
            - compatible
            - mdio-parent-bus
            - mdio@1

  - if:
      properties:
        compatible:
          contains:
            enum:
              - allwinner,sun55i-a523-gmac200
              - allwinner,sun60i-a733-gmac210
    then:
      properties:
        tx-internal-delay-ps:
          default: 0
          minimum: 0
          multipleOf: 100
          description:
            Internal RGMII PHY TX clock delay chain value in ps.
        rx-internal-delay-ps:
          default: 0
          minimum: 0
          maximum: 3100
          multipleOf: 100
          description:
            Internal RGMII PHY RX clock delay chain value in ps.
    else:
      properties:
        reg:
          maxItems: 1
        interrupts:
          maxItems: 1
        interrupt-names:
          maxItems: 1
        clocks:
          maxItems: 1
        clock-names:
          maxItems: 1
        power-domains: false
      required:
        - syscon

  - if:
      properties:
        compatible:
          contains:
            const: allwinner,sun55i-a523-gmac200
    then:
      properties:
        reg:
          maxItems: 1
        interrupts:
          maxItems: 1
        interrupt-names:
          maxItems: 1
        clocks:
          minItems: 2
          maxItems: 2
        clock-names:
          minItems: 2
          maxItems: 2
        resets:
          maxItems: 1
        reset-names:
          maxItems: 1
        tx-internal-delay-ps:
          maximum: 700
      required:
        - power-domains
        - syscon

  - if:
      properties:
        compatible:
          contains:
            const: allwinner,sun60i-a733-gmac210
    then:
      properties:
        reg:
          minItems: 2
        interrupts:
          minItems: 4
        interrupt-names:
          minItems: 4
        clocks:
          minItems: 3
        clock-names:
          minItems: 3
        resets:
          minItems: 2
        reset-names:
          minItems: 2
        tx-internal-delay-ps:
          maximum: 3100
        syscon: false
        power-domains: false

unevaluatedProperties: false

examples:
  - |
    ethernet@1c0b000 {
        compatible = "allwinner,sun8i-h3-emac";
        syscon = <&syscon>;
        reg = <0x01c0b000 0x104>;
        interrupts = <0 82 1>;
        interrupt-names = "macirq";
        resets = <&ccu 12>;
        reset-names = "stmmaceth";
        clocks = <&ccu 27>;
        clock-names = "stmmaceth";

        phy-handle = <&int_mii_phy>;
        phy-mode = "mii";
        allwinner,leds-active-low;

        mdio1: mdio {
            #address-cells = <1>;
            #size-cells = <0>;
            compatible = "snps,dwmac-mdio";
        };

        mdio-mux {
            compatible = "allwinner,sun8i-h3-mdio-mux";
            #address-cells = <1>;
            #size-cells = <0>;

            mdio-parent-bus = <&mdio1>;

            int_mii_phy: mdio@1 {
                compatible = "allwinner,sun8i-h3-mdio-internal";
                reg = <1>;
                #address-cells = <1>;
                #size-cells = <0>;

                ethernet-phy@1 {
                    reg = <1>;
                    clocks = <&ccu 67>;
                    resets = <&ccu 39>;
                    phy-is-integrated;
                };
            };

            mdio@2 {
                reg = <2>;
                #address-cells = <1>;
                #size-cells = <0>;
            };
        };
    };

  - |
    ethernet@1c0b000 {
        compatible = "allwinner,sun8i-h3-emac";
        syscon = <&syscon>;
        reg = <0x01c0b000 0x104>;
        interrupts = <0 82 1>;
        interrupt-names = "macirq";
        resets = <&ccu 12>;
        reset-names = "stmmaceth";
        clocks = <&ccu 27>;
        clock-names = "stmmaceth";

        phy-handle = <&ext_rgmii_phy>;
        phy-mode = "rgmii";
        allwinner,leds-active-low;

        mdio2: mdio {
            #address-cells = <1>;
            #size-cells = <0>;
            compatible = "snps,dwmac-mdio";
        };

        mdio-mux {
            compatible = "allwinner,sun8i-h3-mdio-mux";
            #address-cells = <1>;
            #size-cells = <0>;
            mdio-parent-bus = <&mdio2>;

            mdio@1 {
                compatible = "allwinner,sun8i-h3-mdio-internal";
                reg = <1>;
                #address-cells = <1>;
                #size-cells = <0>;

                ethernet-phy@1 {
                    reg = <1>;
                    clocks = <&ccu 67>;
                    resets = <&ccu 39>;
                };
            };

            mdio@2 {
                reg = <2>;
                #address-cells = <1>;
                #size-cells = <0>;

                ext_rgmii_phy: ethernet-phy@1 {
                    reg = <1>;
                };
            };
        };
    };

  - |
    ethernet@1c0b000 {
        compatible = "allwinner,sun8i-a83t-emac";
        syscon = <&syscon>;
        reg = <0x01c0b000 0x104>;
        interrupts = <0 82 1>;
        interrupt-names = "macirq";
        resets = <&ccu 13>;
        reset-names = "stmmaceth";
        clocks = <&ccu 27>;
        clock-names = "stmmaceth";
        phy-handle = <&ext_rgmii_phy1>;
        phy-mode = "rgmii";

        mdio {
            compatible = "snps,dwmac-mdio";
            #address-cells = <1>;
            #size-cells = <0>;

            ext_rgmii_phy1: ethernet-phy@1 {
                reg = <1>;
            };
        };
    };

  - |
    ethernet@4510000 {
        compatible = "allwinner,sun55i-a523-gmac200",
                     "snps,dwmac-4.20a";
        reg = <0x04510000 0x10000>;
        clocks = <&ccu 117>, <&ccu 79>;
        clock-names = "stmmaceth", "mbus";
        resets = <&ccu 43>;
        reset-names = "stmmaceth";
        interrupts = <0 47 4>;
        interrupt-names = "macirq";
        pinctrl-names = "default";
        pinctrl-0 = <&rgmii1_pins>;
        power-domains = <&pck600 4>;
        syscon = <&syscon>;
        phy-handle = <&ext_rgmii_phy_1>;
        phy-mode = "rgmii-id";
        snps,fixed-burst;
        snps,axi-config = <&gmac1_stmmac_axi_setup>;

        mdio {
            compatible = "snps,dwmac-mdio";
            #address-cells = <1>;
            #size-cells = <0>;

            ext_rgmii_phy_1: ethernet-phy@1 {
                reg = <1>;
            };
        };
    };

  - |
    ethernet@4510000 {
        compatible = "allwinner,sun60i-a733-gmac210",
                     "snps,dwmac-5.20";
        reg = <0x04510000 0x8000>,
              <0x04518000 0x1000>;
        clocks = <&ccu 58>, <&ccu 59>, <&ccu 60>;
        clock-names = "stmmaceth", "mbus", "ptp_ref";
        resets = <&ccu 30>, <&ccu 31>;
        reset-names = "stmmaceth", "ahb";
        interrupts = <0 175 4>, <0 179 4>, <0 176 4>, <0 177 4>;
        interrupt-names = "macirq", "eth_lpi", "tx-queue-0", "rx-queue-0";
        pinctrl-names = "default";
        pinctrl-0 = <&rgmii1_pins>;
        phy-handle = <&ext_rgmii_phy_2>;
        phy-mode = "rgmii-id";
        snps,fixed-burst;

        mdio {
            compatible = "snps,dwmac-mdio";
            #address-cells = <1>;
            #size-cells = <0>;

            ext_rgmii_phy_2: ethernet-phy@1 {
                reg = <1>;
            };
        };
    };
...
```
