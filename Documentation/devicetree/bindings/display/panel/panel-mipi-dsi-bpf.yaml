## Documentation/devicetree/bindings/net/amlogic,meson-dwmac.yaml
```yaml
# SPDX-License-Identifier: (GPL-2.0 OR BSD-2-Clause)
# Copyright 2019 BayLibre, SAS
%YAML 1.2
---
$id: http://devicetree.org/schemas/net/amlogic,meson-dwmac.yaml#
$schema: http://devicetree.org/meta-schemas/core.yaml#

title: Amlogic Meson DWMAC Ethernet controller

maintainers:
  - Neil Armstrong <neil.armstrong@linaro.org>
  - Martin Blumenstingl <martin.blumenstingl@googlemail.com>

# We need a select here so we don't match all nodes with 'snps,dwmac'
select:
  properties:
    compatible:
      contains:
        enum:
          - amlogic,meson6-dwmac
          - amlogic,meson8b-dwmac
          - amlogic,meson8m2-dwmac
          - amlogic,meson-gxbb-dwmac
          - amlogic,meson-axg-dwmac
          - amlogic,meson-g12a-dwmac
          - amlogic,t7-dwmac
  required:
    - compatible

allOf:
  - $ref: snps,dwmac.yaml#
  - if:
      properties:
        compatible:
          contains:
            enum:
              - amlogic,meson8b-dwmac
              - amlogic,meson8m2-dwmac
              - amlogic,meson-gxbb-dwmac
              - amlogic,meson-axg-dwmac
              - amlogic,meson-g12a-dwmac

    then:
      properties:
        clocks:
          minItems: 3
          items:
            - description: GMAC main clock
            - description: First parent clock of the internal mux
            - description: Second parent clock of the internal mux
            - description: The clock which drives the timing adjustment logic

        clock-names:
          minItems: 3
          items:
            - const: stmmaceth
            - const: clkin0
            - const: clkin1
            - const: timing-adjustment

        amlogic,tx-delay-ns:
          enum: [0, 2, 4, 6]
          default: 2
          description:
            The internal RGMII TX clock delay (provided by this driver)
            in nanoseconds. When phy-mode is set to "rgmii" then the TX
            delay should be explicitly configured. When the phy-mode is
            set to either "rgmii-id" or "rgmii-txid" the TX clock delay
            is already provided by the PHY. In that case this property
            should be set to 0ns (which disables the TX clock delay in
            the MAC to prevent the clock from going off because both
            PHY and MAC are adding a delay). Any configuration is
            ignored when the phy-mode is set to "rmii".

        amlogic,rx-delay-ns:
          deprecated: true
          enum:
            - 0
            - 2
          default: 0
          description:
            The internal RGMII RX clock delay in nanoseconds. Deprecated, use
            rx-internal-delay-ps instead.

        rx-internal-delay-ps:
          default: 0

  - if:
      properties:
        compatible:
          contains:
            const: amlogic,t7-dwmac
    then:
      properties:
        clocks:
          items:
            - description: GMAC main clock
            - description: First parent clock of the internal mux
            - description: Second parent clock of the internal mux
            - description:
                clock of the pipeline stage inserted in the bus path between
                the controller and the DRAM. Without it, the controller cannot
                complete DMA transfers.
            - description:
                clock of the register block holding PRG_ETH0 and PRG_ETH1.
                Without it, the block reads as zero and ignores writes.

        clock-names:
          items:
            - const: stmmaceth
            - const: clkin0
            - const: clkin1
            - const: pipeline
            - const: pclk

        # The PHY adds the 2ns RGMII delays, see ethernet-controller.yaml.
        # The RX delay line of this glue is fine tuning in 200ps steps,
        # added on top of what phy-mode describes. The TX side has no fine
        # tuning: its only step is a quarter of the clock period, the full
        # 2ns at 1Gbit/s, so the TX property is not accepted.
        rx-internal-delay-ps:
          default: 0

        tx-internal-delay-ps: false

        # Deprecated: new SoCs use the standard *-internal-delay-ps
        # properties instead.
        amlogic,tx-delay-ns: false
        amlogic,rx-delay-ns: false

  - if:
      properties:
        compatible:
          contains:
            enum:
              - amlogic,meson8b-dwmac
              - amlogic,meson8m2-dwmac
              - amlogic,meson-gxbb-dwmac
              - amlogic,meson-axg-dwmac
    then:
      properties:
        rx-internal-delay-ps:
          enum:
            - 0
            - 2000

  - if:
      properties:
        compatible:
          contains:
            enum:
              - amlogic,meson-g12a-dwmac
              - amlogic,t7-dwmac
    then:
      properties:
        rx-internal-delay-ps:
          enum:
            - 0
            - 200
            - 400
            - 600
            - 800
            - 1000
            - 1200
            - 1400
            - 1600
            - 1800
            - 2000
            - 2200
            - 2400
            - 2600
            - 2800
            - 3000

properties:
  compatible:
    oneOf:
      - items:
          - enum:
              - amlogic,meson8b-dwmac
              - amlogic,meson8m2-dwmac
              - amlogic,meson-gxbb-dwmac
              - amlogic,meson-axg-dwmac
              - amlogic,meson-g12a-dwmac
          - const: snps,dwmac-3.70a
          - const: snps,dwmac
      - items:
          - const: amlogic,meson6-dwmac
          - const: snps,dwmac
      - items:
          - const: amlogic,t7-dwmac
          - const: snps,dwmac-5.10a
          - const: snps,dwmac

  reg:
    items:
      - description:
          The first register range should be the one of the DWMAC controller
      - description:
          The second range is for the Amlogic specific configuration
          (for example the PRG_ETHERNET register range on Meson8b and newer)

  interrupts:
    maxItems: 1

  interrupt-names:
    const: macirq

  power-domains:
    maxItems: 1

required:
  - compatible
  - reg
  - interrupts
  - interrupt-names
  - clocks
  - clock-names
  - phy-mode

unevaluatedProperties: false

examples:
  - |
    ethmac: ethernet@c9410000 {
        compatible = "amlogic,meson-gxbb-dwmac", "snps,dwmac-3.70a", "snps,dwmac";
        reg = <0xc9410000 0x10000>, <0xc8834540 0x8>;
        interrupts = <8>;
        interrupt-names = "macirq";
        clocks = <&clk_eth>, <&clk_fclk_div2>, <&clk_mpll2>, <&clk_fclk_div2>;
        clock-names = "stmmaceth", "clkin0", "clkin1", "timing-adjustment";
        phy-mode = "rgmii";
    };
```

## Documentation/devicetree/bindings/net/amlogic,t7-dwmac.yaml
```yaml
# SPDX-License-Identifier: (GPL-2.0-only OR BSD-2-Clause)
%YAML 1.2
---
$id: http://devicetree.org/schemas/net/amlogic,t7-dwmac.yaml#
$schema: http://devicetree.org/meta-schemas/core.yaml#

title: Amlogic T7 DWMAC Ethernet controller

maintainers:
  - Lucas Tanure <tanure@linux.com>

# The select keeps this schema from matching every "snps,dwmac-5.10a" node.
select:
  properties:
    compatible:
      contains:
        const: amlogic,t7-dwmac
  required:
    - compatible

allOf:
  - $ref: snps,dwmac.yaml#

properties:
  compatible:
    items:
      - const: amlogic,t7-dwmac
      - const: snps,dwmac-5.10a

  reg:
    items:
      - description: registers of the DWMAC controller
      - description: the glue registers PRG_ETH0 and PRG_ETH1

  interrupts:
    maxItems: 1

  interrupt-names:
    const: macirq

  clocks:
    items:
      - description: GMAC main clock
      - description: First parent clock of the internal mux
      - description: Second parent clock of the internal mux
      - description:
          clock of the pipeline stage inserted in the bus path between
          the controller and the DRAM. Without it, the controller cannot
          complete DMA transfers.
      - description:
          APB clock of the glue registers PRG_ETH0 and PRG_ETH1.
          Without it, they read as zero and ignore writes.

  clock-names:
    items:
      - const: stmmaceth
      - const: clkin0
      - const: clkin1
      - const: pipeline
      - const: pclk

  power-domains:
    maxItems: 1

  rx-internal-delay-ps:
    description:
      Fine tuning of the RX clock, added on top of the delays that
      phy-mode describes. The PHY adds the 2ns RGMII delays, see
      ethernet-controller.yaml.
    default: 0
    maximum: 3000
    multipleOf: 200

  # The TX clock has no fine tuning, its only step is a quarter of the
  # clock period, the full 2ns at 1Gbit/s. The PHY adds the TX delay, so
  # the property is not accepted.
  tx-internal-delay-ps: false

required:
  - compatible
  - reg
  - interrupts
  - interrupt-names
  - clocks
  - clock-names
  - phy-mode

unevaluatedProperties: false

examples:
  - |
    #include <dt-bindings/interrupt-controller/arm-gic.h>
    #include <dt-bindings/interrupt-controller/irq.h>
    #include <dt-bindings/clock/amlogic,t7-peripherals-clkc.h>
    #include <dt-bindings/clock/amlogic,t7-pll-clkc.h>
    #include <dt-bindings/clock/amlogic,t7-scmi.h>
    #include <dt-bindings/power/amlogic,t7-pwrc.h>

    ethernet@fdc00000 {
        compatible = "amlogic,t7-dwmac", "snps,dwmac-5.10a";
        reg = <0xfdc00000 0x10000>, <0xfe024000 0x8>;
        interrupts = <GIC_SPI 74 IRQ_TYPE_LEVEL_HIGH>;
        interrupt-names = "macirq";
        clocks = <&clkc_periphs CLKID_SYS_ETH>,
                 <&scmi_clk CLKID_FCLK_DIV2>,
                 <&mpll CLKID_MPLL2>,
                 <&clkc_periphs CLKID_SYS_AMPIPE_ETH>,
                 <&clkc_periphs CLKID_SYS_ETHPHY>;
        clock-names = "stmmaceth", "clkin0", "clkin1", "pipeline", "pclk";
        power-domains = <&pwrc PWRC_T7_ETH_ID>;
        phy-mode = "rgmii-id";
    };
```

## Documentation/devicetree/bindings/net/can/aeroflexgaisler,grcan.yaml
```yaml
# SPDX-License-Identifier: (GPL-2.0-only OR BSD-2-Clause)
%YAML 1.2
---
$id: http://devicetree.org/schemas/net/can/aeroflexgaisler,grcan.yaml#
$schema: http://devicetree.org/meta-schemas/core.yaml#

title: Aeroflex Gaisler GRCAN and GRHCAN CAN controllers

maintainers:
  - Marc Kleine-Budde <mkl@pengutronix.de>

description: |
  The GRCAN and GRHCAN CAN controllers are available in the GRLIB VHDL IP
  core library.

  On a LEON SPARC system there are no device tree source files. The nodes
  are built by the PROM from the AMBA plug&play information, which does not
  provide a compatible string. The driver therefore matches on the node
  name, which is built as "<core name>@<irq>,<address>" from the "name" and
  "reg" properties of the AMBA plug&play core.

  The GRLIB build ID is not a property of the controller node either. It is
  read from the "systemid" property of the "/ambapp0" node, and the TX bug
  workaround is enabled when that property is absent or when its least
  significant 16 bits are smaller than 4100.

select:
  properties:
    $nodename:
      pattern: '^(01_034|01_03d|GAISLER_GRCAN|GAISLER_GRHCAN)@'
  required:
    - $nodename

properties:
  reg:
    maxItems: 1

  freq:
    description:
      Frequency of the external oscillator clock in Hz, which is the
      frequency of the AMBA bus in the ordinary case.
    $ref: /schemas/types.yaml#/definitions/uint32

  interrupts:
    maxItems: 1
    description:
      Interrupt number of the controller, as built from the AMBA plug&play
      information.

required:
  - reg
  - freq
  - interrupts

additionalProperties: false

examples:
  - |
    /* AMBA plug&play children are named "<core name>@<irq>,<address>" */
    GAISLER_GRCAN@c,80000000 {
        reg = <0x80000000 0x1000>;
        freq = <40000000>;
        interrupts = <12>;
    };
...
```

## Documentation/devicetree/bindings/net/can/bosch,cc770.yaml
```yaml
# SPDX-License-Identifier: (GPL-2.0-only OR BSD-2-Clause)
%YAML 1.2
---
$id: http://devicetree.org/schemas/net/can/bosch,cc770.yaml#
$schema: http://devicetree.org/meta-schemas/core.yaml#

title: Bosch CC770 and Intel AN82527 CAN controllers

maintainers:
  - Marc Kleine-Budde <mkl@pengutronix.de>

description:
  The CC770 is a CAN controller from Bosch which is 100% compatible with the
  older AN82527 from Intel, except that some bugs have been fixed.

allOf:
  - $ref: can-controller.yaml#

properties:
  compatible:
    enum:
      - bosch,cc770
      - intc,82527

  reg:
    description:
      Register window of the controller. On a PowerPC system the controller
      sits on the local bus and the property describes the chip select, the
      address offset and the size, the size usually being 0x80.
    maxItems: 1

  interrupts:
    maxItems: 1

  bosch,external-clock-frequency:
    $ref: /schemas/types.yaml#/definitions/uint32
    description:
      Frequency of the external oscillator clock in Hz. The internal clock
      frequency used by the controller is half of this value.
    default: 16000000

  bosch,clock-out-frequency:
    $ref: /schemas/types.yaml#/definitions/uint32
    description:
      Clock frequency in Hz on the CLKOUT pin. If not specified or if the
      value is 0 the CLKOUT pin is disabled.
    default: 0

  bosch,slew-rate:
    $ref: /schemas/types.yaml#/definitions/uint32
    description:
      Slew rate of the CLKOUT signal. If not specified a reasonable value
      is calculated. Only used when bosch,clock-out-frequency is set.

  bosch,divide-memory-clock:
    description: Divide the memory clock for slower memories.
    type: boolean

  bosch,iso-low-speed-mux:
    description: Use the ISO low speed multiplexed bus configuration.
    type: boolean

  bosch,no-comperator-bypass:
    description:
      Disable the comparator bypass. When this property is absent the
      comparator bypass is enabled.
    type: boolean

  bosch,disconnect-rx0-input:
    description: Disconnect the RX0 input.
    type: boolean

  bosch,disconnect-rx1-input:
    description: Disconnect the RX1 input.
    type: boolean

  bosch,disconnect-tx1-output:
    description: Disconnect the TX1 output.
    type: boolean

  bosch,polarity-dominant:
    description: Use dominant polarity on the bus.
    type: boolean

required:
  - compatible
  - reg
  - interrupts

unevaluatedProperties: false

examples:
  - |
    localbus {
        #address-cells = <2>;
        #size-cells = <1>;

        can@2,100 {
            compatible = "bosch,cc770";
            reg = <2 0x100 0x100>;
            interrupts = <4 1>;
            interrupt-parent = <&mpic>;
            bosch,external-clock-frequency = <16000000>;
            bosch,disconnect-rx1-input;
            bosch,disconnect-tx1-output;
            bosch,iso-low-speed-mux;
        };
    };
...
```
