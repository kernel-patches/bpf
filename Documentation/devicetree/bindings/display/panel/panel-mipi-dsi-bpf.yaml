## Documentation/devicetree/bindings/net/dsa/soce,swip.yaml
```yaml
# SPDX-License-Identifier: (GPL-2.0-only OR BSD-2-Clause)
%YAML 1.2
---
$id: http://devicetree.org/schemas/net/dsa/soce,swip.yaml#
$schema: http://devicetree.org/meta-schemas/core.yaml#

title: SoC-e ethernet switch IP core for FPGAs

maintainers:
  - Vasilij Strassheim <v.strassheim@linutronix.de>

description:
  SoC-e Ethernet switch IP cores are FPGA-based switches whose features
  and number of ports are selected at synthesis time. Ports can connect
  to CPUs, external PHYs, FPGA logic, or other switch cores. An integrated
  MDIO controller accesses the per-port external buses through a mux.

$ref: dsa.yaml#

properties:
  compatible:
    const: soce,swip-00-04-0c-10
    description:
      Register layout with the core version register at offset 0x00 and
      feature identification registers at offsets 0x04, 0x0c, and 0x10.
      Switch instances using this register layout are autodetected from
      these registers and use this compatible regardless of their
      synthesis-time feature and port configuration.

  reg:
    maxItems: 1

  '#address-cells':
    const: 1

  '#size-cells':
    const: 1

  ranges: true

  mdio@204:
    $ref: /schemas/net/soce,swip-mdio.yaml#
    unevaluatedProperties: false
    description:
      Integrated MDIO controller bus on the master side of the mux.

  mdio-mux@202:
    $ref: /schemas/net/mdio-mux-mmioreg.yaml#
    unevaluatedProperties: false

  ethernet-ports:
    type: object
    patternProperties:
      '^ethernet-port@[0-9a-f]+$':
        type: object
        $ref: dsa-port.yaml#
        unevaluatedProperties: false

        properties:
          reg:
            maximum: 30
            description:
              Switch port index. Supported switch configurations have
              up to 31 ports, numbered from 0 through 30.

          phy-mode:
            enum:
              - mii
              - gmii
              - rmii
              - rgmii
              - rgmii-id
              - rgmii-rxid
              - rgmii-txid

        required:
          - reg
          - phy-mode

required:
  - compatible
  - reg
  - ethernet-ports

unevaluatedProperties: false

examples:
  - |
    ethernet-switch@80020000 {
        compatible = "soce,swip-00-04-0c-10";
        reg = <0x80020000 0x10000>;
        #address-cells = <1>;
        #size-cells = <1>;
        ranges = <0x0 0x80020000 0x10000>;

        mdio_parent: mdio@204 {
            compatible = "soce,swip-mdio-23-02";
            reg = <0x204 0xc>, <0x200 0x4>;
            reg-names = "data", "control";
            #address-cells = <1>;
            #size-cells = <0>;
        };

        mdio-mux@202 {
            compatible = "mdio-mux-mmioreg", "mdio-mux";
            reg = <0x202 0x2>;
            mux-mask = <0x07ff>;
            mdio-parent-bus = <&mdio_parent>;
            #address-cells = <1>;
            #size-cells = <0>;

            mdio@0 {
                reg = <0>;
                #address-cells = <1>;
                #size-cells = <0>;

                switchphy0: ethernet-phy@1 {
                    compatible = "ethernet-phy-ieee802.3-c22";
                    reg = <1>;
                };
            };

            mdio@1 {
                reg = <1>;
                #address-cells = <1>;
                #size-cells = <0>;

                switchphy1: ethernet-phy@1 {
                    compatible = "ethernet-phy-ieee802.3-c22";
                    reg = <1>;
                };
            };
        };

        ethernet-ports {
            #address-cells = <1>;
            #size-cells = <0>;

            ethernet-port@0 {
                reg = <0>;
                phy-handle = <&switchphy0>;
                phy-mode = "rgmii-id";
            };

            ethernet-port@1 {
                reg = <1>;
                phy-handle = <&switchphy1>;
                phy-mode = "rgmii-id";
            };

            ethernet-port@2 {
                reg = <2>;
                ethernet = <&eth0>;
                phy-mode = "gmii";

                fixed-link {
                    speed = <1000>;
                    full-duplex;
                };
            };
        };
    };
```

## Documentation/devicetree/bindings/net/hisilicon,hns-mdio.yaml
```yaml
# SPDX-License-Identifier: (GPL-2.0-only OR BSD-2-Clause)
%YAML 1.2
---
$id: http://devicetree.org/schemas/net/hisilicon,hns-mdio.yaml#
$schema: http://devicetree.org/meta-schemas/core.yaml#

title: Hisilicon HNS MDIO bus controller

maintainers:
  - Jian Shen <shenjian15@huawei.com>
  - Jijie Shao <shaojijie@huawei.com>

allOf:
  - $ref: mdio.yaml#

properties:
  compatible:
    enum:
      - hisilicon,hns-mdio
      - hisilicon,mdio

  reg:
    maxItems: 1

  subctrl-vbase:
    $ref: /schemas/types.yaml#/definitions/phandle-array
    items:
      - items:
          - description: syscon phandle
          - description: MDIO clock enable register offset
          - description: MDIO reset request register offset
          - description: MDIO reset done register offset
          - description: MDIO reset deassert register offset

required:
  - compatible
  - reg
  - '#address-cells'
  - '#size-cells'

unevaluatedProperties: false

examples:
  - |
    bus {
        #address-cells = <2>;
        #size-cells = <2>;

        mdio@803c0000 {
            #address-cells = <1>;
            #size-cells = <0>;
            compatible = "hisilicon,hns-mdio";
            reg = <0x0 0x803c0000 0x0 0x10000>;

            ethernet-phy@0 {
                reg = <0>;
            };
        };
    };
```

## Documentation/devicetree/bindings/net/maxlinear,gpy2xx.yaml
```yaml
# SPDX-License-Identifier: GPL-2.0-only OR BSD-2-Clause
%YAML 1.2
---
$id: http://devicetree.org/schemas/net/maxlinear,gpy2xx.yaml#
$schema: http://devicetree.org/meta-schemas/core.yaml#

title: MaxLinear GPY2xx PHY

maintainers:
  - Andrew Lunn <andrew@lunn.ch>
  - Michael Walle <michael@walle.cc>

allOf:
  - $ref: ethernet-phy.yaml#
  - if:
      properties:
        compatible:
          contains:
            const: ethernet-phy-idc133.5400
      required:
        - compatible

    then:
      properties:
        maxlinear,lane-asp-map:
          description: |
            Mapping of the physical TPI lanes A through D to the PHY's
            analog signal processing lanes (ASPs). The array index identifies
            physical lane A, B, C, or D, while its value identifies ASP A, B,
            C, or D, encoded as 0 through 3. Each ASP must be mapped exactly
            once. Omit the property to retain the hardware reset mapping.
          $ref: /schemas/types.yaml#/definitions/uint32-array
          minItems: 4
          maxItems: 4
          uniqueItems: true
          items:
            minimum: 0
            maximum: 3

        mdio-regulator:
          type: object
          description: |
            Initial data for the MxL86211C MDIO I/O voltage regulator. Set
            this to 1.8 V or 3.3 V to configure the MDIO, MDC, and MDINT
            pad voltage. The board must supply the VDDP pin at the selected
            voltage.
          $ref: /schemas/regulator/regulator.yaml#
          unevaluatedProperties: false

    else:
      properties:
        maxlinear,lane-asp-map: false
        mdio-regulator: false

properties:
  maxlinear,use-broken-interrupts:
    description: |
      Interrupts are broken on some GPY2xx PHYs in that they keep the
      interrupt line asserted for a random amount of time even after the
      interrupt status register is cleared. Thus it is blocking the
      interrupt line which is usually bad for shared lines. By default,
      interrupts are disabled for this PHY and polling mode is used. If one
      can live with the consequences, this property can be used to enable
      interrupt handling.

      Affected PHYs (as far as known) are GPY215B and GPY215C.
    type: boolean

dependencies:
  maxlinear,use-broken-interrupts: [ interrupts ]

unevaluatedProperties: false

examples:
  - |
    ethernet {
        #address-cells = <1>;
        #size-cells = <0>;

        ethernet-phy@0 {
            reg = <0>;
            interrupts-extended = <&intc 0>;
            maxlinear,use-broken-interrupts;
        };
    };

  - |
    ethernet {
        #address-cells = <1>;
        #size-cells = <0>;

        ethernet-phy@0 {
            compatible = "ethernet-phy-idc133.5400",
                         "ethernet-phy-ieee802.3-c45";
            reg = <0>;

            /* Swap physical TPI lanes C and D. */
            maxlinear,lane-asp-map = <0 1 3 2>;

            mdio: mdio-regulator {
                regulator-min-microvolt = <1800000>;
                regulator-max-microvolt = <1800000>;
            };
        };
    };

...
```

## Documentation/devicetree/bindings/net/micrel,gigabit.yaml
```yaml
# SPDX-License-Identifier: (GPL-2.0-only OR BSD-2-Clause)
%YAML 1.2
---
$id: http://devicetree.org/schemas/net/micrel,gigabit.yaml#
$schema: http://devicetree.org/meta-schemas/core.yaml#

title: Micrel series Gigabit Ethernet PHYs

maintainers:
  - Andrew Lunn <andrew@lunn.ch>
  - Stefan Eichenberger <eichest@gmail.com>

description: |
  Some boards require special skew tuning values, particularly when it comes
  to clock delays. These values can be specified in the device tree using
  the properties listed here.

properties:
  compatible:
    enum:
      - ethernet-phy-id0022.1610  # KSZ9021
      - ethernet-phy-id0022.1611  # KSZ9021RLRN
      - ethernet-phy-id0022.1620  # KSZ9031
      - ethernet-phy-id0022.1631  # KSZ9477
      - ethernet-phy-id0022.1640  # KSZ9131
      - ethernet-phy-id0022.1650  # LAN8841
      - ethernet-phy-id0022.1660  # LAN8814
      - ethernet-phy-id0022.1670  # LAN8804
  micrel,force-master:
    type: boolean
    description: |
      Force phy to master mode. Only set this option if the phy reference
      clock provided at CLK125_NDO pin is used as MAC reference clock
      because the clock jitter in slave mode is too high (errata#2).
      Attention: The link partner must be configurable as slave otherwise
      no link will be established.
  coma-mode-gpios:
    maxItems: 1
    description: |
      If present the given gpio will be deasserted when the PHY is probed.

      Some PHYs have a COMA mode input pin which puts the PHY into
      isolate and power-down mode. On some boards this input is connected
      to a GPIO of the SoC.
  micrel,led-mode:
    $ref: /schemas/types.yaml#/definitions/uint32
    description: |
      LED mode value to set for PHYs with configurable LEDs.

      Configure the LED mode with single value. The list of PHYs and the
      bits that are currently supported:

      LAN8814: register EP5.0, bit 6

      See the respective PHY datasheet for the mode values.
    minimum: 0
    maximum: 1

patternProperties:
  '^([rt]xc)-skew-psec$':
    $ref: /schemas/types.yaml#/definitions/int32
    description: |
      Skew control of the pad in picoseconds.
    minimum: -700
    maximum: 2400
    multipleOf: 100
    default: 0
  '^([rt]xd[0-3]|rxdv|txen)-skew-psec$':
    $ref: /schemas/types.yaml#/definitions/int32
    description: |
      Skew control of the pad in picoseconds.
    minimum: -700
    maximum: 800
    multipleOf: 100
    default: 0

allOf:
  - $ref: ethernet-phy.yaml#
  - if:
      properties:
        compatible:
          contains:
            enum:
              - ethernet-phy-id0022.1610
              - ethernet-phy-id0022.1611
    then:
      patternProperties:
        '^([rt]xd[0-3]|[rt]xc|rxdv|txen)-skew-ps$':
          description: |
            Skew control of the pad in picoseconds. A value of 0 equals to a
            skew of -840ps.
            The actual increment on the chip is 120ps ranging from -840ps to
            960ps, this mismatch comes from a documentation error before
            datasheet revision 1.2 (Feb 2014):
          minimum: 0
          maximum: 3000
          multipleOf: 200
          default: 1400
  - if:
      properties:
        compatible:
          contains:
            const: ethernet-phy-id0022.1620
    then:
      patternProperties:
        '^([rt]xc)-skew-ps$':
          description: |
            Skew control of the pad in picoseconds. A value of 0 equals to a
            skew of -900ps.
          minimum: 0
          maximum: 1860
          multipleOf: 60
          default: 900
        '^([rt]xd[0-3]|rxdv|txen)-skew-ps$':
          description: |
            Skew control of the pad in picoseconds. A value of 0 equals to a
            skew of -420.
          minimum: 0
          maximum: 900
          multipleOf: 60
          default: 420
  - if:
      not:
        properties:
          compatible:
            contains:
              enum:
                - ethernet-phy-id0022.1640
                - ethernet-phy-id0022.1650
    then:
      patternProperties:
        '^([rt]xd[0-3]|[rt]xc|rxdv|txen)-skew-psec$': false
  - if:
      not:
        properties:
          compatible:
            contains:
              const: ethernet-phy-id0022.1620
    then:
      properties:
        micrel,force-master: false
  - if:
      not:
        properties:
          compatible:
            contains:
              const: ethernet-phy-id0022.1660
    then:
      properties:
        coma-mode-gpios: false
        micrel,led-mode: false

unevaluatedProperties: false

examples:
  - |
    ethernet {
        #address-cells = <1>;
        #size-cells = <0>;

        ethernet-phy@7 {
            compatible = "ethernet-phy-id0022.1610";
            reg = <7>;
            rxc-skew-ps = <3000>;
            rxdv-skew-ps = <0>;
            txc-skew-ps = <3000>;
            txen-skew-ps = <0>;
        };

        ethernet-phy@9 {
            compatible = "ethernet-phy-id0022.1640";
            reg = <9>;
            rxc-skew-psec = <(-100)>;
            txc-skew-psec = <(-100)>;
        };
    };
```
