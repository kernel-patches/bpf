## Documentation/devicetree/bindings/net/airoha,an7583-mdio.yaml
```yaml
# SPDX-License-Identifier: GPL-2.0-only OR BSD-2-Clause
%YAML 1.2
---
$id: http://devicetree.org/schemas/net/airoha,an7583-mdio.yaml#
$schema: http://devicetree.org/meta-schemas/core.yaml#

title: Airoha AN7583 Dedicated MDIO Controller

maintainers:
  - Christian Marangi <ansuelsmth@gmail.com>

description:
  Airoha AN7583 SoC have 3 different MDIO Controller.

  One comes from the intergated Switch based on MT7530.

  The other 2 (that this schema describe) live under the SCU
  register supporting both C22 and C45 PHYs.

  The Airoha AN7589 has a third controller of this kind under the SCU.

$ref: mdio.yaml#

properties:
  compatible:
    oneOf:
      - const: airoha,an7583-mdio
      - items:
          - const: airoha,an7589-mdio
          - const: airoha,an7583-mdio

  reg:
    maxItems: 1

  clocks:
    maxItems: 1

  resets:
    maxItems: 1

  clock-frequency:
    default: 2500000

required:
  - compatible
  - reg
  - clocks
  - resets

allOf:
  - if:
      properties:
        compatible:
          contains:
            const: airoha,an7589-mdio
    then:
      properties:
        reg:
          enum: [0xc8, 0xcc, 0xd8]
    else:
      properties:
        reg:
          enum: [0xc8, 0xcc]

unevaluatedProperties: false

examples:
  - |
    system-controller {
        #address-cells = <1>;
        #size-cells = <0>;

        mdio-bus@c8 {
            compatible = "airoha,an7583-mdio";
            reg = <0xc8>;

            clocks = <&scu>;
            resets = <&scu>;
        };
    };
```

## Documentation/devicetree/bindings/net/airoha,an8855-phy.yaml
```yaml
# SPDX-License-Identifier: (GPL-2.0-only OR BSD-2-Clause)
%YAML 1.2
---
$id: http://devicetree.org/schemas/net/airoha,an8855-phy.yaml#
$schema: http://devicetree.org/meta-schemas/core.yaml#

title: Airoha AN8855 Switch Internal PHY

maintainers:
  - Christian Marangi <ansuelsmth@gmail.com>

description: >
  Airoha AN8855 is a 5-port Gigabit Switch that expose the Internal
  PHYs on the MDIO bus.

  Each PHY might need to be calibrated to correctly work with the
  use of the eFUSE provided by the Switch SoC.

allOf:
  - $ref: ethernet-phy.yaml#

select:
  properties:
    compatible:
      contains:
        enum:
          - ethernet-phy-idc0ff.0410
  required:
    - compatible

properties:
  reg:
    maxItems: 1

  nvmem-cells:
    items:
      - description: phandle to SoC eFUSE tx_a
      - description: phandle to SoC eFUSE tx_b
      - description: phandle to SoC eFUSE tx_c
      - description: phandle to SoC eFUSE tx_d

  nvmem-cell-names:
    items:
      - const: tx_a
      - const: tx_b
      - const: tx_c
      - const: tx_d

required:
  - compatible
  - reg

dependentRequired:
  nvmem-cells: [ nvmem-cell-names ]

unevaluatedProperties: false

examples:
  - |
    mdio {
        #address-cells = <1>;
        #size-cells = <0>;

        ethernet-phy@1 {
            compatible = "ethernet-phy-idc0ff.0410",
                         "ethernet-phy-ieee802.3-c45";

            reg = <1>;
        };

        ethernet-phy@2 {
            compatible = "ethernet-phy-idc0ff.0410",
                         "ethernet-phy-ieee802.3-c45";

            reg = <2>;

            nvmem-cells = <&shift_sel_port0_tx_a>,
                          <&shift_sel_port0_tx_b>,
                          <&shift_sel_port0_tx_c>,
                          <&shift_sel_port0_tx_d>;
            nvmem-cell-names = "tx_a", "tx_b", "tx_c", "tx_d";
        };
    };
```
