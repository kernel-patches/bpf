## Documentation/devicetree/bindings/net/microchip,lan78xx.yaml
```yaml
# SPDX-License-Identifier: (GPL-2.0-only OR BSD-2-Clause)
%YAML 1.2
---
$id: http://devicetree.org/schemas/net/microchip,lan78xx.yaml#
$schema: http://devicetree.org/meta-schemas/core.yaml#

title: Microchip LAN78xx Gigabit Ethernet controller

maintainers:
  - Rengarajan Sundararajan <Rengarajan.S@microchip.com>
  - UNGLinuxDriver <UNGLinuxDriver@microchip.com>

description:
  The LAN78XX devices are usually configured by programming their OTP or with
  an external EEPROM, but some platforms (e.g. Raspberry Pi 3 B+) have neither.
  The Device Tree properties, if present, override the OTP and EEPROM.

allOf:
  - $ref: /schemas/usb/usb-device.yaml#
  - $ref: /schemas/net/ethernet-controller.yaml#

properties:
  compatible:
    enum:
      - usb424,7800
      - usb424,7801
      - usb424,7850
  reg:
    maxItems: 1
    description: USB port number
  local-mac-address:
    $ref: /schemas/types.yaml#/definitions/uint8-array
    minItems: 6
    maxItems: 6
    description:
      MAC address to use if not stored in OTP or EEPROM. If present,
      overrides OTP/EEPROM.
  mdio:
    $ref: /schemas/net/mdio.yaml#
    unevaluatedProperties: false

patternProperties:
  "^ethernet-phy(@[0-9a-f]+)?$":
    type: object
    description: |
      PHY node for the embedded or external PHY. The PHY address is
      given by the 'reg' property.
    properties:
      reg:
        maxItems: 1
        description: PHY address.
      microchip,led-modes:
        $ref: /schemas/types.yaml#/definitions/uint32-array
        minItems: 1
        maxItems: 4
        description:
          Array of LED mode values for each of up to 4 LEDs.
          Omitted LEDs are turned off. Allowed values are defined
          in include/dt-bindings/net/microchip-lan78xx.h.
    required:
      - reg
    additionalProperties: false

required:
  - compatible
  - reg

unevaluatedProperties: false

examples:
  - |
    #include <dt-bindings/net/microchip-lan78xx.h>
    / {
        usb: usb {
            compatible = "usb-host";
            #address-cells = <1>;
            #size-cells = <0>;
        };
    };
    &usb {
        usb-port@1 {
            compatible = "usb424,2514";
            reg = <1>;
            #address-cells = <1>;
            #size-cells = <0>;

            usb-port@1 {
                compatible = "usb424,2514";
                reg = <1>;
                #address-cells = <1>;
                #size-cells = <0>;

                ethernet@1 {
                    compatible = "usb424,7800";
                    reg = <1>;
                    local-mac-address = [00 11 22 33 44 55];

                    mdio {
                        #address-cells = <1>;
                        #size-cells = <0>;
                        ethernet-phy@1 {
                            reg = <1>;
                            microchip,led-modes = <
                                LAN78XX_LINK_1000_ACTIVITY
                                LAN78XX_LINK_10_100_ACTIVITY
                            >;
                        };
                    };
                };
            };
        };
    };
...
```

## Documentation/devicetree/bindings/net/motorcomm,yt8824.yaml
```yaml
# SPDX-License-Identifier: (GPL-2.0-only OR BSD-2-Clause)
%YAML 1.2
---
$id: http://devicetree.org/schemas/net/motorcomm,yt8824.yaml#
$schema: http://devicetree.org/meta-schemas/core.yaml#

title: MotorComm YT8824 Ethernet PHY

maintainers:
  - Kyle Switch <kyle.switch@motor-comm.com>

description:
  Motorcomm YT8824 Ethernet PHY is a PHY package of 4 PHYs.

$ref: ethernet-phy-package.yaml#

properties:
  compatible:
    enum:
      - motorcomm,yt8824-package

  motorcomm,package-mode:
    description: |
      PHY package can be configured in 2 modes:
      - internal: YT8824 is embedded in the switch, using
        an internal interface to the MAC.
      - 10g-qxgmii: YT8824 is a standalone external PHY,
        connected via 10G QXGMII.
    $ref: /schemas/types.yaml#/definitions/string
    enum: [ internal, 10g-qxgmii ]

  reg:
    description:
      The absolute MDIO address of the YT8824 shared top extend
      register block.
      For internal mode, this is fixed at 9;
      For external mode, it is the base MDIO address of the four
      member PHYs plus 4, where base is typically 0x0.
      Note that this is NOT the reg of the first member PHY.

required:
  - compatible
  - motorcomm,package-mode
  - reg

unevaluatedProperties: false

examples:
  - |
    mdio {
        #address-cells = <1>;
        #size-cells = <0>;

        ethernet-phy-package@9 {
            #address-cells = <1>;
            #size-cells = <0>;
            compatible = "motorcomm,yt8824-package";
            reg = <9>;

            motorcomm,package-mode = "internal";

            ethernet-phy@4 {
                reg = <4>;
            };

            ethernet-phy@5 {
                reg = <5>;
            };

            ethernet-phy@6 {
                reg = <6>;
            };

            ethernet-phy@7 {
                reg = <7>;
            };
        };
    };
```

## Documentation/devicetree/bindings/net/nfc/samsung,s3fwrn5.yaml
```yaml
# SPDX-License-Identifier: GPL-2.0-only OR BSD-2-Clause
%YAML 1.2
---
$id: http://devicetree.org/schemas/net/nfc/samsung,s3fwrn5.yaml#
$schema: http://devicetree.org/meta-schemas/core.yaml#

title: Samsung S3FWRN5 NCI NFC Controller

maintainers:
  - Krzysztof Kozlowski <krzk@kernel.org>

properties:
  compatible:
    enum:
      - samsung,s3fwrn5-i2c
      - samsung,s3fwrn82
      - samsung,s3nrn4v

  en-gpios:
    maxItems: 1
    description:
      Output GPIO pin used for enabling/disabling the chip

  clk-req-gpios:
    maxItems: 1
    description:
      Input GPIO pin connected to the controller's CLK_REQ output, which the
      controller asserts for as long as it requires its external reference
      clock.

  interrupts:
    maxItems: 1

  reg:
    maxItems: 1

  clocks:
    maxItems: 1

  pvdd-supply:
    description: PVDD power supply

  wake-gpios:
    maxItems: 1
    description:
      Output GPIO pin used to enter firmware mode and sleep/wakeup control

  s3fwrn5,en-gpios:
    maxItems: 1
    deprecated: true
    description:
      Use en-gpios

  s3fwrn5,fw-gpios:
    maxItems: 1
    deprecated: true
    description:
      Use wake-gpios

additionalProperties: false

required:
  - compatible
  - en-gpios
  - wake-gpios

# The clock-request handshake gates an external clock, so it needs one.
dependencies:
  clk-req-gpios: [ clocks ]

allOf:
  - if:
      properties:
        compatible:
          contains:
            enum:
              - samsung,s3fwrn5-i2c
              - samsung,s3nrn4v
    then:
      required:
        - interrupts
        - reg

  # No user of the clock-request handshake is known on the other parts.
  - if:
      not:
        properties:
          compatible:
            contains:
              const: samsung,s3nrn4v
    then:
      properties:
        clk-req-gpios: false

  # Deployed DTs for the older parts never described a supply, so PVDD is
  # only required for the new device.
  - if:
      properties:
        compatible:
          contains:
            const: samsung,s3nrn4v
    then:
      required:
        - pvdd-supply

examples:
  - |
    #include <dt-bindings/gpio/gpio.h>
    #include <dt-bindings/interrupt-controller/irq.h>

    i2c {
        #address-cells = <1>;
        #size-cells = <0>;

        s3fwrn5@27 {
            compatible = "samsung,s3fwrn5-i2c";
            reg = <0x27>;

            interrupt-parent = <&gpa1>;
            interrupts = <3 IRQ_TYPE_EDGE_RISING>;

            en-gpios = <&gpf1 4 GPIO_ACTIVE_HIGH>;
            wake-gpios = <&gpj0 2 GPIO_ACTIVE_HIGH>;

            clocks = <&rpmcc 20>;
        };
    };
  # UART example on Raspberry Pi
  - |
    uart0 {
        nfc {
            compatible = "samsung,s3fwrn82";

            en-gpios = <&gpio 20 GPIO_ACTIVE_HIGH>;
            wake-gpios = <&gpio 16 GPIO_ACTIVE_HIGH>;

        };
    };
  # S3NRN4V with a clock-request gated external clock
  - |
    #include <dt-bindings/gpio/gpio.h>
    #include <dt-bindings/interrupt-controller/irq.h>

    i2c {
        #address-cells = <1>;
        #size-cells = <0>;

        nfc@27 {
            compatible = "samsung,s3nrn4v";
            reg = <0x27>;

            interrupt-parent = <&tlmm>;
            interrupts = <31 IRQ_TYPE_EDGE_RISING>;

            en-gpios = <&tlmm 56 GPIO_ACTIVE_HIGH>;
            wake-gpios = <&tlmm 7 GPIO_ACTIVE_HIGH>;
            clk-req-gpios = <&tlmm 6 GPIO_ACTIVE_HIGH>;

            clocks = <&rpmhcc 4>;
            pvdd-supply = <&nfc_pvdd>;
        };
    };
```

## Documentation/devicetree/bindings/net/onnn,s2500.yaml
```yaml
# SPDX-License-Identifier: (GPL-2.0-only OR BSD-2-Clause)
%YAML 1.2
---
$id: http://devicetree.org/schemas/net/onnn,s2500.yaml#
$schema: http://devicetree.org/meta-schemas/core.yaml#

title: onsemi S2500 10BASE-T1S MACPHY Ethernet Controllers

maintainers:
  - Selva Rajagopal <Selvamani.Rajagopal@onsemi.com>

description:
  The S2500 combines a Media Access Controller (MAC) and an
  Ethernet PHY to enable 10BASE‑T1S networks. The Ethernet Media Access
  Controller (MAC) module implements a 10 Mbps half duplex Ethernet MAC,
  compatible with the IEEE 802.3 standard and a 10BASE-T1S physical layer
  transceiver integrated into the S2500. The communication between
  the host and the MAC-PHY is specified in the OPEN Alliance 10BASE-T1x
  MACPHY Serial Interface (TC6).

allOf:
  - $ref: /schemas/net/ethernet-controller.yaml#
  - $ref: /schemas/spi/spi-peripheral-props.yaml#

properties:
  compatible:
    const: onnn,s2500

  reg:
    maxItems: 1

  interrupts:
    description:
      Interrupt from MAC-PHY asserted in the event of Receive Chunks
      Available, Transmit Chunk Credits Available and Extended Status
      Event.
    maxItems: 1

  reset-gpios:
    description:
      GPIO connected to the active-low RST_N pin of the MAC-PHY.
    maxItems: 1

  spi-max-frequency:
    maximum: 25000000

required:
  - compatible
  - reg
  - interrupts
  - spi-max-frequency

unevaluatedProperties: false

examples:
  - |
    #include <dt-bindings/interrupt-controller/irq.h>
    spi {
      #address-cells = <1>;
      #size-cells = <0>;

      ethernet@0 {
        compatible = "onnn,s2500";
        reg = <0>;
        pinctrl-names = "default";
        pinctrl-0 = <&eth0_pins>;
        interrupt-parent = <&gpio>;
        interrupts = <25 IRQ_TYPE_LEVEL_LOW>;
        spi-max-frequency = <15000000>;
      };
    };
```

## Documentation/devicetree/bindings/net/pcs/rockchip-dwxpcs.yaml
```yaml
# SPDX-License-Identifier: (GPL-2.0-only OR BSD-2-Clause)
%YAML 1.2
---
$id: http://devicetree.org/schemas/net/pcs/rockchip-dwxpcs.yaml#
$schema: http://devicetree.org/meta-schemas/core.yaml#

title: Rockchip RK3568 Synopsys DesignWare Ethernet PCS

maintainers:
  - Coia Prant <coiaprant@gmail.com>

description: |
  Rockchip RK3568 SoC integrates a Synopsys DesignWare Ethernet Physical
  Coding Sublayer (XPCS).
  The PCS provides an interface between the Media Access Control (MAC)
  and the Physical Medium Attachment (PMA) sublayer through a Media
  Independent Interface (GMII).

  The XPCS is accessed over the APB3 bus and internally connected to a
  Naneng Combo SerDes PHY.
  It supports 1000BASE-X, SGMII and QSGMII modes.

  The block contains four MII ports that can be individually enabled and
  routed to one of the Ethernet GMAC controllers via the pcs-handle
  property in the MAC device tree node.

properties:
  compatible:
    const: rockchip,rk3568-xpcs

  reg:
    maxItems: 1

  "#address-cells":
    const: 1

  "#size-cells":
    const: 0

  clocks:
    items:
      - description: APB3 bus interface clock (clk_csr_i), required for register access
      - description: EEE clock (clk_eee_i), required for Energy Efficient Ethernet operation

  clock-names:
    items:
      - const: csr
      - const: eee

  phys:
    maxItems: 1

  phy-names:
    const: serdes

  power-domains:
    maxItems: 1

patternProperties:
  "^pcs-mii@[0-3]$":
    type: object
    description:
      One of the four MII ports of the XPCS. The port is linked to an
      Ethernet MAC controller via the pcs-handle property in the MAC's
      device tree node.

    properties:
      reg:
        description: MII port number.
        enum: [0, 1, 2, 3]

    required:
      - reg

    additionalProperties: false

required:
  - compatible
  - reg
  - "#address-cells"
  - "#size-cells"
  - clocks
  - clock-names
  - phys
  - phy-names
  - power-domains

additionalProperties: false

examples:
  - |
    #include <dt-bindings/clock/rk3568-cru.h>
    #include <dt-bindings/power/rk3568-power.h>
    #include <dt-bindings/phy/phy.h>

    pcs@fda00000 {
      compatible = "rockchip,rk3568-xpcs";
      reg = <0xfda00000 0x200000>;
      #address-cells = <1>;
      #size-cells = <0>;
      clocks = <&cru PCLK_XPCS>, <&cru CLK_XPCS_EEE>;
      clock-names = "csr", "eee";
      phys = <&combphy2 PHY_TYPE_SGMII>;
      phy-names = "serdes";
      power-domains = <&power RK3568_PD_PIPE>;

      pcs-mii@0 {
        reg = <0>;
      };
    };
```
