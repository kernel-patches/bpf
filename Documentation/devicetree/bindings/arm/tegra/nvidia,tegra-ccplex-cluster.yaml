## Documentation/devicetree/bindings/sound/nuvoton,nau8310.yaml
```yaml
# SPDX-License-Identifier: GPL-2.0-only OR BSD-2-Clause
%YAML 1.2
---
$id: http://devicetree.org/schemas/sound/nuvoton,nau8310.yaml#
$schema: http://devicetree.org/meta-schemas/core.yaml#

title: Nuvoton NAU83G10/20 Mono Class-D Amplifier with DSP

description:
  Mono Class-D Amplifier with DSP and I/V-sense.
  This device supports I2C.

maintainers:
  - Neo Chang <YLCHANG2@nuvoton.com>

properties:
  compatible:
    enum:
      - nuvoton,nau8310
      - nuvoton,nau8320

  reg:
    description: The I2C address is determined by the hardware pins.
    enum: [0x10, 0x11, 0x40, 0x41]

  "#sound-dai-cells":
    const: 0

  clocks:
    maxItems: 1

  clock-names:
    const: mclk

  firmware-name:
    items:
      - description:
          DSP core firmware.

  nuvoton,vref-impedance-ohms:
    description:
      VREF Impedance Selection.
    enum: [0, 25000, 125000, 2500]

  nuvoton,dac-vref-microvolt:
    description:
      The DAC vref to be used in voltage. DAC reference voltage setting. Can
      be used for minor tuning of the output level. Since the VDDA is range
      between 1.62 to 1.98 voltage, the typical value for design is 1.8V. After
      the minor tuning, the final microvolt are as the below.
    enum: [1800000, 2700000, 2880000, 3060000]

  nuvoton,sar-voltage-microvolt:
    description:
      SAR Gain Tracking Selection in microvolts.
      Assuming the typical VDDA design value is 1.8V, the SAR voltage is
      calculated by multiplying VDDA by the gain tracking ratio.
    enum: [1800000, 1980000, 2160000, 2340000, 2520000, 2772000, 5616000]

  nuvoton,sar-compare-time-ns:
    description:
      SAR compare time.
    enum: [500, 1000, 2000, 4000]

  nuvoton,sar-sampling-time-us:
    description:
      SAR sampling time.
    enum: [2, 4, 8, 16]

  nuvoton,clock-detection-disable:
    type: boolean
    description:
      Disable the Clock Detection Module. By default, clock detection is enabled.
      When clock detection is enabled, it will detect whether MCLK
      and FS are within the range. MCLK range is from 2.048MHz to 24.576MHz.
      FS range is from 8kHz to 96kHz. And also needs to detect the ratio
      MCLK_SRC/LRCK of 256, 400 or 500, and needs to detect the BCLK
      to make sure data is present. There needs to be at least 32 BCLK
      cycles per Frame Sync.

  nuvoton,clock-det-data:
    type: boolean
    description:
      Clock detection non-zero samples configuration for power up signal.

  nuvoton,boost-delay-ms:
    description:
      Boost Control Hold Timer in decrement (msec).
    enum: [0, 1, 2, 4, 8, 16, 32, 64, 128]

  nuvoton,boost-convert-mode:
    $ref: /schemas/types.yaml#/definitions/uint32
    description: Boost Converter operating mode.
    enum:
      - 0 # BOOST CONVERTER disabled
      - 1 # BOOST CONVERTER enable gated by POWERUP signal
      - 3 # BOOST CONVERTER enabled

  nuvoton,boost-target-limit-microvolt:
    description:
      Boost Control Target Value Limit.
      The step size is 190000uV (0.19V).
    minimum: 0
    maximum: 11970000

  nuvoton,boost-target-margin-microvolt:
    description:
      Boost Margin Value between Boost Target Voltage and peak output level.
      The step size is 190000uV (0.19V).
    minimum: 0
    maximum: 11970000

  nuvoton,temp-compensation:
    type: boolean
    description:
      Enable Temperature Compensation.

  nuvoton,normal-iis-data:
    type: boolean
    description:
      Enable Normal I2S Audio Data mode. The I2S interface
      transmits only audio data without SAR ADC data.

required:
  - compatible
  - reg
  - firmware-name

allOf:
  - $ref: dai-common.yaml#
  - if:
      properties:
        compatible:
          contains:
            const: nuvoton,nau8320
    then:
      properties:
        nuvoton,boost-delay-ms: false
        nuvoton,boost-convert-mode: false
        nuvoton,boost-target-limit-microvolt: false
        nuvoton,boost-target-margin-microvolt: false

unevaluatedProperties: false

examples:
  - |
    i2c {
        #address-cells = <1>;
        #size-cells = <0>;

        codec@10 {
            compatible = "nuvoton,nau8310";
            reg = <0x10>;
            #sound-dai-cells = <0>;
            firmware-name = "NAU83G10.kcs.bin";
            nuvoton,vref-impedance-ohms = <125000>;
            nuvoton,dac-vref-microvolt = <2700000>;
            nuvoton,sar-voltage-microvolt = <1800000>;
            nuvoton,sar-compare-time-ns = <1000>;
            nuvoton,sar-sampling-time-us = <4>;
            nuvoton,clock-detection-disable;
            nuvoton,clock-det-data;
            nuvoton,boost-delay-ms = <128>;
            nuvoton,boost-convert-mode = <1>;
            nuvoton,boost-target-limit-microvolt = <9500000>;
            nuvoton,boost-target-margin-microvolt = <380000>;
            nuvoton,temp-compensation;
            nuvoton,normal-iis-data;
        };

        codec@11 {
            compatible = "nuvoton,nau8320";
            reg = <0x11>;
            #sound-dai-cells = <0>;
            firmware-name = "NAU83G20.kcs.bin";
            nuvoton,vref-impedance-ohms = <125000>;
            nuvoton,dac-vref-microvolt = <2700000>;
            nuvoton,sar-voltage-microvolt = <1800000>;
            nuvoton,sar-compare-time-ns = <1000>;
            nuvoton,sar-sampling-time-us = <4>;
            nuvoton,clock-detection-disable;
            nuvoton,clock-det-data;
            nuvoton,temp-compensation;
            nuvoton,normal-iis-data;
        };
    };
```

## Documentation/devicetree/bindings/sound/nxp,tfa9865.yaml
```yaml
# SPDX-License-Identifier: (GPL-2.0-only OR BSD-2-Clause)
%YAML 1.2
---
$id: http://devicetree.org/schemas/sound/nxp,tfa9865.yaml#
$schema: http://devicetree.org/meta-schemas/core.yaml#

title: NXP/Goodix TFA9865 Audio Amplifier

maintainers:
  - Venkat Yadlapati <venkat.yadlapati@yahoo.com>

description:
  The TFA9865 is a mono class-D speaker amplifier with an integrated boost
  converter and voltage/current sensing. It is controlled over I2C and
  receives audio over I2S/TDM.

allOf:
  - $ref: dai-common.yaml#

properties:
  compatible:
    const: nxp,tfa9865

  reg:
    maxItems: 1

  interrupts:
    maxItems: 1

  reset-gpios:
    maxItems: 1

  vddd-supply:
    description: Digital supply (1.8 V)

  '#sound-dai-cells':
    const: 0

required:
  - compatible
  - reg
  - '#sound-dai-cells'

unevaluatedProperties: false

examples:
  - |
    #include <dt-bindings/gpio/gpio.h>
    #include <dt-bindings/interrupt-controller/irq.h>

    i2c {
        #address-cells = <1>;
        #size-cells = <0>;

        audio-codec@35 {
            compatible = "nxp,tfa9865";
            reg = <0x35>;
            interrupts-extended = <&tlmm 201 IRQ_TYPE_EDGE_FALLING>;
            reset-gpios = <&tlmm 183 GPIO_ACTIVE_LOW>;
            sound-name-prefix = "Speaker";
            #sound-dai-cells = <0>;
        };
    };
```

## Documentation/devicetree/bindings/sound/xlnx,spdif.yaml
```yaml
# SPDX-License-Identifier: (GPL-2.0-only OR BSD-2-Clause)
%YAML 1.2
---
$id: http://devicetree.org/schemas/sound/xlnx,spdif.yaml#
$schema: http://devicetree.org/meta-schemas/core.yaml#

title: Xilinx SPDIF IP

description:
  The IP supports playback and capture of SPDIF audio.

maintainers:
  - Vincenzo Frascino <vincenzo.frascino@arm.com>

allOf:
  - $ref: dai-common.yaml#
  - if:
      properties:
        xlnx,spdif-mode:
          const: 1
      required:
        - xlnx,spdif-mode
    then:
      properties:
        clock-names:
          minItems: 2
          items:
            - const: aud_clk_i
            - const: s_axi_aclk
            - const: s_axis_aclk
    else:
      properties:
        clock-names:
          minItems: 2
          items:
            - const: aud_clk_i
            - const: s_axi_aclk
            - const: m_axis_aclk

properties:
  compatible:
    enum:
      - xlnx,spdif-2.0

  reg:
    maxItems: 1

  interrupts:
    items:
      - description: SPDIF audio interrupt

  clock-names:
    minItems: 2
    maxItems: 3

  clocks:
    minItems: 2
    items:
      - description: Audio clock input used at the SPDIF/AES3 interface
      - description: AXI4-Lite clock
      - description: AXI4-Stream clock

  xlnx,spdif-mode:
    $ref: /schemas/types.yaml#/definitions/uint32
    enum:
      - 0
      - 1
    description: |
      0 - receiver
      1 - transmitter

  xlnx,aud_clk_i:
    $ref: /schemas/types.yaml#/definitions/uint32
    deprecated: true
    description:
      Frequency of the audio clock input. Superseded by the rate of the
      clock named aud_clk_i.

required:
  - compatible
  - reg
  - interrupts
  - clock-names
  - clocks
  - xlnx,spdif-mode

additionalProperties: false

examples:
  - |
    spdif@80010000 {
      compatible = "xlnx,spdif-2.0";
      reg = <0x80010000 0x10000>;
      clock-names = "aud_clk_i", "s_axi_aclk", "s_axis_aclk";
      clocks = <&misc_clk_0>, <&clk 71>, <&misc_clk_0>;
      interrupt-parent = <&gic>;
      interrupts = <0 91 4>;
      xlnx,spdif-mode = <1>;
    };
  - |
    spdif@80090000 {
      compatible = "xlnx,spdif-2.0";
      reg = <0x80090000 0x10000>;
      clock-names = "aud_clk_i", "s_axi_aclk", "m_axis_aclk";
      clocks = <&misc_clk_0>, <&clk 71>, <&clk 71>;
      interrupt-parent = <&gic>;
      interrupts = <0 90 4>;
      xlnx,spdif-mode = <0>;
    };

...
```
