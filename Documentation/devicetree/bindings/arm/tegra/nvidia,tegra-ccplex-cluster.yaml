## Documentation/devicetree/bindings/arm/tegra/nvidia,tegra-ccplex-cluster.yaml
```yaml
# SPDX-License-Identifier: (GPL-2.0-only OR BSD-2-Clause)
%YAML 1.2
---
$id: http://devicetree.org/schemas/arm/tegra/nvidia,tegra-ccplex-cluster.yaml#
$schema: http://devicetree.org/meta-schemas/core.yaml#

title: NVIDIA Tegra CPU COMPLEX CLUSTER area

maintainers:
  - Sumit Gupta <sumitg@nvidia.com>
  - Mikko Perttunen <mperttunen@nvidia.com>
  - Jon Hunter <jonathanh@nvidia.com>
  - Thierry Reding <thierry.reding@gmail.com>

description: |+
  The Tegra CPU COMPLEX CLUSTER area contains memory-mapped
  registers that initiate CPU frequency/voltage transitions.

properties:
  $nodename:
    pattern: "ccplex@([0-9a-f]+)$"

  compatible:
    enum:
      - nvidia,tegra186-ccplex-cluster
      - nvidia,tegra234-ccplex-cluster
      - nvidia,tegra238-ccplex-cluster
      - nvidia,tegra264-ccplex-cluster

  reg:
    maxItems: 1

  nvidia,bpmp:
    $ref: /schemas/types.yaml#/definitions/phandle
    description: |
      Specifies the BPMP node that needs to be queried to get
      operating point data for all CPUs.

  '#performance-domain-cells':
    const: 1
    description:
      The cell is the index of the performance domain that clocks a CPU.
      When present, every CPU names its domain with "performance-domains".

required:
  - compatible
  - reg
  - nvidia,bpmp

allOf:
  - if:
      properties:
        compatible:
          contains:
            const: nvidia,tegra264-ccplex-cluster
    then:
      required:
        - '#performance-domain-cells'

additionalProperties: false

examples:
  - |
    ccplex@e000000 {
      compatible = "nvidia,tegra234-ccplex-cluster";
      reg = <0x0e000000 0x5ffff>;
      nvidia,bpmp = <&bpmp>;
    };

  - |
    ccplex@30000000 {
      compatible = "nvidia,tegra264-ccplex-cluster";
      reg = <0x30000000 0xcf0000>;
      #performance-domain-cells = <1>;
      nvidia,bpmp = <&bpmp>;
    };
```

## Documentation/devicetree/bindings/display/imx/fsl,imx-fb-display.yaml
```yaml
# SPDX-License-Identifier: (GPL-2.0-only OR BSD-2-Clause)
%YAML 1.2
---
$id: http://devicetree.org/schemas/display/imx/fsl,imx-fb-display.yaml#
$schema: http://devicetree.org/meta-schemas/core.yaml#

title: Freescale i.MX framebuffer display

maintainers:
  - Fabio Estevam <festevam@gmail.com>

description:
  Legacy display nodes referenced by the display property of the i.MX
  LCD controller describe the panel and its interface configuration.

select:
  required:
    - fsl,pcr

allOf:
  - $ref: /schemas/display/panel/panel-common.yaml#

properties:
  model:
    $ref: /schemas/types.yaml#/definitions/string
    description: Display panel model name.

  bits-per-pixel:
    $ref: /schemas/types.yaml#/definitions/uint32
    description: Number of bits per pixel in the framebuffer.

  bus-width:
    $ref: /schemas/types.yaml#/definitions/uint32
    description: Number of data lines connected to the panel.

  fsl,pcr:
    $ref: /schemas/types.yaml#/definitions/uint32
    description: LCDC Panel Configuration Register value.

  fsl,aus-mode:
    type: boolean
    description: Enable AUS mode on i.MX21 and later LCD controllers.

required:
  - bits-per-pixel
  - display-timings
  - fsl,pcr

unevaluatedProperties: false

examples:
  - |
    display {
        model = "Primeview-PD050VL1";
        bits-per-pixel = <16>;
        fsl,pcr = <0xf0c88080>;

        display-timings {
            native-mode = <&timing0>;

            timing0: timing0 {
                hactive = <640>;
                vactive = <480>;
                hback-porch = <112>;
                hfront-porch = <36>;
                hsync-len = <32>;
                vback-porch = <33>;
                vfront-porch = <33>;
                vsync-len = <2>;
                clock-frequency = <25000000>;
            };
        };
    };
```

## Documentation/devicetree/bindings/dsp/asus,tf201-dsp.yaml
```yaml
# SPDX-License-Identifier: (GPL-2.0-only OR BSD-2-Clause)
%YAML 1.2
---
$id: http://devicetree.org/schemas/dsp/asus,tf201-dsp.yaml#
$schema: http://devicetree.org/meta-schemas/core.yaml#

title: Fortemedia FM34NE based voice processor

description:
  Fortemedia FM34NE is a hardware voice processor (DSP — Digital Signal
  Processor) designed by Fortemedia. It specializes in real-time audio
  processing, focusing on noise suppression and echo cancellation.

maintainers:
  - Svyatoslav Ryhel <clamor95@gmail.com>

properties:
  compatible:
    enum:
      - asus,sl101-dsp
      - asus,tf101-dsp
      - asus,tf201-dsp
      - asus,tf300t-dsp
      - asus,tf700t-dsp
      - pegatron,chagall-dsp

  reg:
    maxItems: 1

  clocks:
    items:
      - description: Master clock to the DSP

  reset-gpios:
    maxItems: 1

  bypass-gpios:
    maxItems: 1
    description: Signal that switches DSP into programming mode.

  vdd-supply: true

  port:
    $ref: /schemas/sound/audio-graph-port.yaml#
    unevaluatedProperties: false

required:
  - compatible
  - reg
  - bypass-gpios

unevaluatedProperties: false

examples:
  - |
    #include <dt-bindings/gpio/gpio.h>

    i2c {
        #address-cells = <1>;
        #size-cells = <0>;

        dsp@60 {
            compatible = "asus,tf201-dsp";
            reg = <0x60>;

            clocks = <&fm34ne_clk>;

            bypass-gpios = <&gpio 222 GPIO_ACTIVE_HIGH>;
            reset-gpios = <&gpio 115 GPIO_ACTIVE_LOW>;

            vdd-supply = <&vdd_1v8_dsp>;
        };
    };
...
```

## Documentation/devicetree/bindings/gpio/cortina,cs7542-gpio.yaml
```yaml
# SPDX-License-Identifier: (GPL-2.0-only OR BSD-2-Clause)
%YAML 1.2
---
$id: http://devicetree.org/schemas/gpio/cortina,cs7542-gpio.yaml#
$schema: http://devicetree.org/meta-schemas/core.yaml#

title: Cortina Systems CS7542 GPIO controller

maintainers:
  - Fil Dunsky <filipp.dunsky@gmail.com>

description:
  The Cortina Systems CS75xx (Goldengate G2) SoCs have five banks of 32
  GPIO lines, each with its own interrupt. Every pin is shared between a
  GPIO line and a peripheral function; the choice is made in the global
  control block and is not part of the GPIO controller.

properties:
  compatible:
    const: cortina,cs7542-gpio

  reg:
    maxItems: 1

  interrupts:
    maxItems: 1

  gpio-controller: true

  "#gpio-cells":
    const: 2

  gpio-line-names:
    maxItems: 32

  gpio-reserved-ranges: true

  interrupt-controller: true

  "#interrupt-cells":
    const: 2

required:
  - compatible
  - reg
  - interrupts
  - gpio-controller
  - "#gpio-cells"
  - interrupt-controller
  - "#interrupt-cells"

additionalProperties: false

examples:
  - |
    gpio@f00701f0 {
        compatible = "cortina,cs7542-gpio";
        reg = <0xf00701f0 0x20>;
        interrupt-parent = <&intc>;
        interrupts = <7>;
        gpio-controller;
        #gpio-cells = <2>;
        interrupt-controller;
        #interrupt-cells = <2>;
    };
```

## Documentation/devicetree/bindings/i2c/cortina,cs7542-i2c.yaml
```yaml
# SPDX-License-Identifier: (GPL-2.0-only OR BSD-2-Clause)
%YAML 1.2
---
$id: http://devicetree.org/schemas/i2c/cortina,cs7542-i2c.yaml#
$schema: http://devicetree.org/meta-schemas/core.yaml#

title: Cortina Systems CS7542 I2C controller

maintainers:
  - Fil Dunsky <filipp.dunsky@gmail.com>

description:
  The I2C ("Bi-Wire") controller of the Cortina Systems CS75xx (Goldengate
  G2) SoCs. It transfers one byte per command and runs from the peripheral
  (APB) clock through a 16-bit prescaler.

allOf:
  - $ref: /schemas/i2c/i2c-controller.yaml#

properties:
  compatible:
    const: cortina,cs7542-i2c

  reg:
    maxItems: 1

  clocks:
    maxItems: 1

  clock-frequency:
    maximum: 400000
    default: 100000

  interrupts:
    maxItems: 1

required:
  - compatible
  - reg
  - clocks
  - interrupts

unevaluatedProperties: false

examples:
  - |
    i2c@f00700e8 {
        compatible = "cortina,cs7542-i2c";
        reg = <0xf00700e8 0x28>;
        clocks = <&apb_clk>;
        clock-frequency = <400000>;
        interrupt-parent = <&intc>;
        interrupts = <11>;
        #address-cells = <1>;
        #size-cells = <0>;
    };
```

## Documentation/devicetree/bindings/interconnect/qcom,halliday-rpmh.yaml
```yaml
# SPDX-License-Identifier: (GPL-2.0-only OR BSD-2-Clause)
%YAML 1.2
---
$id: http://devicetree.org/schemas/interconnect/qcom,halliday-rpmh.yaml#
$schema: http://devicetree.org/meta-schemas/core.yaml#

title: Qualcomm RPMh Network-On-Chip Interconnect on Halliday

maintainers:
  - Stanislav Aleksandrov <lightofmysoul@gmail.com>

description: |
  RPMh interconnect providers support system bandwidth requirements through
  RPMh hardware accelerators known as Bus Clock Manager (BCM).

  See also: include/dt-bindings/interconnect/qcom,halliday-rpmh.h

properties:
  compatible:
    enum:
      - qcom,halliday-aggre1-noc
      - qcom,halliday-aggre2-noc
      - qcom,halliday-clk-virt
      - qcom,halliday-config-noc
      - qcom,halliday-gem-noc
      - qcom,halliday-lpass-ag-noc
      - qcom,halliday-mc-virt
      - qcom,halliday-mmss-noc
      - qcom,halliday-nsp-noc
      - qcom,halliday-pcie-anoc
      - qcom,halliday-system-noc

  reg:
    maxItems: 1

  clocks:
    minItems: 1
    maxItems: 3

required:
  - compatible

allOf:
  - $ref: qcom,rpmh-common.yaml#
  - if:
      properties:
        compatible:
          contains:
            enum:
              - qcom,halliday-clk-virt
              - qcom,halliday-mc-virt
    then:
      properties:
        reg: false
    else:
      required:
        - reg

  - if:
      properties:
        compatible:
          contains:
            enum:
              - qcom,halliday-aggre1-noc
    then:
      properties:
        clocks:
          items:
            - description: aggre UFS PHY AXI clock
            - description: aggre USB3 PRIM AXI clock

  - if:
      properties:
        compatible:
          contains:
            enum:
              - qcom,halliday-aggre2-noc
    then:
      properties:
        clocks:
          items:
            - description: RPMH CC IPA clock

  - if:
      properties:
        compatible:
          contains:
            enum:
              - qcom,halliday-pcie-anoc
    then:
      properties:
        clocks:
          items:
            - description: aggre-NOC PCIe AXI clock
            - description: cfg-NOC PCIe a-NOC AHB clock
            - description: aggre-NOC PCIe SF AXI clock

  - if:
      properties:
        compatible:
          contains:
            enum:
              - qcom,halliday-aggre1-noc
              - qcom,halliday-aggre2-noc
              - qcom,halliday-pcie-anoc
    then:
      required:
        - clocks
    else:
      properties:
        clocks: false

unevaluatedProperties: false

examples:
  - |
    interconnect-0 {
        compatible = "qcom,halliday-clk-virt";
        #interconnect-cells = <2>;
        qcom,bcm-voters = <&apps_bcm_voter>;
    };

    interconnect@16c0000 {
        compatible = "qcom,halliday-pcie-anoc";
        reg = <0x016c0000 0xc080>;
        clocks = <&aggre_noc_pcie_axi_clk>,
                 <&cfg_noc_pcie_anoc_ahb_clk>,
                 <&aggre_noc_pcie_sf_axi_clk>;
        #interconnect-cells = <2>;
        qcom,bcm-voters = <&apps_bcm_voter>;
    };
```

## Documentation/devicetree/bindings/interconnect/qcom,sm7250-rpmh.yaml
```yaml
# SPDX-License-Identifier: (GPL-2.0-only OR BSD-2-Clause)
%YAML 1.2
---
$id: http://devicetree.org/schemas/interconnect/qcom,sm7250-rpmh.yaml#
$schema: http://devicetree.org/meta-schemas/core.yaml#

title: Qualcomm RPMh Network-On-Chip Interconnect on SM7250

maintainers:
  - Ishu Brar <patches@brar.si>

description: |
  RPMh interconnect providers support system bandwidth requirements through
  RPMh hardware accelerators known as Bus Clock Manager (BCM). The provider is
  able to communicate with the BCM through the Resource State Coordinator (RSC)
  associated with each execution environment. Provider nodes must point to at
  least one RPMh device child node pertaining to their RSC and each provider
  can map to multiple RPMh resources.

  See also: include/dt-bindings/interconnect/qcom,sm7250-rpmh.h

properties:
  compatible:
    enum:
      - qcom,sm7250-aggre1-noc
      - qcom,sm7250-aggre2-noc
      - qcom,sm7250-config-noc
      - qcom,sm7250-dc-noc
      - qcom,sm7250-gem-noc
      - qcom,sm7250-mmss-noc
      - qcom,sm7250-npu-noc
      - qcom,sm7250-system-noc

  reg:
    maxItems: 1

  clocks:
    minItems: 1
    maxItems: 2

  interconnect:
    type: object
    description:
      Interconnect provider without a register space of its own. The
      compute-noc QoS registers are within the aggre2-noc register space.
      The mc-virt and qup-virt providers are virtual and have no registers.

    allOf:
      - $ref: qcom,rpmh-common.yaml#

    properties:
      compatible:
        enum:
          - qcom,sm7250-compute-noc
          - qcom,sm7250-mc-virt
          - qcom,sm7250-qup-virt

    required:
      - compatible

    unevaluatedProperties: false

required:
  - compatible
  - reg

allOf:
  - $ref: qcom,rpmh-common.yaml#
  - if:
      properties:
        compatible:
          contains:
            const: qcom,sm7250-aggre1-noc
    then:
      properties:
        clocks:
          items:
            - description: aggre UFS PHY AXI clock
            - description: aggre USB3 PRIM AXI clock
      required:
        - clocks

  - if:
      properties:
        compatible:
          contains:
            const: qcom,sm7250-aggre2-noc
    then:
      properties:
        clocks:
          items:
            - description: RPMH CC IPA clock
        interconnect:
          properties:
            compatible:
              const: qcom,sm7250-compute-noc
      required:
        - clocks

  - if:
      properties:
        compatible:
          contains:
            const: qcom,sm7250-gem-noc
    then:
      properties:
        interconnect:
          properties:
            compatible:
              const: qcom,sm7250-mc-virt

  - if:
      properties:
        compatible:
          contains:
            const: qcom,sm7250-system-noc
    then:
      properties:
        interconnect:
          properties:
            compatible:
              const: qcom,sm7250-qup-virt

  - if:
      properties:
        compatible:
          contains:
            enum:
              - qcom,sm7250-config-noc
              - qcom,sm7250-dc-noc
              - qcom,sm7250-gem-noc
              - qcom,sm7250-mmss-noc
              - qcom,sm7250-npu-noc
              - qcom,sm7250-system-noc
    then:
      properties:
        clocks: false

  - if:
      properties:
        compatible:
          contains:
            enum:
              - qcom,sm7250-aggre1-noc
              - qcom,sm7250-config-noc
              - qcom,sm7250-dc-noc
              - qcom,sm7250-mmss-noc
              - qcom,sm7250-npu-noc
    then:
      properties:
        interconnect: false

unevaluatedProperties: false

examples:
  - |
    interconnect@16e0000 {
        compatible = "qcom,sm7250-aggre1-noc";
        reg = <0x016e0000 0x15080>;
        #interconnect-cells = <2>;
        clocks = <&gcc 4>, <&gcc 5>;
        qcom,bcm-voters = <&apps_bcm_voter>;
    };

    interconnect@1620000 {
        compatible = "qcom,sm7250-system-noc";
        reg = <0x01620000 0x19200>;
        #interconnect-cells = <2>;
        qcom,bcm-voters = <&apps_bcm_voter>;

        interconnect {
            compatible = "qcom,sm7250-qup-virt";
            #interconnect-cells = <2>;
            qcom,bcm-voters = <&apps_bcm_voter>;
        };
    };
```
