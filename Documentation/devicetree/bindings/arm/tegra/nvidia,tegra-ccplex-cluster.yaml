## Documentation/devicetree/bindings/pinctrl/qcom,halliday-tlmm.yaml
```yaml
# SPDX-License-Identifier: (GPL-2.0-only OR BSD-2-Clause)
%YAML 1.2
---
$id: http://devicetree.org/schemas/pinctrl/qcom,halliday-tlmm.yaml#
$schema: http://devicetree.org/meta-schemas/core.yaml#

title: Qualcomm Technologies, Inc. Halliday TLMM block

maintainers:
  - Stanislav Aleksandrov <lightofmysoul@gmail.com>

description:
  Top Level Mode Multiplexer pin controller in Qualcomm Halliday SoC.

allOf:
  - $ref: /schemas/pinctrl/qcom,tlmm-common.yaml#

properties:
  compatible:
    const: qcom,halliday-tlmm

  reg:
    maxItems: 1

  interrupts:
    maxItems: 1

  gpio-reserved-ranges:
    minItems: 1
    maxItems: 112

  gpio-line-names:
    maxItems: 224

patternProperties:
  "-state$":
    oneOf:
      - $ref: "#/$defs/qcom-halliday-tlmm-state"
      - patternProperties:
          "-pins$":
            $ref: "#/$defs/qcom-halliday-tlmm-state"
        additionalProperties: false

$defs:
  qcom-halliday-tlmm-state:
    type: object
    description:
      Pinctrl node's client devices use subnodes for desired pin configuration.
      Client device subnodes use below standard properties.
    $ref: qcom,tlmm-common.yaml#/$defs/qcom-tlmm-state
    unevaluatedProperties: false

    properties:
      pins:
        description:
          List of gpio pins affected by the properties specified in this
          subnode.
        items:
          oneOf:
            - pattern: "^gpio([0-9]|[1-9][0-9]|1[0-9][0-9]|2[01][0-9]|22[0-3])$"
            - enum: [ ufs_reset, sdc2_clk, sdc2_cmd, sdc2_data ]
        minItems: 1
        maxItems: 36

      function:
        description:
          Specify the alternative function to be configured for the specified
          pins.
        enum: [ atest_char, atest_usb, audio_ext_mclk0, audio_ext_mclk1,
                audio_ref_clk, cam_mclk, cci_async_in, cci_i2c_scl,
                cci_i2c_sda, cci_timer, cmu_rng, dbg_out_clk,
                ddr_bist_complete, ddr_bist_fail, ddr_bist_start,
                ddr_bist_stop, ddr_pxi0, ddr_pxi1, ddr_pxi2, ddr_pxi3, dp0_hot,
                edp0_hot, edp0_lcd_self, edp1_dpu0_lcd, edp1_dpu1_lcd,
                edp1_hot, egpio, gcc_gp1, gcc_gp10, gcc_gp11, gcc_gp2, gcc_gp3,
                gcc_gp4, gcc_gp5, gcc_gp6, gcc_gp7, gcc_gp8, gcc_gp9, gpio,
                i2s0_data0, i2s0_data1, i2s0_sck, i2s0_ws, i2s2_data0,
                i2s2_data1, i2s2_sck, i2s2_ws, ibi_i3c, jitter_bist,
                mdp0_vsync, mdp0_vsync0_out, mdp0_vsync1_out, mdp0_vsync2_out,
                mdp0_vsync3_out, mdp0_vsync4_out, mdp0_vsync5_out,
                mdp0_vsync6_out, mdp0_vsync7_out, mdp0_vsync8_out, mdp1_vsync,
                mdp1_vsync0_out, mdp1_vsync1_out, mdp1_vsync2_out,
                mdp1_vsync3_out, mdp1_vsync4_out, mdp1_vsync5_out,
                mdp1_vsync6_out, mdp1_vsync7_out, mdp1_vsync8_out,
                pcie0_clk_req_n, pcie1_clk_req_n, pcie2_clk_req_n, phase_flag,
                pll_bist_sync, pll_clk_aux, prng_rosc0, prng_rosc1, prng_rosc2,
                prng_rosc3, pwm_0, pwm_1, pwm_10, pwm_11, pwm_12, pwm_13,
                pwm_14, pwm_15, pwm_16, pwm_17, pwm_18, pwm_19, pwm_2, pwm_3,
                pwm_4, pwm_5, pwm_6, pwm_7, pwm_8, pwm_9, qdss_cti, qdss_gpio,
                qup0_se0, qup0_se1, qup0_se2, qup0_se3, qup0_se4,
                qup0_se4_l0_mira, qup0_se4_l0_mirb, qup0_se4_l1_mira,
                qup0_se4_l1_mirb, qup0_se4_l2_mira, qup0_se4_l2_mirb,
                qup0_se4_l3_mira, qup0_se4_l3_mirb, qup0_se5, qup0_se6,
                qup1_se0, qup1_se0_l3_mira, qup1_se0_l3_mirb, qup1_se1,
                qup1_se1_l3_mira, qup1_se1_l3_mirb, qup1_se2, qup1_se2_l3_mira,
                qup1_se2_l3_mirb, qup1_se3, qup1_se3_l3_mira, qup1_se3_l3_mirb,
                qup1_se4, qup1_se5, qup1_se6, qup1_se6_l0_mira,
                qup1_se6_l0_mirb, qup1_se6_l1_mira, qup1_se6_l1_mirb,
                sd_write_protect, sdcc5_vdd2_on, tb_trig_sdc2, tgu_ch0_trigout,
                tgu_ch1_trigout, tgu_ch2_trigout, tgu_ch3_trigout, tmess_prng0,
                tmess_prng1, tmess_prng2, tmess_prng3, tsense_pwm1,
                tsense_pwm2, usb0_phy_ps, usb2phy_ac_en,
                vsense_trigger_mirnat ]

    required:
      - pins

required:
  - compatible
  - reg

unevaluatedProperties: false

examples:
  - |
    #include <dt-bindings/interrupt-controller/arm-gic.h>
    tlmm: pinctrl@f100000 {
        compatible = "qcom,halliday-tlmm";
        reg = <0x0f100000 0x300000>;
        gpio-controller;
        #gpio-cells = <2>;
        gpio-ranges = <&tlmm 0 0 225>;
        interrupt-controller;
        #interrupt-cells = <2>;
        interrupts = <GIC_SPI 208 IRQ_TYPE_LEVEL_HIGH>;

        gpio-wo-state {
            pins = "gpio1";
            function = "gpio";
        };

        i2c-w-state {
            scl-pins {
                pins = "gpio58";
                function = "qup1_se0";
                bias-pull-up;
            };

            sda-pins {
                pins = "gpio57";
                function = "qup1_se0";
                bias-pull-up;
            };
        };
    };
...
```

## Documentation/devicetree/bindings/pinctrl/zhihe,a210-pinctrl.yaml
```yaml
# SPDX-License-Identifier: (GPL-2.0-only OR BSD-2-Clause)
%YAML 1.2
---
$id: http://devicetree.org/schemas/pinctrl/zhihe,a210-pinctrl.yaml#
$schema: http://devicetree.org/meta-schemas/core.yaml#

title: Zhihe A210 pin controller

maintainers:
  - Zhiguo Zhu <zhiguo.zhu@linux.alibaba.com>
  - Han Gao <gaohan@iscas.ac.cn>

description: |
  Pinmux and pinconf controller of the Zhihe A210 RISC-V SoC.

  Most pads of the A210 are split into three groups, each managed by its
  own pad controller with a separate register range:

    AON pad controller   -> zhihe,a210-aon-pinctrl
    Peripheral 1 pads    -> zhihe,a210-peri1-pinctrl
    Peripheral 2 pads    -> zhihe,a210-peri2-pinctrl

  Each pad can be muxed individually to up to 8 different functions,
  though for most pads only a few of those settings are valid. A few pads
  in the AON group do not support muxing or configuration at all.

  The pads support configurable drive strength, bias, input enable,
  Schmitt trigger and slew rate.

properties:
  compatible:
    enum:
      - zhihe,a210-aon-pinctrl
      - zhihe,a210-peri1-pinctrl
      - zhihe,a210-peri2-pinctrl

  reg:
    maxItems: 1

  clocks:
    maxItems: 1

  clock-names:
    const: pclk

  resets:
    maxItems: 1

patternProperties:
  '-[0-9]+$':
    type: object

    description:
      A pinmux group referenced by a consumer's pinctrl phandle. It
      contains one subnode per set of pads sharing the same pinmux and
      pinconf settings.

    additionalProperties: false

    patternProperties:
      '-pins$':
        type: object
        $ref: /schemas/pinctrl/pincfg-node.yaml#

        description:
          A pinctrl node describing the pinmux and pinconf settings of
          one or more pads.

        properties:
          pins:
            $ref: /schemas/pinctrl/pinmux-node.yaml#/properties/pins
            description: List of pads that properties in the node apply to.

          function:
            $ref: /schemas/pinctrl/pinmux-node.yaml#/properties/function
            enum: [ aouart, aouart_ir, aogpio, aoi2c, aospi, jtag, reset,
                    por, pmic, dvs, uart0, uart1, uart2, uart3, uart4,
                    uart5, uart6, uart7, uart8, uart9, uart_ir, gpio,
                    gmac0, gmac1, spi, qspi, pwm, can, i2s0, i2s1, i2s2,
                    i2s3, i2c0, i2c1, i2c2, i2c3, i2c4, i2c5, i2c6, i2c7,
                    i2c7_smb, sdio, isp0, dptx, usb31, sata, hdmi, zmac,
                    bsel, dbgm, cdbg, pdm, tdm, pcie, sen_vclk ]
            description: |
              The mux function to select for the given pins. Functions of
              the same kind share one name, such as spi or pwm, unless a
              pad can select more than one instance. For example GPIO0_16
              selects UART0 or UART1, so the UARTs are named uart0 to
              uart9.

          bias-disable: true

          bias-pull-up: true

          bias-pull-down: true

          drive-strength:
            minimum: 1
            maximum: 25
            description:
              Drive strength in mA. The pads support 1, 2, 3, 5, 7, 8, 10,
              12, 13, 15, 16, 18, 20, 21, 23 and 25 mA. Other values select
              the next higher strength.

          input-enable: true

          input-disable: true

          input-schmitt-enable: true

          input-schmitt-disable: true

          slew-rate:
            maximum: 1

        required:
          - pins

        additionalProperties: false

required:
  - compatible
  - reg
  - clocks
  - clock-names

additionalProperties: false

examples:
  - |
    pinctrl@2026000 {
        compatible = "zhihe,a210-peri1-pinctrl";
        reg = <0x2026000 0x1000>;
        clocks = <&clk 0>;
        clock-names = "pclk";

        gmac0-0 {
            gmac0-pins {
                pins = "GPIO0_0", "GPIO0_12";
                function = "gmac0";
                bias-disable;
                drive-strength = <13>;
                input-disable;
                input-schmitt-disable;
                slew-rate = <0>;
            };
        };
    };
```

## Documentation/devicetree/bindings/power/supply/siliconmitus,sm5714-fuel-gauge.yaml
```yaml
# SPDX-License-Identifier: (GPL-2.0-only OR BSD-2-Clause)
%YAML 1.2
---
$id: http://devicetree.org/schemas/power/supply/siliconmitus,sm5714-fuel-gauge.yaml#
$schema: http://devicetree.org/meta-schemas/core.yaml#

title: Silicon Mitus SM5714 fuel gauge

maintainers:
  - Nizat Mikayilli <nacht@dxdmail.cc>

description:
  The Silicon Mitus SM5714 includes a MUIC, a battery charger with a flash LED
  driver and a fuel gauge, each on its own I2C address. The fuel gauge measures
  the battery voltage and current and estimates the state of charge.

allOf:
  - $ref: power-supply.yaml#

properties:
  compatible:
    const: siliconmitus,sm5714-fuel-gauge

  reg:
    maxItems: 1

  interrupts:
    maxItems: 1

required:
  - compatible
  - reg

unevaluatedProperties: false

examples:
  - |
    i2c {
        #address-cells = <1>;
        #size-cells = <0>;

        fuel-gauge@71 {
            compatible = "siliconmitus,sm5714-fuel-gauge";
            reg = <0x71>;
            monitored-battery = <&battery>;
        };
    };
```
