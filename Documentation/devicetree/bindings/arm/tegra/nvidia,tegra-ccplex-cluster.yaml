## Documentation/devicetree/bindings/net/dptel,dap8211r.yaml
```yaml
# SPDX-License-Identifier: (GPL-2.0-only OR BSD-2-Clause)
%YAML 1.2
---
$id: http://devicetree.org/schemas/net/dptel,dap8211r.yaml#
$schema: http://devicetree.org/meta-schemas/core.yaml#

title: DAPU Telecom DAP8211R(I) Gigabit Ethernet PHY

maintainers:
  - Artem Shimko <a.shimko.dev@gmail.com>

description: |
  The DAP8211R(I) is a Gigabit Ethernet PHY with RGMII interface,
  supporting IEEE 802.3az Energy Efficient Ethernet, IEEE 1588 SyncE,
  and an internal packet generator for diagnostics.

  Specifications:
    - 10BASE-Te, 100BASE-TX, 1000BASE-T
    - RGMII with configurable TX/RX clock delays (150 ps steps, 0-2250 ps)
    - IEEE 802.3az-2010 Energy Efficient Ethernet
    - IEEE 1588 SyncE support
    - Internal packet generator and checker for link diagnostics
    - Three configurable LEDs (link, speed, duplex, TX/RX activity)

allOf:
  - $ref: ethernet-phy.yaml#

properties:
  compatible:
    const: ethernet-phy-id0008.011b

  reg:
    maxItems: 1

  rx-internal-delay-ps:
    description:
      RGMII RX clock delay in picoseconds (0 to maximum).
    multipleOf: 150
    maximum: 2250
    default: 1950

  tx-internal-delay-ps:
    description:
      RGMII TX clock delay in picoseconds (0 to maximum).
    multipleOf: 150
    maximum: 2250
    default: 1950

  leds:
    type: object

    properties:
      '#address-cells':
        const: 1
      '#size-cells':
        const: 0

    patternProperties:
      '^led@[0-2]$':
        type: object
        properties:
          reg:
            items:
              maximum: 2

    additionalProperties: false

unevaluatedProperties: false

examples:
  - |
    #include <dt-bindings/leds/common.h>

    mdio {
        #address-cells = <1>;
        #size-cells = <0>;

        ethernet-phy@1 {
            compatible = "ethernet-phy-id0008.011b";
            reg = <1>;
            rx-internal-delay-ps = <1950>;
            tx-internal-delay-ps = <1950>;

            leds {
                #address-cells = <1>;
                #size-cells = <0>;

                led@0 {
                    reg = <0>;
                    color = <LED_COLOR_ID_GREEN>;
                    function = LED_FUNCTION_LAN;
                    linux,default-trigger = "netdev";
                };

                led@1 {
                    reg = <1>;
                    color = <LED_COLOR_ID_AMBER>;
                    function = LED_FUNCTION_LAN;
                    linux,default-trigger = "netdev";
                };
            };
        };
    };
```

## Documentation/devicetree/bindings/nvmem/layouts/fixed-cell.yaml
```yaml
# SPDX-License-Identifier: (GPL-2.0-only OR BSD-2-Clause)
%YAML 1.2
---
$id: http://devicetree.org/schemas/nvmem/layouts/fixed-cell.yaml#
$schema: http://devicetree.org/meta-schemas/core.yaml#

title: Fixed offset & size NVMEM cell

maintainers:
  - Rafał Miłecki <rafal@milecki.pl>
  - Srinivas Kandagatla <srinivas.kandagatla@linaro.org>

properties:
  compatible:
    oneOf:
      - const: mac-base
        description: >
          Cell with base MAC address to be used for calculating extra relative
          addresses.
          It can be stored in a plain binary format (cell length 6) or as an
          ASCII text like "00:11:22:33:44:55" (cell length 17).
      - const: rockchip,cpuid
        description: >
          Cell with the unique CPU ID of a Rockchip SoC (cell length 16).
          A consumer referencing it as its "mac-address" NVMEM cell, as
          Ethernet controllers do, refers to a stable MAC address derived from
          the CPU ID rather than to the CPU ID itself. The base of such
          addresses consists of the first six octets of the SHA-256 digest of
          the 32-character string of lowercase hexadecimal digits representing
          the 16 CPU ID bytes in stored order, without separators or a
          terminator. In the first octet, the multicast bit (bit 0) is then
          cleared and the locally administered bit (bit 1) set. Any other
          reference to the cell refers to the CPU ID as stored.

  reg:
    maxItems: 1

  bits:
    $ref: /schemas/types.yaml#/definitions/uint32-array
    items:
      - minimum: 0
        maximum: 31
        description:
          Offset in bit within the address range specified by reg.
      - minimum: 1
        description:
          Size in bit within the address range specified by reg.

allOf:
  - if:
      properties:
        compatible:
          contains:
            const: mac-base
      required: [ compatible ]
    then:
      properties:
        "#nvmem-cell-cells":
          description: The first argument is a MAC address offset.
          const: 1
      required:
        - "#nvmem-cell-cells"
  - if:
      properties:
        compatible:
          contains:
            const: rockchip,cpuid
      required: [ compatible ]
    then:
      properties:
        reg:
          items:
            - items:
                - description: Offset of the CPU ID
                - const: 16
        "#nvmem-cell-cells":
          description:
            For a "mac-address" reference, the first argument is the index of
            the MAC address, which is XORed into the last octet of the base
            address. It is ignored for any other reference.
          const: 1
      required:
        - "#nvmem-cell-cells"

required:
  - reg

additionalProperties: true
```

## Documentation/devicetree/bindings/phy/airoha,an7581-usb-phy.yaml
```yaml
# SPDX-License-Identifier: GPL-2.0-only OR BSD-2-Clause
%YAML 1.2
---
$id: http://devicetree.org/schemas/phy/airoha,an7581-usb-phy.yaml#
$schema: http://devicetree.org/meta-schemas/core.yaml#

title: Airoha AN7581 SoC USB PHY

maintainers:
  - Christian Marangi <ansuelsmth@gmail.com>

description: >
  The Airoha AN7581 SoC USB PHY describes the USB PHY for the USB controller.

  Airoha AN7581 SoC support a maximum of 2 USB port. The USB 2.0 mode is
  always supported. The USB 3.0 mode is optional and depends on the Serdes
  mode currently configured on the system for the relevant USB port.

properties:
  compatible:
    const: airoha,an7581-usb-phy

  reg:
    maxItems: 1

  airoha,usb2-monitor-clk-sel:
    description: Describe what oscillator across the available 4
      should be selected for USB 2.0 Slew Rate calibration.
    $ref: /schemas/types.yaml#/definitions/uint32
    enum: [0, 1, 2, 3]

  phys:
    items:
      - description: phandle to Serdes PHY. Optional if USB 3.0 is not used.

  '#phy-cells':
    description: The cell contains the mode, PHY_TYPE_USB2 or PHY_TYPE_USB3,
      as defined in dt-bindings/phy/phy.h.
    const: 1

required:
  - compatible
  - reg
  - airoha,usb2-monitor-clk-sel
  - '#phy-cells'

additionalProperties: false

examples:
  - |
    #include <dt-bindings/soc/airoha,scu-ssr.h>

    phy@1fac0000 {
        compatible = "airoha,an7581-usb-phy";
        reg = <0x1fac0000 0x10000>;

        airoha,usb2-monitor-clk-sel = <1>;
        phys = <&scu AIROHA_SCU_SERDES_USB1>;

        #phy-cells = <1>;
    };
```

## Documentation/devicetree/bindings/phy/cix,sky1-dp-phy.yaml
```yaml
# SPDX-License-Identifier: (GPL-2.0-only OR BSD-2-Clause)
%YAML 1.2
---
$id: http://devicetree.org/schemas/phy/cix,sky1-dp-phy.yaml#
$schema: http://devicetree.org/meta-schemas/core.yaml#

title: CIX Sky1 DisplayPort PHY

maintainers:
  - Luo Liu <Luo.Liu@cixtech.com>

description:
  The CIX Sky1 DP PHY provides the PMA/CDB register interface for the
  dedicated DisplayPort instance on CIX Sky1.

  The PHY APB clock is physically shared with the DPTx controller.

properties:
  compatible:
    const: cix,sky1-dp-phy

  reg:
    maxItems: 1

  clocks:
    maxItems: 1
    description: APB register interface clock

  clock-names:
    const: apb

  resets:
    maxItems: 1
    description: PHY hardware reset

  "#phy-cells":
    const: 0

  cix,external-dp:
    type: boolean
    description:
      Use voltage swing values suitable for an external DisplayPort
      connector instead of the default low-voltage values.

required:
  - compatible
  - reg
  - clocks
  - clock-names
  - resets
  - "#phy-cells"

additionalProperties: false

examples:
  - |
    #include <dt-bindings/clock/cix,sky1.h>
    #include <dt-bindings/reset/cix,sky1-s5-system-control.h>

    phy@1414c000 {
        compatible = "cix,sky1-dp-phy";
        reg = <0x1414c000 0x4000>;
        clocks = <&scmi_clk CLK_TREE_DPC2_APBCLK>;
        clock-names = "apb";
        resets = <&s5_syscon SKY1_DP_PHY_RST_N>;
        #phy-cells = <0>;
    };
```

## Documentation/devicetree/bindings/phy/fsl,lynx-10g.yaml
```yaml
# SPDX-License-Identifier: (GPL-2.0-only OR BSD-2-Clause)
%YAML 1.2
---
$id: http://devicetree.org/schemas/phy/fsl,lynx-10g.yaml#
$schema: http://devicetree.org/meta-schemas/core.yaml#

title: Freescale Lynx 10G SerDes PHY

maintainers:
  - Vladimir Oltean <vladimir.oltean@nxp.com>

description:
  The 10G Lynx is a multi-protocol SerDes block which handles networking, PCIe,
  SATA and other high-speed interfaces. It is present on most QorIQ and
  Layerscape SoCs. The register map is common, but the integration is
  SoC-specific, with the differences consisting in register endianness, the
  number of lanes, protocol converters available per lane and their location in
  the PCCR registers. Some SoCs have multiple SerDes blocks and those differ in
  their protocol capabilities per lane.

properties:
  compatible:
    enum:
      - fsl,ls1028a-serdes
      - fsl,ls1046a-serdes1
      - fsl,ls1046a-serdes2
      - fsl,ls1088a-serdes1
      - fsl,ls1088a-serdes2
      - fsl,ls2088a-serdes1
      - fsl,ls2088a-serdes2

  reg:
    maxItems: 1

  big-endian: true

  "#phy-cells":
    const: 1

  "#address-cells":
    const: 1

  "#size-cells":
    const: 0

patternProperties:
  "^phy@[0-7]$":
    type: object
    description: SerDes lane (single RX/TX differential pair)

    properties:
      reg:
        minimum: 0
        maximum: 7
        description: Lane index as seen in register map

      "#phy-cells":
        const: 0

      phys:
        description:
          PHYs on the signal path between the lane and the connector, such as a
          signal retimer. A retimer can be modeled with a PHY device per
          channel / direction.

      phy-names:
        description:
          Optional names for the entries of "phys", for example to tell the
          channels of a retimer apart.

    required:
      - reg
      - "#phy-cells"

    dependencies:
      phy-names: [ phys ]

    additionalProperties: false

required:
  - compatible
  - reg
  - "#phy-cells"
  - "#address-cells"
  - "#size-cells"

allOf:
  - if:
      properties:
        compatible:
          contains:
            enum:
              - fsl,ls1028a-serdes
              - fsl,ls1046a-serdes1
              - fsl,ls1046a-serdes2
              - fsl,ls1088a-serdes1
              - fsl,ls1088a-serdes2
    then:
      patternProperties:
        "^phy@[0-7]$":
          properties:
            reg:
              minimum: 0
              maximum: 3
  - if:
      properties:
        compatible:
          enum:
            - fsl,ls1046a-serdes1
            - fsl,ls1046a-serdes2
    then:
      required:
        - big-endian
    else:
      properties:
        big-endian: false

additionalProperties: false

examples:
  - |
    soc {
      #address-cells = <2>;
      #size-cells = <2>;

      serdes@1ea0000 {
        compatible = "fsl,ls1028a-serdes";
        reg = <0x0 0x1ea0000 0x0 0xffff>;
        #address-cells = <1>;
        #size-cells = <0>;
        #phy-cells = <1>;

        phy@0 {
          reg = <0>;
          #phy-cells = <0>;
          phys = <&retimer 0>, <&retimer 1>;
          phy-names = "tx", "rx";
        };

        phy@1 {
          reg = <1>;
          #phy-cells = <0>;
        };

        phy@2 {
          reg = <2>;
          #phy-cells = <0>;
        };

        phy@3 {
          reg = <3>;
          #phy-cells = <0>;
        };
      };
    };

    i2c {
      #address-cells = <1>;
      #size-cells = <0>;

      retimer: retimer@18 {
        compatible = "ti,ds125df111";
        reg = <0x18>;
        #phy-cells = <1>;
      };
    };
```

## Documentation/devicetree/bindings/phy/rockchip,rk3568-edp-phy.yaml
```yaml
# SPDX-License-Identifier: (GPL-2.0-only OR BSD-2-Clause)
%YAML 1.2
---
$id: http://devicetree.org/schemas/phy/rockchip,rk3568-edp-phy.yaml#
$schema: http://devicetree.org/meta-schemas/core.yaml#

title: Rockchip eDP Transmitter PHY with Naneng IP block

maintainers:
  - Damon Ding <damon.ding@rock-chips.com>
  - Heiko Stuebner <heiko@sntech.de>

description:
  On the RK3568 SoC the eDP PHY is controlled through the eDP PHY GRF
  registers, therefore the PHY node is expected to be a child of the
  eDP PHY GRF syscon node.

properties:
  compatible:
    const: rockchip,rk3568-edp-phy

  reg:
    maxItems: 1
    description: PHY registers within the eDP PHY GRF.

  clocks:
    items:
      - description: Reference clock from the PMU CRU
      - description: APB clock gating the PHY register window

  clock-names:
    items:
      - const: ref
      - const: apb

  "#phy-cells":
    const: 0

required:
  - compatible
  - reg
  - clocks
  - clock-names
  - "#phy-cells"

additionalProperties: false
```
