## Documentation/devicetree/bindings/regulator/ti,lm51772.yaml
```yaml
# SPDX-License-Identifier: (GPL-2.0-only OR BSD-2-Clause)
%YAML 1.2
---
$id: http://devicetree.org/schemas/regulator/ti,lm51772.yaml#
$schema: http://devicetree.org/meta-schemas/core.yaml#

title: TI LM51772 buck-boost voltage regulator

maintainers:
  - Paul Louvel <paul.louvel@bootlin.com>

description: |
  The LM51772 is a buck-boost controller with I2C control, designed for
  USB Power Delivery applications. The output voltage is software
  configurable between 1V to 48V, with:

    – 1V up to 24V in 10mV monotonous steps.
    – 3.3V up to 48V in 20mV monotonous steps.

  The LM51772 also provides an auxiliary fixed 5 V regulator output
  (VCC1).

properties:
  compatible:
    const: ti,lm51772

  reg:
    maxItems: 1

  interrupts:
    maxItems: 1
    description: Fault / warning irq.

  vin-supply:
    description: Regulator supply for the chip.

  regulators:
    type: object
    description: List of regulators provided by this PMIC.
    additionalProperties: false

    properties:
      vout:
        type: object
        $ref: regulator.yaml#
        description: Main output voltage.
        unevaluatedProperties: false

        properties:
          ti,active-discharge-strength-microamp:
            description: Discharge current for VOUT.
            multipleOf: 25000
            minimum: 25000
            maximum: 75000
            default: 25000

          ti,pcm-window-low-permille:
            description: |
              When VIN is inside a programmable window around VOUT, the PWM
              logic stops switching entirely and the regulator connect VIN to VOUT.
              This mode is called the Programmable Conduction Mode (PCM), and is an
              efficiency features allowing the unit to avoid unnecessary switching
              operation when VIN ≈ VOUT.

              Lower threshold of the Programmable Conduction Mode (PCM)
              window, expressed in permille (1/1000) below VOUT target.
              If this property is zero, PCM is disabled.
            $ref: /schemas/types.yaml#/definitions/uint32
            multipleOf: 25
            minimum: 0
            maximum: 775
            default: 300

          regulator-temp-warn-kelvin:
            enum: [0, 1, 368, 383, 398, 413]

          regulator-ramp-delay:
            enum: [40000, 20000, 1000, 500]

          regulator-min-microvolt:
            minimum: 1000000
            maximum: 48000000

          regulator-max-microvolt:
            minimum: 1000000
            maximum: 48000000

          regulator-min-microamp:
            minimum: 500000
            maximum: 7000000

          regulator-max-microamp:
            minimum: 500000
            maximum: 7000000

      vcc1:
        type: object
        $ref: regulator.yaml#
        description: |
          LDO regulator for auxiliary use.
          It can used to power, for example, a PD controller that will drive this PMIC.
        unevaluatedProperties: false

        properties:
          regulator-min-microvolt:
            minimum: 5000000
            maximum: 5000000

          regulator-max-microvolt:
            minimum: 5000000
            maximum: 5000000

  ti,sync-pin:
    description: |
      Selects the function of the SYNC pin, used when several converters
      operate in parallel.
    $ref: /schemas/types.yaml#/definitions/string
    enum: [input-rising, input-falling, output-rising, output-falling]
    default: input-rising

  ti,ivp-thres-microvolt:
    description: |
      Input Overvoltage Protection and Regulation Threshold.
      It shall avoid any damage to the device in case the current flows from the
      output to the input and the input source cannot sink current.
      This threshold is used for IVP (Input Voltage Protection) and IVR (Input
      Voltage Regulation).
    oneOf:
      - multipleOf: 125000
        minimum: 4750000
        maximum: 23250000
      - multipleOf: 250000
        minimum: 23500000
        maximum: 50000000
    default: 50000000

  ti,input-voltage-mode:
    description: |
      Select the input voltage mode.

      In protection mode, the input voltage protection (IVP) is enabled:
      the converter stops switching when the input voltage reaches the
      threshold.

      In regulation mode, the input voltage regulation (IVR) is enabled:
      the input voltage is regulated at the threshold by limiting the
      current.
    $ref: /schemas/types.yaml#/definitions/string
    enum: [protection, regulation]

  ti,nint:
    description: |
      Configures the nFLT/nINT pin to act as an interrupt pin.

      nFLT mode: The pin remains low until the cause of the status change ceases.
      In this mode use an level irq trigger.

      nINT mode: The pin is asserted low to signal a status change.
      In this mode use an edge irq trigger.
    type: boolean

  ti,iset-pin:
    description: |
      Select the ISET pin as the source of the current limit, instead of
      the ILIM DAC. When this property is present, the ISET pin is forced
      in its active configuration and the ILIM DAC is disabled, so the
      current limit can no longer be programmed through the
      dedicated register.
    type: boolean

  shunt-resistor-micro-ohms:
    description: |
      Value of the current sense resistor connected between the ISNSP
      and ISNSN pins, used to translate the ILIM threshold voltage into
      a current limit and vice versa.
      TI recommands a value of 10000.
    default: 10000

  ti,cable-drop-compensation:
    description: |
      The cable drop compensation feature helps to keep the output voltage at the
      nominal value over a wide range of load current without the need for
      additional remote sensing. The cable drop compensation measures the
      current and offsets the output voltage proportionally to the measured
      current.
    type: boolean

required:
  - compatible
  - reg
  - interrupts

additionalProperties: false

examples:
  - |
    #include <dt-bindings/interrupt-controller/irq.h>

    i2c {
        #address-cells = <1>;
        #size-cells = <0>;

        pmic@6a {
            compatible = "ti,lm51772";
            reg = <0x6a>;
            interrupt-parent = <&irqc>;
            interrupts = <1 IRQ_TYPE_EDGE_FALLING>;

            ti,nint;

            regulators {
                vcc1 {
                    regulator-max-microvolt = <5000000>;
                    regulator-min-microvolt = <5000000>;
                    regulator-name = "vcc1";
                };

                vout {
                    regulator-max-microamp = <5000000>;
                    regulator-max-microvolt = <20000000>;
                    regulator-min-microamp = <1000000>;
                    regulator-min-microvolt = <5000000>;
                    regulator-name = "vout";
                    regulator-ov-protection-microvolt = <1000000>;
                    regulator-temp-warn-kelvin = <368>;
                };
            };
        };
    };
...
```

## Documentation/devicetree/bindings/regulator/willsemi,wl2868c.yaml
```yaml
# SPDX-License-Identifier: (GPL-2.0-only OR BSD-2-Clause)
%YAML 1.2
---
$id: http://devicetree.org/schemas/regulator/willsemi,wl2868c.yaml#
$schema: http://devicetree.org/meta-schemas/core.yaml#

title: Will Semiconductor WL2868C camera power management IC

maintainers:
  - Qianhui Xu <xiaqinghuan@mail.ustc.edu.cn>

description: >
  The WL2868C is a camera power management IC with seven programmable LDOs.
  LDO1 and LDO2 share the VIN12 input and cover 0.496 V to 1.512 V; LDO3 and
  LDO4 share VIN34, and LDO5 to LDO7 have one input each, covering 1.504 V to
  3.544 V. All outputs are programmable in 8 mV steps.

  VIN7 and VSYS feed the internal control logic, which is powered from the
  higher of the two, so at least one of them has to be connected. The other
  inputs only feed LDOs, so an input may be left unconnected on a board that
  does not use the outputs it feeds, which is why they are not mandatory.

properties:
  compatible:
    const: willsemi,wl2868c

  reg:
    maxItems: 1

  reset-gpios:
    maxItems: 1
    description: Active-low RST_N input.

  vin12-supply:
    description: Input supply for LDO1 and LDO2.

  vin34-supply:
    description: Input supply for LDO3 and LDO4.

  vin5-supply:
    description: Input supply for LDO5.

  vin6-supply:
    description: Input supply for LDO6.

  vin7-supply:
    description: >
      Input supply for LDO7 and one of the two supplies of the internal
      control logic.

  vsys-supply:
    description: >
      System supply, the other supply of the internal control logic. The
      control logic is powered from the higher of VIN7 and VSYS.

  regulators:
    type: object
    additionalProperties: false

    patternProperties:
      "^ldo[1-7]$":
        type: object
        $ref: regulator.yaml#
        unevaluatedProperties: false

required:
  - compatible
  - reg
  - regulators

anyOf:
  - required:
      - vin7-supply
  - required:
      - vsys-supply

additionalProperties: false

examples:
  - |
    i2c {
        #address-cells = <1>;
        #size-cells = <0>;

        pmic@2f {
            compatible = "willsemi,wl2868c";
            reg = <0x2f>;
            vsys-supply = <&vreg_vsys>;
            vin12-supply = <&vreg_vin12>;

            regulators {
                ldo1 {
                    regulator-max-microvolt = <1128000>;
                    regulator-min-microvolt = <1128000>;
                };
            };
        };
    };
...
```

## Documentation/devicetree/bindings/soc/rockchip/rockchip,rk3568-edp-phy-grf.yaml
```yaml
# SPDX-License-Identifier: (GPL-2.0-only OR BSD-2-Clause)
%YAML 1.2
---
$id: http://devicetree.org/schemas/soc/rockchip/rockchip,rk3568-edp-phy-grf.yaml#
$schema: http://devicetree.org/meta-schemas/core.yaml#

title: Rockchip eDP PHY GRF on the RK3568 SoC

maintainers:
  - Damon Ding <damon.ding@rock-chips.com>
  - Heiko Stuebner <heiko@sntech.de>

description:
  The eDP PHY GRF is a dedicated register file on the RK3568 SoC,
  holding the registers used by the eDP Transmitter PHY with Naneng IP
  block. The PHY itself is modeled as a child node, with its reg
  property describing the PHY register window inside the GRF.

properties:
  compatible:
    items:
      - const: rockchip,rk3568-edp-phy-grf
      - const: syscon
      - const: simple-mfd

  reg:
    maxItems: 1

  clocks:
    maxItems: 1

  "#address-cells":
    const: 1

  "#size-cells":
    const: 1

  ranges: true

patternProperties:
  "^phy@[0-9a-f]+$":
    type: object
    $ref: /schemas/phy/rockchip,rk3568-edp-phy.yaml#
    unevaluatedProperties: false

required:
  - compatible
  - reg
  - clocks
  - "#address-cells"
  - "#size-cells"
  - ranges

additionalProperties: false

examples:
  - |
    #include <dt-bindings/clock/rk3568-cru.h>

    soc {
      #address-cells = <2>;
      #size-cells = <2>;

      edp_phy_grf: syscon@fdcb0000 {
        compatible = "rockchip,rk3568-edp-phy-grf", "syscon", "simple-mfd";
        reg = <0x0 0xfdcb0000 0x0 0x8000>;
        clocks = <&cru PCLK_EDPPHY_GRF>;
        ranges = <0x0 0x0 0xfdcb0000 0x100>;
        #address-cells = <1>;
        #size-cells = <1>;

        edp_phy: phy@0 {
          compatible = "rockchip,rk3568-edp-phy";
          reg = <0x0 0x100>;
          clocks = <&pmucru XIN_OSC0_EDPPHY_G>, <&cru PCLK_EDPPHY_GRF>;
          clock-names = "ref", "apb";
          #phy-cells = <0>;
        };
      };
    };
```

## Documentation/devicetree/bindings/sound/airoha,an7581-afe.yaml
```yaml
# SPDX-License-Identifier: (GPL-2.0-only OR BSD-2-Clause)
%YAML 1.2
---
$id: http://devicetree.org/schemas/sound/airoha,an7581-afe.yaml#
$schema: http://devicetree.org/meta-schemas/core.yaml#

title: Airoha AFE PCM controller for AN7581

maintainers:
  - Christian Marangi <ansuelsmth@gmail.com>

properties:
  compatible:
    const: airoha,an7581-afe

  reg:
    items:
      - description: base AFE register
      - description: secondary IRQ option register

  interrupts:
    maxItems: 1

  resets:
    maxItems: 1

  '#sound-dai-cells':
    const: 0

required:
  - compatible
  - reg
  - interrupts
  - resets
  - '#sound-dai-cells'

additionalProperties: false

examples:
  - |
    #include <dt-bindings/interrupt-controller/arm-gic.h>
    #include <dt-bindings/interrupt-controller/irq.h>
    #include <dt-bindings/reset/airoha,en7581-reset.h>

    afe@1fbe2200 {
        compatible = "airoha,an7581-afe";
        reg = <0x1fbe2200 0x100>,
              <0x1fbe2f00 0x100>;

        interrupts = <GIC_SPI 48 IRQ_TYPE_LEVEL_HIGH>;
        resets = <&scuclk EN7581_I2S_RST>;

        #sound-dai-cells = <0>;
    };

...
```

## Documentation/devicetree/bindings/sound/awinic,aw8738.yaml
```yaml
# SPDX-License-Identifier: (GPL-2.0-only OR BSD-2-Clause)
%YAML 1.2
---
$id: http://devicetree.org/schemas/sound/awinic,aw8738.yaml#
$schema: http://devicetree.org/meta-schemas/core.yaml#

title: Awinic AW8738 Audio Amplifier

maintainers:
  - Stephan Gerhold <stephan@gerhold.net>

description:
  The Awinic AW8738 is a simple audio amplifier with different operation modes
  (set using one-wire pulse control). The mode configures the speaker-guard
  function (primarily the power limit for the amplifier).

  The Awinic AW8155 also has its mode set by one-wire pulses on its control
  pin. Its modes select the amplifier class, its gain and its power limit.

allOf:
  - $ref: dai-common.yaml#
  - if:
      properties:
        compatible:
          contains:
            const: awinic,aw8155
    then:
      properties:
        awinic,mode:
          enum: [1, 2, 4]

properties:
  compatible:
    oneOf:
      - const: awinic,aw8738
      - items:
          - const: awinic,aw8155
          - const: awinic,aw8738

  mode-gpios:
    description:
      GPIO used for one-wire pulse control. The pin is typically called SHDN
      (active-low), but this is misleading since it is actually more than
      just a simple shutdown/enable control.
    maxItems: 1

  awinic,mode:
    description: Operation mode (number of pulses for one-wire pulse control)
    $ref: /schemas/types.yaml#/definitions/uint32
    minimum: 1
    maximum: 7

  sound-name-prefix: true

required:
  - compatible
  - mode-gpios
  - awinic,mode

additionalProperties: false

examples:
  - |
    #include <dt-bindings/gpio/gpio.h>
    audio-amplifier {
        compatible = "awinic,aw8738";
        mode-gpios = <&msmgpio 114 GPIO_ACTIVE_HIGH>;
        awinic,mode = <5>;
        sound-name-prefix = "Speaker Amp";
    };
```
