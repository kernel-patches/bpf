## Documentation/devicetree/bindings/ufs/starfive,jhb100-ufs.yaml
```yaml
# SPDX-License-Identifier: GPL-2.0-only OR BSD-2-Clause
%YAML 1.2
---
$id: http://devicetree.org/schemas/ufs/starfive,jhb100-ufs.yaml#
$schema: http://devicetree.org/meta-schemas/core.yaml#

title: StarFive Universal Flash Storage (UFS) Controller

maintainers:
  - Minda Chen <minda.chen@starfivetech.com>

allOf:
  - $ref: ufs-common.yaml

properties:
  compatible:
    const: starfive,jhb100-ufs

  reg:
    maxItems: 1

  clocks:
    maxItems: 1

  clock-names:
    items:
      - const: main

  resets:
    items:
      - description: UFS main reset
      - description: UFS PHY reset

  reset-names:
    items:
      - const: main
      - const: phy

  interrupts:
    maxItems: 1

  starfive,syscon:
    $ref: /schemas/types.yaml#/definitions/phandle
    description:
      The phandle to the StarFive JHB100 SoC Peripheral-1 syscon
      register block.

required:
  - compatible
  - reg
  - clocks
  - clock-names
  - resets
  - reset-names
  - interrupts
  - starfive,syscon
  - operating-points-v2

unevaluatedProperties: false

examples:
  - |
    ufs@11b10000 {
        compatible = "starfive,jhb100-ufs";
        reg = <0x11b10000 0x20000>;
        interrupts = <105>;
        clocks = <&syscrg 4>;
        clock-names = "main";
        resets = <&syscrg 10>,
                 <&syscrg 7>;
        reset-names = "main", "phy";
        starfive,syscon = <&syscon>;
        operating-points-v2 = <&ufs_opp_table>;

        ufs_opp_table: opp-table {
            compatible = "operating-points-v2";
            opp-100000000 {
                opp-hz = /bits/ 64 <100000000>;
            };
        };
    };
```

## Documentation/devicetree/bindings/usb/stericsson,db8500-musb.yaml
```yaml
# SPDX-License-Identifier: (GPL-2.0-only OR BSD-2-Clause)
%YAML 1.2
---
$id: http://devicetree.org/schemas/usb/stericsson,db8500-musb.yaml#
$schema: http://devicetree.org/meta-schemas/core.yaml#

title: ST-Ericsson DB8500 MUSB controller

maintainers:
  - Linus Walleij <linusw@kernel.org>

allOf:
  - $ref: usb-drd.yaml#

properties:
  compatible:
    const: stericsson,db8500-musb

  reg:
    maxItems: 1

  interrupts:
    maxItems: 1

  interrupt-names:
    items:
      - const: mc

  clocks:
    maxItems: 1

  phys:
    maxItems: 1

  phy-names:
    items:
      - const: usb

  dmas:
    minItems: 16
    maxItems: 16

  dma-names:
    items:
      - const: iep_1_9
      - const: oep_1_9
      - const: iep_2_10
      - const: oep_2_10
      - const: iep_3_11
      - const: oep_3_11
      - const: iep_4_12
      - const: oep_4_12
      - const: iep_5_13
      - const: oep_5_13
      - const: iep_6_14
      - const: oep_6_14
      - const: iep_7_15
      - const: oep_7_15
      - const: iep_8
      - const: oep_8

required:
  - compatible
  - reg
  - interrupts
  - dr_mode

unevaluatedProperties: false

examples:
  - |
    usb@a03e0000 {
        compatible = "stericsson,db8500-musb";
        reg = <0xa03e0000 0x10000>;
        interrupts = <0 23 4>;
        interrupt-names = "mc";
        clocks = <&prcc_pclk 5 0>;
        dr_mode = "otg";
    };
```

## Documentation/devicetree/bindings/xilinx.txt
```
   Bindings for specific devices:

      v) Xilinx hwicap

		Xilinx hwicap devices provide access to the configuration logic
		of the FPGA through the Internal Configuration Access Port
		(ICAP).  The ICAP enables partial reconfiguration of the FPGA,
		readback of the configuration information, and some control over
		'warm boots' of the FPGA fabric.

		Required properties:
		- xlnx,family : The family of the FPGA, necessary since the
                      capabilities of the underlying ICAP hardware
                      differ between different families.  May be
                      'virtex2p', 'virtex4', or 'virtex5'.
		- compatible : should contain "xlnx,xps-hwicap-1.00.a" or
				"xlnx,opb-hwicap-1.00.b".
```

## arch/arm64/Kconfig.debug
```kconfig
# SPDX-License-Identifier: GPL-2.0-only

choice
	prompt "Choose kernel unwinder"
	default UNWINDER_FRAME_POINTER
	help
	  This determines which method will be used for unwinding kernel stack
	  traces for panics, oopses, bugs, warnings, perf, /proc/<pid>/stack,
	  livepatch, lockdep, and more.  If unsure, keep the default frame
	  pointer unwinder.

config UNWINDER_FRAME_POINTER
	bool "Frame pointer unwinder"
	select ARCH_WANT_FRAME_POINTERS
	select FRAME_POINTER
	help
	  This option enables the standard frame pointer (x29) unwinder for
	  unwinding kernel stack traces on arm64.  Kernel code is compiled
	  with frame records stored on the stack at a small runtime register
	  and code-size cost.

config UNWINDER_DWARF_CFI
	bool "Minimal DWARF CFI unwinder"
	depends on (!FUNCTION_TRACER || DYNAMIC_FTRACE_WITH_ARGS) && (!SHADOW_CALL_STACK || DYNAMIC_SCS)
	select UNWIND_DWARF_CFI
	select UNWIND_TABLES
	help
	  This option enables the Minimal DWARF Call Frame Information (CFI)
	  unwinder for kernel stack traces.  It interprets a strictly bounded
	  subset of compiler-generated .eh_frame / .eh_frame_hdr tables
	  matching SFrame's stack state model without requiring frame pointers.

endchoice

config PID_IN_CONTEXTIDR
	bool "Write the current PID to the CONTEXTIDR register"
	help
	  Enabling this option causes the kernel to write the current PID to
	  the CONTEXTIDR register, at the expense of some additional
	  instructions during context switch. Say Y here only if you are
	  planning to use hardware trace tools with this kernel.

config DEBUG_EFI
	depends on EFI && DEBUG_INFO
	bool "UEFI debugging"
	help
	  Enable this option to include EFI specific debugging features into
	  the kernel that are only useful when using a debug build of the
	  UEFI firmware

config ARM64_RELOC_TEST
	depends on m
	tristate "Relocation testing module"

source "drivers/hwtracing/coresight/Kconfig"
```

## arch/riscv/Kconfig.debug
```kconfig
# SPDX-License-Identifier: GPL-2.0-only

config UNWINDER_DWARF_CFI
	bool "Minimal DWARF CFI kernel unwinder"
	depends on 64BIT && MMU
	depends on (!FUNCTION_TRACER || DYNAMIC_FTRACE_WITH_ARGS) && !SHADOW_CALL_STACK
	select HAVE_MOD_ARCH_SPECIFIC if MODULES
	select UNWIND_DWARF_CFI
	select UNWIND_TABLES
	help
	  This option enables the Minimal DWARF Call Frame Information (CFI)
	  unwinder for kernel stack traces on 64-bit RISC-V.  It interprets a
	  strictly bounded subset of compiler-generated .eh_frame /
	  .eh_frame_hdr tables matching SFrame's stack state model without
	  requiring frame pointers.

source "arch/riscv/kernel/tests/Kconfig.debug"
```

## arch/sparc/crypto/Kconfig
```kconfig
# SPDX-License-Identifier: GPL-2.0

menu "Accelerated Cryptographic Algorithms for CPU (sparc64)"

config CRYPTO_CAMELLIA_SPARC64
	tristate "Ciphers: Camellia, modes: ECB, CBC"
	depends on SPARC64
	select CRYPTO_ALGAPI
	select CRYPTO_SKCIPHER
	help
	  Block ciphers: Camellia cipher algorithms
	  Length-preserving ciphers: Camellia with ECB and CBC modes

	  Architecture: sparc64

endmenu
```

## drivers/crypto/dwc-spacc/Kconfig
```kconfig
# SPDX-License-Identifier: GPL-2.0-only

config CRYPTO_DEV_SPACC
	tristate "Support for dwc_spacc Security Protocol Accelerator"
	depends on HAS_DMA
	depends on HAS_IOMEM
	select CRYPTO_ENGINE
	select CRYPTO_HASH if CRYPTO_DEV_SPACC_HASH
	select CRYPTO_SHA1 if CRYPTO_DEV_SPACC_HASH
	select CRYPTO_MD5 if CRYPTO_DEV_SPACC_HASH
	select CRYPTO_SHA256 if CRYPTO_DEV_SPACC_HASH
	select CRYPTO_SHA512 if CRYPTO_DEV_SPACC_HASH
	select CRYPTO_SHA3 if CRYPTO_DEV_SPACC_HASH
	select CRYPTO_HMAC if CRYPTO_DEV_SPACC_HASH
	select CRYPTO_CMAC if CRYPTO_DEV_SPACC_HASH
	select CRYPTO_XCBC if CRYPTO_DEV_SPACC_HASH
	select CRYPTO_SM4_GENERIC if CRYPTO_DEV_SPACC_HASH
	default n

	help
	  This enables support for SPAcc Hardware Accelerator.

if CRYPTO_DEV_SPACC

config CRYPTO_DEV_SPACC_HASH
	bool "Enable HASH functionality"
	default CRYPTO_DEV_SPACC
	help
	  Say y to enable Hash functionality of SPAcc.

config CRYPTO_DEV_SPACC_AUTODETECT
	bool "Enable Autodetect functionality"
	default n
	help
	  Say y to enable Autodetect functionality of SPAcc.

config CRYPTO_DEV_SPACC_DEBUG_TRACE_IO
	bool "Enable Trace MMIO reads/writes stats"
	default n
	help
	  Say y to enable Trace MMIO reads/writes stats.
	  To Debug and trace IO register read/write operations.

config CRYPTO_DEV_SPACC_DEBUG_TRACE_DDT
	bool "Enable Trace DDT entries stats"
	default n
	help
	  Say y to enable Enable DDT entry stats.
	  To Debug and trace DDT operation

config CRYPTO_DEV_SPACC_SECURE_MODE
	bool "Enable Spacc secure mode stats"
	default n
	help
	  Say y to enable SPAcc secure modes stats.

config CRYPTO_DEV_SPACC_CONFIG_DEBUG
	bool "Enable SPAcc debug logs"
	default n
	help
	  Say y to enable additional debug prints and diagnostics in the
	  SPAcc driver. Disable this for production builds.

endif # CRYPTO_DEV_SPACC
```

## drivers/net/ethernet/yunsilicon/Kconfig
```kconfig
# SPDX-License-Identifier: GPL-2.0
# Copyright (C) 2021-2026, Shanghai Yunsilicon Technology Co., Ltd.
# All rights reserved.
#
# Yunsilicon driver configuration
#

config NET_VENDOR_YUNSILICON
	bool "Yunsilicon devices"
	default y
	depends on PCI
	depends on 64BIT || COMPILE_TEST
	help
	  If you have a network (Ethernet) device belonging to this class,
	  say Y.

	  Note that the answer to this question doesn't directly affect the
	  kernel: saying N will just cause the configurator to skip all
	  the questions about Yunsilicon cards. If you say Y, you will be asked
	  for your specific card in the following questions.

if NET_VENDOR_YUNSILICON

source "drivers/net/ethernet/yunsilicon/xsc/pci/Kconfig"

endif # NET_VENDOR_YUNSILICON
```

## drivers/net/ethernet/yunsilicon/xsc/net/Kconfig
```kconfig
# SPDX-License-Identifier: GPL-2.0
# Copyright (C) 2021-2026, Shanghai Yunsilicon Technology Co., Ltd.
# All rights reserved.
# Yunsilicon driver configuration
#

config YUNSILICON_XSC_ETH
	tristate "Yunsilicon XSC ethernet driver"
	depends on YUNSILICON_XSC_PCI
	depends on NET
	select PAGE_POOL
	help
	  This driver provides ethernet support for
	  Yunsilicon XSC devices.

	  To compile this driver as a module, choose M here. The module
	  will be called xsc_eth.
```

## drivers/net/ethernet/yunsilicon/xsc/pci/Kconfig
```kconfig
# SPDX-License-Identifier: GPL-2.0
# Copyright (C) 2021-2026, Shanghai Yunsilicon Technology Co., Ltd.
# All rights reserved.
# Yunsilicon PCI configuration
#

config YUNSILICON_XSC_PCI
	tristate "Yunsilicon XSC PCI driver"
	depends on PCI
	depends on NET
	help
	  This driver provides the PCI core for Yunsilicon XSC
	  ethernet devices.

	  To compile this driver as a module, choose M here. The module
	  will be called xsc_pci.
```

## drivers/phy/cix/Kconfig
```kconfig
# SPDX-License-Identifier: GPL-2.0-only
#
# Phy drivers for CIX PHYs
#

config PHY_CIX_DP
	tristate "CIX Sky1 DP PHY driver"
	depends on OF && HAS_IOMEM && COMMON_CLK
	depends on ARCH_CIX || COMPILE_TEST
	select GENERIC_PHY
	help
	  Say Y here to enable the dedicated DisplayPort PHY used by the CIX
	  Sky1 DisplayPort controller. The PHY provides the physical layer
	  used by the dedicated DisplayPort output and supports link rates
	  up to HBR3.

	  To compile this driver as a module, choose M here. The module will
	  be called phy-cix-dp.
```

## drivers/pinctrl/nxp/Kconfig
```kconfig
# SPDX-License-Identifier: GPL-2.0-only
config PINCTRL_S32CC
	bool
	depends on ARCH_S32 && OF
	select GENERIC_PINCTRL_GROUPS
	select GENERIC_PINMUX_FUNCTIONS
	select GENERIC_PINCONF
	select REGMAP_MMIO

config PINCTRL_S32G2
	bool "NXP S32G2 pinctrl driver" if COMPILE_TEST
	depends on ARCH_S32 && OF
	default ARCH_S32
	select PINCTRL_S32CC
	help
	  Enable the SIUL2 pin controller driver for NXP S32G2 family SoCs.

	  This controller provides the pin muxing and configuration needed by
	  peripherals on the S32G274A-EVB, S32G274A-RDB2 and S32G399A-RDB3
	  boards, so every S32G defconfig build requires it to reach rootfs.
	  It is therefore enabled by default on ARCH_S32.
```

## kernel/livepatch/Kconfig
```kconfig
# SPDX-License-Identifier: GPL-2.0-only
config HAVE_LIVEPATCH
	bool
	help
	  Arch supports kernel live patching

config LIVEPATCH
	bool "Kernel Live Patching"
	depends on DYNAMIC_FTRACE_WITH_REGS || DYNAMIC_FTRACE_WITH_ARGS
	depends on MODULES
	depends on SYSFS
	depends on KALLSYMS_ALL
	depends on HAVE_LIVEPATCH
	depends on !TRIM_UNUSED_KSYMS
	help
	  Say Y here if you want to support kernel live patching.
	  This option has no runtime impact until a kernel "patch"
	  module uses the interface provided by this option to register
	  a patch, causing calls to patched functions to be redirected
	  to new function code contained in the patch module.

config HAVE_KLP_BUILD
	bool
	help
	  Arch supports klp-build

config KLP_BUILD
	def_bool y
	depends on LIVEPATCH && HAVE_KLP_BUILD
	select OBJTOOL
	help
	  Enable klp-build support

config KLP_HAS_PROVIDES
	def_bool y
	depends on LIVEPATCH
	help
	  Compile-time marker for the livepatch provides/obsoletes support.
	  It is always set when the kernel is built with the scoped atomic
	  replace model, i.e. struct klp_patch provides the "provides" and
	  "obsoletes" fields instead of the legacy "replace" flag.

	  The option itself does not enable or add any functionality; it
	  only serves as a compile-time marker so that out-of-tree modules
	  and tools (e.g. the livepatch kselftests) can detect kernels that
	  speak the provides/obsoletes interface and adapt to it with
	  #ifdef CONFIG_KLP_HAS_PROVIDES.
```
