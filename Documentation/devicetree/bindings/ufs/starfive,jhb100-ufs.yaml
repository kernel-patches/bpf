## scripts/Kconfig.toolchain
```kconfig
# SPDX-License-Identifier: GPL-2.0-only
# When adding a new dynamic check (such as {cc,ld}-option{,-str} or testing a
# small program), please add a comment documenting the first version of the
# tool that supported the feature being tested, ideally with a link to the tool
# change as well. For cc-option{,-str}, note the "beware" comment below.

config CC_VERSION_TEXT
	string
	default "$(CC_VERSION_TEXT)"
	help
	  This is used in unclear ways:

	  - Re-run Kconfig when the compiler is updated
	    The 'default' property references the environment variable,
	    CC_VERSION_TEXT so it is recorded in include/config/auto.conf.cmd.
	    When the compiler is updated, Kconfig will be invoked.

	  - Ensure full rebuild when the compiler is updated
	    include/linux/compiler-version.h contains this option in the comment
	    line so fixdep adds include/config/CC_VERSION_TEXT into the
	    auto-generated dependency. When the compiler is updated, syncconfig
	    will touch it and then every file will be rebuilt.

config CC_IS_GCC
	def_bool $(success,test "$(cc-name)" = GCC)

config GCC_VERSION
	int
	default $(cc-version) if CC_IS_GCC
	default 0

config CC_IS_CLANG
	def_bool $(success,test "$(cc-name)" = Clang)

config CLANG_VERSION
	int
	default $(cc-version) if CC_IS_CLANG
	default 0

config AS_IS_GNU
	def_bool $(success,test "$(as-name)" = GNU)

config AS_IS_LLVM
	def_bool $(success,test "$(as-name)" = LLVM)

config AS_VERSION
	int
	# Use clang version if this is the integrated assembler
	default CLANG_VERSION if AS_IS_LLVM
	default $(as-version)

config LD_IS_BFD
	def_bool $(success,test "$(ld-name)" = BFD)

config LD_VERSION
	int
	default $(ld-version) if LD_IS_BFD
	default 0

config LD_IS_LLD
	def_bool $(success,test "$(ld-name)" = LLD)

config LLD_VERSION
	int
	default $(ld-version) if LD_IS_LLD
	default 0

config RUSTC_VERSION
	int
	default $(rustc-version)
	help
	  It does not depend on `RUST` since that one may need to use the version
	  in a `depends on`.

config RUST_IS_AVAILABLE
	def_bool $(success,$(srctree)/scripts/rust_is_available.sh)
	help
	  This shows whether a suitable Rust toolchain is available (found).

	  Please see Documentation/rust/quick-start.rst for instructions on how
	  to satisfy the build requirements of Rust support.

	  In particular, the Makefile target 'rustavailable' is useful to check
	  why the Rust toolchain is not being detected.

config RUSTC_LLVM_VERSION
	int
	default $(rustc-llvm-version)

config RUSTC_LLVM_MAJOR_VERSION
	int
	default $(shell,expr $(rustc-llvm-version) / 10000)

config RUSTC_CLANG_LLVM_COMPATIBLE
	bool
	default y if CC_IS_CLANG && RUSTC_LLVM_MAJOR_VERSION = $(shell,expr $(cc-version) / 10000)
	help
	  This indicates whether Rust and Clang use LLVM of the same major
	  version.

	  Operations involving handling LLVM IR or bitcode (e.g. cross-language
	  LTO) require the same LLVM major version to work properly. For best
	  compatibility it is recommended that the exact same LLVM is used.

config ARCH_HAS_CC_CAN_LINK
	bool

config CC_CAN_LINK
	bool
	default ARCH_CC_CAN_LINK if ARCH_HAS_CC_CAN_LINK
	default $(cc_can_link_user,$(m64-flag)) if 64BIT
	default $(cc_can_link_user,$(m32-flag))

# Fixed in GCC 14, 13.3, 12.4 and 11.5
# https://gcc.gnu.org/bugzilla/show_bug.cgi?id=113921
config GCC_ASM_GOTO_OUTPUT_BROKEN
	bool
	depends on CC_IS_GCC
	default y if GCC_VERSION < 110500
	default y if GCC_VERSION >= 120000 && GCC_VERSION < 120400
	default y if GCC_VERSION >= 130000 && GCC_VERSION < 130300

config CC_HAS_ASM_GOTO_OUTPUT
	def_bool y
	depends on !GCC_ASM_GOTO_OUTPUT_BROKEN
	# gcc-11: https://gcc.gnu.org/git/?p=gcc.git;a=commit;h=e3b3b59683c1e7d31a9d313dd97394abebf644be
	# clang-11: https://github.com/llvm/llvm-project/commit/50cac248773c3a023e8f6ceb9938bdd5e9f15da2
	depends on $(success,echo 'int foo(int x) { asm goto ("": "=r"(x) ::: bar); return x; bar: return 0; }' | $(CC) -x c - -c -o /dev/null)

config TOOLS_SUPPORT_RELR
	def_bool $(success,env "CC=$(CC)" "LD=$(LD)" "NM=$(NM)" "OBJCOPY=$(OBJCOPY)" $(srctree)/scripts/tools-support-relr.sh)

config CC_HAS_ASM_INLINE
	# gcc-9: https://gcc.gnu.org/git/?p=gcc.git;a=commit;h=5b76e75f760f3e4787851366359d5d50f989877c
	# clang-11: https://github.com/llvm/llvm-project/commit/246398ece7115b57a02dbe7876d86ae8e72406ef
	def_bool $(success,echo 'void foo(void) { asm inline (""); }' | $(CC) -x c - -c -o /dev/null)

config CC_HAS_ASSUME
	bool
	# clang needs to be at least 19.1.0 since the meaning of the assume
	# attribute changed:
	# https://github.com/llvm/llvm-project/commit/c44fa3e8a9a44c2e9a575768a3c185354b9f6c17
	default y if CC_IS_CLANG && CLANG_VERSION >= 190100
	# supported since gcc 13.1.0
	# https://gcc.gnu.org/bugzilla/show_bug.cgi?id=106654
	default y if CC_IS_GCC && GCC_VERSION >= 130100

# Beware of two problems when using cc-option in Kconfig compared to Kbuild
#
# 1. cc-option in Kbuild tests the provided flags with all previously added
#    CFLAGS, whereas cc-option in Kconfig only tests the provided flags with a
#    small, constant set of additional flags.  If a flag (e.g., '-mfoo')
#    depends on another (e.g, '-fbar') to function properly, the dependency
#    must be included in the cc-option call (e.g, '-fbar -mfoo').
#
# 2. Bit and endianness flags ('-m32', '-m64', '-mbig-endian', and
#    '-mlittle-endian') are not present in Kconfig cc-option checks because
#    they may be included in KBUILD_CFLAGS / KBUILD_CPPFLAGS based on the
#    finalized configuration result. This can result in inconsistent results
#    when probing toolchains that support either option, as the toolchain's
#    configured default tested in Kconfig may not support the tested flag but
#    the post-configuration result in Kbuild would.
#
#    In general, prefer adding truly generic compiler flags to avoid this
#    pitfall.

config CC_OPT_ZERO_INIT_PADDING_BITS
	# gcc-15: https://gcc.gnu.org/git/?p=gcc.git;a=commit;h=0547dbb725b6d8e878a79e28a2e171eafcfbc1aa
	# clang-20 does this by default without a flag: https://github.com/llvm/llvm-project/commit/7a086e1b2dc05f54afae3591614feede727601fa
	def_string "$(cc-option-str,-fzero-init-padding-bits=all)"

config CC_OPT_NO_ADDRSIG
	# supported in clang, not needed for gcc
	def_string "-fno-addrsig" if CC_IS_CLANG

config CC_OPT_DIAGNOSTICS_SHOW_CONTEXT
	# gcc-16: https://gcc.gnu.org/git/?p=gcc.git;a=commit;h=6faa3cfe60ff9769d1bebfffdd2c7325217d7389
	# clang: not supported
	def_string "$(cc-option-str,-fdiagnostics-show-context=2)"

config CC_OPT_DIAGNOSTICS_SHOW_INLINING_CHAIN
	# clang-23: https://github.com/llvm/llvm-project/commit/f9ad232421e37e4168f6937abdd0a1665a590f12
	# gcc: not needed, it does this by default
	def_string "$(cc-option-str,-fdiagnostics-show-inlining-chain)"

config CC_OPT_STRICT_FLEX_ARRAYS
	# gcc-13: https://gcc.gnu.org/git/?p=gcc.git;a=commit;h=1879e48f3d8595bc9e7f583bbd12df3c6f5c42dc
	# clang-16: https://github.com/llvm/llvm-project/commit/7f93ae808634e33e4dc9bce753c909aa5f9a6eb4
	def_string "$(cc-option-str,-fstrict-flex-arrays=3)"

config CC_OPT_NO_ALLOW_STORE_DATA_RACES
	# gcc-10 renamed --param=allow-store-data-races=0 to -fno-allow-store-data-races:
	#   https://gcc.gnu.org/git/?p=gcc.git;a=commit;h=e622a32db78300821fc1327637ec6413febc2c66
	# clang: not needed
	def_string "$(cc-option-str,-fno-allow-store-data-races,--param=allow-store-data-races=0)" if CC_IS_GCC

config CC_HAS_MNOP_MCOUNT
	# s390 support
	#   gcc-9: https://gcc.gnu.org/git/?p=gcc.git;a=commit;h=79c2f6d7de59d5580d224b491d5600d20e3101fe
	#   clang-10: https://github.com/llvm/llvm-project/commit/93767143147b7d765c6ce8123a4226d449228649
	# x86 support
	#   gcc-5: https://gcc.gnu.org/git/?p=gcc.git;a=commit;h=ecc81e33123d7ac9c11742161e128858d844b99d
	#   clang-24: https://github.com/llvm/llvm-project/commit/f514b16972f785fdd3fad1d19195aad5c9324fb5
	def_bool $(cc-option,-mnop-mcount)

config LD_OPT_FORCE_GROUP_ALLOCATION
	# GNU ld 2.29: https://sourceware.org/git/gitweb.cgi?h=7bdf4127c38081c7764c0bf1db55d0b2e56391dc&p=binutils-gdb.git
	# ld.lld 19: https://github.com/llvm/llvm-project/commit/4d9020ca0b125a936d5e26b48f07fcfa4bd78004
	def_string "$(ld-option-str,--force-group-allocation)"

config LD_OPT_NO_WARN_RWX_SEGMENTS
	# GNU ld 2.39: https://sourceware.org/git/gitweb.cgi?h=ba951afb99912da01a6e8434126b8fac7aa75107&p=binutils-gdb.git
	# ld.lld: not supported
	def_string "$(ld-option-str,--no-warn-rwx-segments)"

config CC_OPT_WNO_ADDRESS_OF_PACKED_MEMBER
	# gcc-9: https://gcc.gnu.org/git/?p=gcc.git;a=commit;h=da77eace90fd99b38cd89ce281033d86ebfda434
	# clang-4: https://github.com/llvm/llvm-project/commit/585ea9ddce50f3c3d3fd6dae0f9f148c074bcc2b
	def_string "$(cc-option-str,-Wno-address-of-packed-member)"

config CC_OPT_WNO_FORMAT_OVERFLOW_NON_KPRINTF
	# clang-18: https://github.com/llvm/llvm-project/commit/56c3b8e997d065b568964f71715ecbbd28c2e4a4
	# gcc: not needed, it has this behavior by default
	def_string "$(cc-option-str,-Wno-format-overflow-non-kprintf)"

config CC_OPT_WNO_FORMAT_TRUNCATION_NON_KPRINTF
	# clang-18: https://github.com/llvm/llvm-project/commit/56c3b8e997d065b568964f71715ecbbd28c2e4a4
	# gcc: not needed, it has this behavior by default
	def_string "$(cc-option-str,-Wno-format-truncation-non-kprintf)"

config CC_OPT_WNO_DEFAULT_CONST_INIT_UNSAFE
	# clang-21: https://github.com/llvm/llvm-project/commit/00f9ef282c7482754a0fea497417604d1deca9fa
	# gcc: not supported
	def_string "$(cc-option-str,-Wno-default-const-init-unsafe)"

config CC_OPT_WNO_DANGLING_POINTER
	# gcc-12: https://gcc.gnu.org/git/?p=gcc.git;a=commit;h=9d6a0f388eb048f8d87f47af78f07b5ce513bfe6
	# clang: not supported
	def_string "$(cc-option-str,-Wno-dangling-pointer)"

config CC_OPT_WVLA_LARGER_THAN
	# gcc-7 for -Wvla-larger-than=: https://gcc.gnu.org/git/?p=gcc.git;a=commit;h=adc577c558a4b2e3b604511927cce17039d57c11
	# gcc-9 for -Wvla-larger-than=0: https://gcc.gnu.org/git/?p=gcc.git;a=commit;h=00abf86c47606f8220d6508654ef52ef11d76e3d
	# clang: not supported
	def_string "$(cc-option-str,-Wvla-larger-than=1)"

config CC_HAS_WSTRINGOP_OVERFLOW
	# gcc-7: https://gcc.gnu.org/git/?p=gcc.git;a=commit;h=ee92e7bafb52d267f52e4c48edada5f279bcf591
	# clang: not supported
	def_bool $(cc-option,-Wstringop-overflow)

config CC_OPT_WNO_UNTERMINATED_STRING_INITIALIZATION
	# gcc-15: https://gcc.gnu.org/git/?p=gcc.git;a=commit;h=44c9403ed1833ae71a59e84f9e37af3182be0df5
	# clang-21: https://github.com/llvm/llvm-project/commit/e8ae77947154e10dbc05cbb95ec9e10d3b0be13e
	def_string "$(cc-option-str,-Wno-unterminated-string-initialization)"

config CC_OPT_WERROR_DESIGNATED_INIT
	# gcc-5: https://gcc.gnu.org/git/?p=gcc.git;a=commit;h=976d5a222fc23279e239ad926472c7810869e494
	# clang: not supported
	def_string "$(cc-option-str,-Werror=designated-init)"

config CC_OPT_WENUM_CONVERSION
	# gcc-10: https://gcc.gnu.org/git/?p=gcc.git;a=commit;h=68e2c1996ec6bde27363ce0db15233ac8cae1c4d
	# clang-3.2: https://github.com/llvm/llvm-project/commit/68e2c7bee3ab337cc3134ff99fdd1ce2ddb33c2f
	def_string "$(cc-option-str,-Wenum-conversion)"

config CC_OPT_WNO_PACKED_NOT_ALIGNED
	# gcc-8: https://gcc.gnu.org/git/?p=gcc.git;a=commit;h=00aa1fa221744dc57f6c6cea8baa669b732d1101
	# clang: not supported
	def_string "$(cc-option-str,-Wno-packed-not-aligned)"

config CC_OPT_WNO_FORMAT_OVERFLOW
	# gcc-7: https://gcc.gnu.org/git/?p=gcc.git;a=commit;h=bce6f76013fd5f2e88a235231231c7879597220c
	# clang-18: https://github.com/llvm/llvm-project/commit/56c3b8e997d065b568964f71715ecbbd28c2e4a4
	def_string "$(cc-option-str,-Wno-format-overflow)"

config CC_OPT_WNO_STRINGOP_TRUNCATION
	# gcc-8: https://gcc.gnu.org/git/?p=gcc.git;a=commit;h=025d57f037ad13eb479818b677ef4be4d97b639c
	# clang: not supported
	def_string "$(cc-option-str,-Wno-stringop-truncation)"

config CC_OPT_WNO_CONSTANT_LOGICAL_OPERAND
	def_string "$(cc-option-str,-Wno-constant-logical-operand)"

config CC_HAS_COUNTED_BY
	bool
	# clang needs to be at least 20.1.0 to avoid potential crashes
	# when building structures that contain __counted_by
	# https://github.com/ClangBuiltLinux/linux/issues/2114
	# https://github.com/llvm/llvm-project/commit/160fb1121cdf703c3ef5e61fb26c5659eb581489
	default y if CC_IS_CLANG && CLANG_VERSION >= 200100
	# supported since gcc 15.1.0
	# https://gcc.gnu.org/bugzilla/show_bug.cgi?id=108896
	default y if CC_IS_GCC && GCC_VERSION >= 150100

config CC_HAS_COUNTED_BY_PTR
	bool
	# supported since clang 22
	default y if CC_IS_CLANG && CLANG_VERSION >= 220100
	# supported since gcc 16.0.0
	default y if CC_IS_GCC && GCC_VERSION >= 160000

config CC_HAS_BROKEN_COUNTED_BY_REF
	bool
	# https://github.com/llvm/llvm-project/issues/182575
	default y if CC_IS_CLANG && CLANG_VERSION < 220100

config CC_HAS_ALLOC_TOKEN
	# clang-22: https://github.com/llvm/llvm-project/commit/774ffe5cce7392e6b4e29c83e725337727c2c994
	# gcc: not supported
	def_bool $(cc-option,-falloc-token-max=123)

config CC_HAS_MULTIDIMENSIONAL_NONSTRING
	# gcc-15: https://gcc.gnu.org/git/?p=gcc.git;a=commit;h=ab714e60870d1bb98039652b760918b5e680ac10
	# clang-21: https://github.com/llvm/llvm-project/commit/3d4f979e271d2a1fe0906f4d1b16db108838f98f
	def_bool $(success,echo 'char tag[][4] __attribute__((__nonstring__)) = { };' | $(CC) $(CLANG_FLAGS) -x c - -c -o /dev/null -Werror)

config CC_OPT_INLINE_MEMSET
	string
	# gcc-14: https://gcc.gnu.org/git/?p=gcc.git;a=commit;h=1ff6d9f7428b0668cd8ab0b3e3ab94f1d733124d
	default "-finline-stringops=memset" if $(cc-option,-finline-stringops=memset)
	# clang-22: https://github.com/llvm/llvm-project/commit/b28eeb28bea39148738dc375e8a97072a1907e64
	default "-mllvm -max-store-memset=4294967294" if $(cc-option,-mllvm -max-store-memset=4294967294)

config LD_CAN_USE_KEEP_IN_OVERLAY
	# ld.lld prior to 21.0.0 did not support KEEP within an overlay description
	# https://github.com/llvm/llvm-project/pull/130661
	def_bool LD_IS_BFD || LLD_VERSION >= 210000

config RUSTC_HAS_UNNECESSARY_TRANSMUTES
	def_bool RUSTC_VERSION >= 108800

config RUSTC_HAS_FILE_WITH_NUL
	def_bool RUSTC_VERSION >= 108900

config RUSTC_HAS_FILE_AS_C_STR
	def_bool RUSTC_VERSION >= 109100

config RUSTC_HAS_SUSPICIOUS_RUNTIME_SYMBOL_DEFINITIONS
	def_bool RUSTC_VERSION >= 109800

config PAHOLE_VERSION
	int
	default "$(PAHOLE_VERSION)"
```

## sound/soc/airoha/Kconfig
```kconfig
# SPDX-License-Identifier: GPL-2.0-only

config SND_SOC_AN7581_PCM
	tristate "PCM support for Airoha AN7581 chip"
	depends on ARCH_AIROHA || COMPILE_TEST
	select REGMAP_MMIO
	help
	  This adds PCM driver for Airoha AN7581 boards
	  that can be used with other codecs.
	  Select Y if you have such device.
	  If unsure select "N".
```
