## drivers/hid/bpf/Kconfig
```kconfig
# SPDX-License-Identifier: GPL-2.0-only
menu "HID-BPF support"
	#depends on x86_64

config HID_BPF
	bool "HID-BPF support"
	default y
	depends on BPF && BPF_SYSCALL
	select HID
	help
	This option allows to support eBPF programs on the HID subsystem.
	eBPF programs can fix HID devices in a lighter way than a full
	kernel patch and allow a lot more flexibility.

	For documentation, see Documentation/hid/hid-bpf.rst

	If unsure, say Y.

endmenu
```

## kernel/bpf/crib/Kconfig
```kconfig
# SPDX-License-Identifier: GPL-2.0-only

config BPF_CRIB
	bool "Checkpoint/Restore In eBPF (CRIB)"
	depends on BPF_SYSCALL
	depends on BPF_JIT
	depends on DEBUG_INFO_BTF
	help
	  Enable CRIB (Checkpoint/Restore In eBPF), which allows
	  checkpointing/restoring of processes through BPF programs.

	  Compared to procfs and system call interfaces, CRIB achieves
	  higher performance and supports dumping/restoring more
	  comprehensive process status information.
```

## kernel/bpf/preload/Kconfig
```kconfig
# SPDX-License-Identifier: GPL-2.0-only
config USERMODE_DRIVER
	bool
	default n

menuconfig BPF_PRELOAD
	bool "Preload eBPF programs"
	depends on BPF
	depends on BPF_SYSCALL
	# The dependency on !COMPILE_TEST prevents it from being enabled
	# in allmodconfig or allyesconfig configurations
	depends on !COMPILE_TEST
	select USERMODE_DRIVER
	help
	  This enables preloading eBPF programs chosen from the kernel
	  configuration or from the kernel option bpf_preload_list=.

if BPF_PRELOAD
config BPF_PRELOAD_UMD
	tristate "Preload BPF file system with kernel specific program and map iterators"
	default m
	help
	  This builds bpf_preload kernel module with several embedded BPF
	  programs that are pinned into BPF FS mount point as human readable
	  files that are useful in debugging and introspection of BPF programs
	  and maps.

config BPF_PRELOAD_LIST
	string "Ordered list of eBPF programs to preload"
	default "bpf_preload"
	help
	  A comma-separated list of eBPF programs to preload. Any eBPF program
	  left off this list will be ignored. This can be controlled at boot
	  with the "bpf_preload_list=" parameter.

	  If unsure, leave this as the default.
endif
```

## security/devguard/Kconfig
```kconfig
config SECURITY_DEVGUARD
	bool "Devguard for device node creation"
	depends on SECURITY
	depends on CGROUP_BPF
	default n
	help
	  This enables devguard, an LSM that allows to guard device node
	  creation in non-initial user namespace. It may allow mknod
	  in cooperation of an attached cgroup device program.
	  This security module stacks with other LSMs.

	  If you are unsure how to answer this question, answer N.
```

## security/device_cgroup/Kconfig
```kconfig
# SPDX-License-Identifier: GPL-2.0-only
config SECURITY_DEVICE_CGROUP
	bool "Device Cgroup Support"
	depends on SECURITY
	help
	  Provides the necessary security framework integration
	  for cgroup device controller implementations.
```
