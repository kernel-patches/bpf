## drivers/platform/asus/Kconfig
```kconfig
# SPDX-License-Identifier: GPL-2.0-only
#
# Asus Platform Specific Drivers
#

if X86_PLATFORM_DEVICES

config ASUS_LAPTOP
	tristate "Asus Laptop Extras"
	depends on ACPI
	select LEDS_CLASS
	select NEW_LEDS
	depends on BACKLIGHT_CLASS_DEVICE
	depends on INPUT
	depends on RFKILL || RFKILL = n
	depends on ACPI_VIDEO || ACPI_VIDEO = n
	select INPUT_SPARSEKMAP
	help
	  This is a driver for Asus laptops, Lenovo SL and the Pegatron
	  Lucid tablet. It may also support some MEDION, JVC or VICTOR
	  laptops. It makes all the extra buttons generate standard
	  ACPI events and input events, and on the Lucid the built-in
	  accelerometer appears as an input device.  It also adds
	  support for video output switching, LCD backlight control,
	  Bluetooth and Wlan control, and most importantly, allows you
	  to blink those fancy LEDs.

	  For more information see <http://acpi4asus.sf.net>.

	  If you have an ACPI-compatible ASUS laptop, say Y or M here.

config ASUS_WIRELESS
	tristate "Asus Wireless Radio Control Driver"
	depends on ACPI
	depends on INPUT
	select NEW_LEDS
	select LEDS_CLASS
	help
	  The Asus Wireless Radio Control handles the airplane mode hotkey
	  present on some Asus laptops.

	  Say Y or M here if you have an ASUS notebook with an airplane mode
	  hotkey.

	  If you choose to compile this driver as a module the module will be
	  called asus-wireless.

config ASUS_TF103C_DOCK
	tristate "Asus TF103C 2-in-1 keyboard dock"
	depends on ACPI
	depends on I2C
	depends on INPUT
	depends on HID
	depends on GPIOLIB
	help
	  This is a driver for the keyboard, touchpad and USB port of the
	  keyboard dock for the Asus TF103C 2-in-1 tablet.

	  This keyboard dock has its own I2C attached embedded controller
	  and the keyboard and touchpad are also connected over I2C,
	  instead of using the usual USB connection. This means that the
	  keyboard dock requires this special driver to function.

	  If you have an Asus TF103C tablet say Y or M here, for a generic x86
	  distro config say M here.

config EEEPC_WMI
	tristate "Eee PC WMI Driver"
	depends on ASUS_WMI
	help
	  This is a driver for newer Eee PC laptops. It adds extra features
	  like wireless radio and bluetooth control, leds, hotkeys, backlight...

	  For more information, see
	  <file:Documentation/ABI/testing/sysfs-platform-asus-wmi>

	  If you have an ACPI-WMI compatible Eee PC laptop (>= 1000), say Y or M
	  here.

config EEEPC_LAPTOP
	tristate "Eee PC Hotkey Driver"
	depends on ACPI_EC
	depends on INPUT
	depends on RFKILL || RFKILL = n
	depends on ACPI_VIDEO || ACPI_VIDEO = n
	depends on HOTPLUG_PCI
	depends on BACKLIGHT_CLASS_DEVICE
	select HWMON
	select LEDS_CLASS
	select NEW_LEDS
	select INPUT_SPARSEKMAP
	help
	  This driver supports the Fn-Fx keys on Eee PC laptops.

	  It  also gives access to some extra laptop functionalities like
	  Bluetooth, backlight and allows powering on/off some other
	  devices.

	  If you have an Eee PC laptop, say Y or M here. If this driver
	  doesn't work on your Eee PC, try eeepc-wmi instead.

endif # X86_PLATFORM_DEVICES

config ASUS_ARMOURY
	tristate "ASUS Armoury driver"
	depends on ASUS_WMI
	select FW_ATTR_CLASS
	help
	  Say Y here if you have a WMI aware Asus machine and would like to use the
	  firmware_attributes API to control various settings typically exposed in
	  the ASUS Armoury Crate application available on Windows.

	  To compile this driver as a module, choose M here: the module will
	  be called asus-armoury.

config ASUS_WMI
	tristate "ASUS WMI Driver"
	depends on ACPI_WMI
	depends on ACPI_BATTERY
	depends on INPUT
	depends on HWMON
	depends on BACKLIGHT_CLASS_DEVICE
	depends on RFKILL || RFKILL = n
	depends on HOTPLUG_PCI
	depends on ACPI_VIDEO || ACPI_VIDEO = n
	depends on SERIO_I8042 || SERIO_I8042 = n
	select INPUT_SPARSEKMAP
	select LEDS_CLASS
	select NEW_LEDS
	select ACPI_PLATFORM_PROFILE
	help
	  Say Y here if you have a WMI aware Asus laptop (like Eee PCs or new
	  Asus Notebooks).

	  To compile this driver as a module, choose M here: the module will
	  be called asus-wmi.

config ASUS_WMI_DEPRECATED_ATTRS
	bool "BIOS option support in WMI platform (DEPRECATED)"
	depends on ASUS_WMI
	default y
	help
	  Say Y to expose the configurable BIOS options through the asus-wmi
	  driver.

	  This can be used with or without the asus-armoury driver which
	  has the same attributes, but more, and better features.

config ASUS_NB_WMI
	tristate "Asus Notebook WMI Driver"
	depends on ASUS_WMI
	help
	  This is a driver for newer Asus notebooks. It adds extra features
	  like wireless radio and bluetooth control, leds, hotkeys, backlight...

	  For more information, see
	  <file:Documentation/ABI/testing/sysfs-platform-asus-wmi>

	  If you have an ACPI-WMI compatible Asus Notebook, say Y or M
	  here.
```

## drivers/reset/realtek/Kconfig
```kconfig
# SPDX-License-Identifier: GPL-2.0-only
config RESET_RTK_COMMON
	tristate "Realtek common reset driver" if COMPILE_TEST
	help
	  This option enables the common reset controller library for
	  Realtek SoCs. It provides shared reset control operations
	  (assert, deassert, status) that other Realtek-specific reset
	  drivers can use.

config RESET_RTD1625
	tristate "RTD1625 Reset Controller"
	depends on ARCH_REALTEK || COMPILE_TEST
	select RESET_RTK_COMMON
	select AUXILIARY_BUS
	help
	  This enables the reset controller driver for Realtek RTD1625 SoC.
	  The driver controls reset lines for various peripherals including
	  PCIe, SATA, HDMI, display, video encoder/decoder, USB, SD, audio,
	  and other subsystems.
```

## fs/notify/fanotify/Kconfig
```kconfig
# SPDX-License-Identifier: GPL-2.0-only
config FANOTIFY
	bool "Filesystem wide access notification"
	select FSNOTIFY
	select EXPORTFS
	default n
	help
	   Say Y here to enable fanotify support.  fanotify is a file access
	   notification system which differs from inotify in that it sends
	   an open file descriptor to the userspace listener along with
	   the event.

	   If unsure, say Y.

config FANOTIFY_ACCESS_PERMISSIONS
	bool "fanotify permissions checking"
	depends on FANOTIFY
	depends on SECURITY
	default n
	help
	   Say Y here is you want fanotify listeners to be able to make permissions
	   decisions concerning filesystem events.  This is used by some fanotify
	   listeners which need to scan files before allowing the system access to
	   use those files.  This is used by some anti-malware vendors and by some
	   hierarchical storage management systems.

	   If unsure, say N.

config FANOTIFY_FASTPATH
	bool "fanotify fastpath handler"
	depends on FANOTIFY
	default y
	help
	   Say Y here if you want to use fanotify in kernel fastpath handler.
	   The fastpath handler can be implemented in a kernel module or a
	   BPF program. The fastpath handler can speed up fanotify in many
	   use cases. For example, when the listener is only interested in
	   a subset of events.

	   If unsure, say Y.
```

## kernel/bpf/insn_kfuncs/Kconfig
```kconfig
# SPDX-License-Identifier: GPL-2.0-only
config BPF_INSN_KFUNCS
	tristate "Kfuncs for CPU instructions that BPF lacks"
	depends on BPF_SYSCALL && BPF_JIT && DEBUG_INFO_BTF
	help
	  Provide kfuncs for rotate, conditional select, bit field extract,
	  big-endian load, prefetch, 16-byte copy and address computation.
	  The verifier checks each call as the kfunc's BPF body, and the JIT
	  puts native code in its place where it can.

	  If unsure, say N.

config BPF_INSN_KFUNCS_ARCH
	bool
	depends on BPF_INSN_KFUNCS
	default y if X86_64
```

## net/smc/Kconfig
```kconfig
# SPDX-License-Identifier: GPL-2.0-only
config SMC
	tristate "SMC socket protocol family"
	depends on INET && INFINIBAND
	depends on m || ISM != m
	help
	  SMC-R provides a "sockets over RDMA" solution making use of
	  RDMA over Converged Ethernet (RoCE) technology to upgrade
	  AF_INET TCP connections transparently.
	  The Linux implementation of the SMC-R solution is designed as
	  a separate socket family SMC.

	  Select this option if you want to run SMC socket applications

config SMC_DIAG
	tristate "SMC: socket monitoring interface"
	depends on SMC
	help
	  Support for SMC socket monitoring interface used by tools such as
	  smcss.

	  if unsure, say Y.

config SMC_LO
	bool "SMC intra-OS shortcut with loopback-ism"
	depends on SMC
	default n
	help
	  SMC_LO enables the creation of an Emulated-ISM device named
	  loopback-ism in SMC and makes use of it for transferring data
	  when communication occurs within the same OS. This helps in
	  convenient testing of SMC-D since loopback-ism is independent
	  of architecture or hardware.

	  if unsure, say N.

config SMC_HS_CTRL_BPF
	bool "Generic eBPF hook for SMC handshake flow"
	depends on SMC && BPF_SYSCALL
	default n
	help
	  SMC_HS_CTRL_BPF enables support to register generic eBPF hook for SMC
	  handshake flow, which offer much greater flexibility in modifying the behavior
	  of the SMC protocol stack compared to a complete kernel-based approach. Select
	  this option if you want filtring the handshake process via eBPF programs.

	  if unsure, say N.
```

## scripts/llvm-plugins/Kconfig
```kconfig
# SPDX-License-Identifier: GPL-2.0-only

menuconfig LLVM_PLUGINS
	bool "LLVM plugins"
	depends on CC_IS_CLANG
	depends on $(success,$(LLVM_CONFIG) --version)
	# The plugins are built against the headers of llvm-config and loaded
	# by clang, so both must come from the same LLVM release
	depends on $(success,test "$(shell,$(LLVM_CONFIG) --version 2>/dev/null | cut -d. -f1)" = "$(shell,$(CC) -dumpversion | cut -d. -f1)")
	# The host C++ compiler must accept the LLVM headers and flags
	depends on $(success,echo '#include <llvm/Config/llvm-config.h>' | $(HOSTCXX) $(shell,$(LLVM_CONFIG) --cxxflags 2>/dev/null) -x c++ -fsyntax-only -)
	default y
	help
	  LLVM plugins add compiler passes to kernel and module builds.
	  Building them requires LLVM development headers and llvm-config
	  of the same major version as clang. Each plugin has its own option
	  below and is built only if that option is enabled.

if LLVM_PLUGINS

config CLANG_PLUGIN_BPF_SCAN_IR
	bool "Scan optimized LLVM IR for BPF"
	depends on X86_64 || ARM64
	depends on DEBUG_INFO_BTF
	depends on !LTO_CLANG
	depends on CLANG_VERSION >= 190000
	help
	  Find the functions which return errors on paths without side
	  effects and describe them in .BTF_fmodret_candidates for
	  resolve_btfids. The section is discarded from the final kernel
	  and modules.

endif
```
