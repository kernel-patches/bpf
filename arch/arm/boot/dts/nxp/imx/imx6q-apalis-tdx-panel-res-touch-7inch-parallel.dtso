// SPDX-License-Identifier: GPL-2.0-only OR MIT
/*
 * Copyright (c) Toradex
 *
 * Toradex Resistive Touch Display 7" Parallel connected through the 40-way
 * Unified Interface Display connector (as featured on Ixora carrier board and
 * Apalis Evaluation Board). Touchscreen is available only on Apalis iMX6 v1.2.
 *
 * https://docs.toradex.com/104498-7-inch-parallel-resistive-touch-display-800x480.pdf
 * https://developer.toradex.com/hardware/accessories/displays/resistive-touch-display-7inch-parallel/
 * https://www.toradex.com/accessories/resistive-touch-display
 */

/dts-v1/;
/plugin/;

&backlight {
	status = "okay";
};

&lcd_display {
	status = "okay";
};

&panel_dpi {
	compatible = "logictechno,lt161010-2nhr";
	power-supply = <&reg_3v3_sw>;

	status = "okay";
};
