// SPDX-License-Identifier: GPL-2.0-only OR MIT
/*
 * Copyright (c) Toradex
 *
 * Legacy Toradex CSI Camera Module 5MP OV5640 on Apalis iMX6 CSI.
 *
 * https://developer.toradex.com/hardware/legacy-products/other/csi-camera-module-5mp-ov5640
 */

/dts-v1/;
/plugin/;

#include "imx6q-apalis-ov5640.dtsi"

&clock_camera {
	clock-frequency = <24000000>;
};
