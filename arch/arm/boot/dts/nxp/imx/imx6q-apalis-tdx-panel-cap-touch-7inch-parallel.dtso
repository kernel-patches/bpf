// SPDX-License-Identifier: GPL-2.0-only OR MIT
/*
 * Copyright (c) Toradex
 *
 * Toradex Capacitive Touch Display 7" Parallel connected through the 40-way
 * Unified Interface Display and 10-way Capacitive Touch Interface connectors
 * (as featured on Ixora carrier board and Apalis Evaluation Board).
 *
 * https://docs.toradex.com/104497-7-inch-parallel-capacitive-touch-display-800x480-datasheet.pdf
 * https://developer.toradex.com/hardware/accessories/displays/capacitive-touch-display-7inch-parallel/
 * https://www.toradex.com/accessories/capacitive-touch-display-7-inch-parallel
 */

/dts-v1/;
/plugin/;

&atmel_mxt_ts {
	status = "okay";
};

&backlight {
	status = "okay";
};

&lcd_display {
	status = "okay";
};

&panel_dpi {
	compatible = "logictechno,lt161010-2nhc";
	power-supply = <&reg_3v3_sw>;

	status = "okay";
};
