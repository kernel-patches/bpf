// SPDX-License-Identifier: GPL-2.0-only OR MIT
/*
 * Copyright (c) Toradex
 *
 * Toradex Capacitive Touch Display 7" Parallel connected through the 40-way
 * Unified Interface Display and 10-way Capacitive Touch Interface connectors
 * (as featured on Iris v2 and Aster v1.1 carrier boards).
 *
 * https://docs.toradex.com/104497-7-inch-parallel-capacitive-touch-display-800x480-datasheet.pdf
 * https://developer.toradex.com/hardware/accessories/displays/capacitive-touch-display-7inch-parallel/
 * https://www.toradex.com/accessories/capacitive-touch-display-7-inch-parallel
 */

/dts-v1/;
/plugin/;

#include <dt-bindings/gpio/gpio.h>
#include <dt-bindings/interrupt-controller/irq.h>

#include "imx6ull-imx7-colibri-tdx-panel-cap-touch-7inch-parallel.dtsi"

&atmel_mxt_ts {
	pinctrl-0 = <&pinctrl_atmel_conn &pinctrl_atmel_snvs_conn>;
	/* SODIMM 107 / TOUCH_INT# */
	interrupt-parent = <&gpio5>;
	interrupts = <4 IRQ_TYPE_EDGE_FALLING>;
	/* SODIMM 106 / TOUCH_RST# */
	reset-gpios = <&gpio1 10 GPIO_ACTIVE_LOW>;

	status = "okay";
};
