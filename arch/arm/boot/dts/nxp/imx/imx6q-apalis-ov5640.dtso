// SPDX-License-Identifier: GPL-2.0-only OR MIT
/*
 * Copyright (c) Toradex
 *
 * Toradex CSI Camera Set 5MP OV5640 on Apalis iMX6 CSI.
 *
 * https://developer.toradex.com/hardware/accessories/cameras/csi-camera-module-5mp-ov5640-arducam
 * https://www.toradex.com/accessories/csi-camera-ov5640
 */

/dts-v1/;
/plugin/;

#include "imx6q-apalis-ov5640.dtsi"

&clock_camera {
	clock-frequency = <27000000>;
};
