// SPDX-License-Identifier: (GPL-2.0 OR MIT)
/*
 * Copyright (C) 2021 BSH Hausgeraete GmbH
 */

/dts-v1/;

#include "imx6ulz-bsh-smm-m2-common.dtsi"

/ {
	model = "BSH SMM M2B";
	compatible = "bsh,imx6ulz-bsh-smm-m2b", "fsl,imx6ull", "fsl,imx6ulz";
};
