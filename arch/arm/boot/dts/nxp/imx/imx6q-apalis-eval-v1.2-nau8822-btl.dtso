// SPDX-License-Identifier: GPL-2.0-only OR MIT
/*
 * Copyright (c) Toradex
 *
 * Enable Bridge Tied Load (BTL) speaker mode on the Apalis Evaluation
 * Board V1.2, combining the two loudspeaker outputs for higher output
 * power.
 */

/dts-v1/;
/plugin/;

&nau8822_1a {
	nuvoton,spk-btl;
};
