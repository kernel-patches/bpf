// SPDX-License-Identifier: BSD-3-Clause
/*
 * Copyright (c) Qualcomm Technologies, Inc. and/or its subsidiaries.
 */

/dts-v1/;

#include "glymur-cob.dtsi"
#include "glymur-qcb.dtsi"

/ {
	model = "Qualcomm Technologies, Inc. Glymur QCB";
	compatible = "qcom,glymur-qcb", "qcom,glymur";
};

&ufs_mem_hc {
	reset-gpios = <&tlmm 250 GPIO_ACTIVE_LOW>;

	vcc-supply = <&vreg_l17b0>;
	vcc-max-microamp = <1200000>;
	vccq-supply = <&vreg_l12b0>;
	vccq-max-microamp = <1200000>;

	status = "okay";
};

&ufs_mem_phy {
	vdda-phy-supply = <&vreg_l1c1>;
	vdda-pll-supply = <&vreg_l4f1>;

	status = "okay";
};
