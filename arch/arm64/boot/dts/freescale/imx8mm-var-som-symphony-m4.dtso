// SPDX-License-Identifier: (GPL-2.0+ OR MIT)
/*
 * Cortex-M4 support for Variscite VAR-SOM-MX8M-MINI on Symphony-Board
 *
 * Link: https://variscite.com/carrier-boards/symphony-board/
 *
 * Copyright (C) 2026 Variscite Ltd. - https://www.variscite.com/
 *
 */

/dts-v1/;
/plugin/;

#include "imx8mm-var-common-m4.dtsi"

/* Reserve the peripherals used by the Cortex-M4 firmware. */
&ecspi1 {
	status = "reserved";
};

&i2c4 {
	status = "reserved";
};

&pwm3 {
	status = "reserved";
};

&uart3 {
	status = "reserved";
};
