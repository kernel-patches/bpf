// SPDX-License-Identifier: (GPL-2.0+ OR MIT)
/*
 * Cortex-M7 support for Variscite DART-MX8M-PLUS on Sonata-Board
 *
 * Link: https://variscite.com/carrier-boards/sonata-board/
 *
 * Copyright (C) 2026 Variscite Ltd. - https://www.variscite.com/
 *
 */

/dts-v1/;
/plugin/;

#include "imx8mp-var-common-m7.dtsi"

/* Reserve the peripherals used by the Cortex-M7 firmware. */
&ecspi1 {
	status = "reserved";
};

&flexcan1 {
	status = "reserved";
};

&i2c3 {
	status = "reserved";
};

&uart3 {
	status = "reserved";
};
